[part 1 of 2: packages /ApplicationTypes to /SVC_DEF_Hierarchy/SVC_eBstActrSecDef]
AUTOSAR XML (schema 00049)
standard types defined: float32, sint16, uint16, uint32, uint64, uint8
package /ApplicationTypes
  6 x app type:
    AppBoolean: category=BOOLEAN
    AppEnum: category=VALUE
    AppSint16: category=VALUE
    AppUint16: category=VALUE
    AppUint64: category=VALUE
    AppUint8: category=VALUE
package /Communication/DataTransformationSet
  data transformation set E2E_Transformer_Configuration
    transformation technology E2E_Transformer_PROFILE_GM_05_SOMEIP:
      buffer-properties={buffer-computation=compu-rational-coeffs={compu-numerator=[0, 1], compu-denominator=[1, 0]}, header-length=8, in-place=true}
      has-internal-state=true
      needs-original-data=false
      protocol=E2E
      end-to-end-transformation-description{clear-from-valid-to-invalid=false, max-delta-counter=2, max-error-state-init=0, max-error-state-invalid=0, max-error-state-valid=0, min-ok-state-init=1, min-ok-state-invalid=1, min-ok-state-valid=1, offset=64, profile-name=PROFILE_GM_05, upper-header-bits-to-shift=64, window-size=2, window-size-init=2, window-size-invalid=1, window-size-valid=1}
      transformer-class=SAFETY
      version=1.0.0
    transformation technology E2E_Transformer_PROFILE_GM_01_SOMEIP:
      buffer-properties={buffer-computation=compu-rational-coeffs={compu-numerator=[0, 1], compu-denominator=[1, 0]}, header-length=8, in-place=true}
      has-internal-state=true
      needs-original-data=false
      protocol=E2E
      end-to-end-transformation-description{clear-from-valid-to-invalid=false, max-delta-counter=2, max-error-state-init=0, max-error-state-invalid=0, max-error-state-valid=0, min-ok-state-init=1, min-ok-state-invalid=1, min-ok-state-valid=1, offset=64, profile-name=PROFILE_GM_01, upper-header-bits-to-shift=64, window-size=2, window-size-init=2, window-size-invalid=1, window-size-valid=1}
      transformer-class=SAFETY
      version=1.0.0
  data transformation set SOMEIP_Transformer_Configuration
    data transformation SOMEIP_Data_Transform_wE2E_PROFILE_GM_05: execute-despite-data-unavailability=true, transformer-chain=[SOMEIP_Transformer, E2E_Transformer_PROFILE_GM_05_SOMEIP]
    data transformation SOMEIP_Data_Transform_wE2E_PROFILE_GM_01: execute-despite-data-unavailability=true, transformer-chain=[SOMEIP_Transformer, E2E_Transformer_PROFILE_GM_01_SOMEIP]
    transformation technology SOMEIP_Transformer: buffer-properties={buffer-computation=compu-rational-coeffs={compu-numerator=[8, 1], compu-denominator=[1, 0]}, header-length=64, in-place=false}, has-internal-state=false, needs-original-data=false, protocol=SOMEIP, someip-transformation-description{alignment=8, byte-order=little-endian, interface-version=1}, transformer-class=SERIALIZER, version=1.0.0
  data transformation set SPM_SOMEIP_Transformer_Configuration
    data transformation SPM_SOMEIP_Data_Transformation: execute-despite-data-unavailability=true, transformer-chain=SPM_SOMEIP_Transformer
    transformation technology SPM_SOMEIP_Transformer: buffer-properties={buffer-computation=compu-rational-coeffs={compu-numerator=[8, 1], compu-denominator=[1, 0]}, header-length=64, in-place=false}, has-internal-state=false, needs-original-data=false, protocol=SOMEIP, someip-transformation-description{alignment=8, byte-order=big-endian, interface-version=1}, transformer-class=SERIALIZER, version=1.0.0
package /Communication/Data_Transformation
  data transformation set COM_Transformer_Configuration
    transformation technology COM_Transformer: buffer-properties={header-length=0, in-place=false}, protocol=COMBased, transformer-class=SERIALIZER, version=1.0.0
  data transformation set E2E_Transformer_Configuration
    5 x data transformation, all with execute-despite-data-unavailability=true:
      ComBasedSafetyDataTransformation_PROFILE_11A: transformer-chain=[COM_Transformer, E2E_Transformer_PROFILE_11A]
      ComBasedSafetyDataTransformation_PROFILE_GM_{01..04}: transformer-chain=COM_Transformer
    transformation technology E2E_Transformer_PROFILE_11A:
      buffer-properties={buffer-computation={lower-limit=0, upper-limit=0}, header-length=0, in-place=true}
      has-internal-state=true
      needs-original-data=false
      protocol=E2E
      end-to-end-transformation-description{clear-from-valid-to-invalid=false, counter-offset=8, crc-offset=0, data-id-mode=ALL-16-BIT, max-delta-counter=1, max-error-state-init=1, max-error-state-invalid=1, max-error-state-valid=1, min-ok-state-init=1, min-ok-state-invalid=2, min-ok-state-valid=1, offset=0, profile-name=PROFILE_11, upper-header-bits-to-shift=0, window-size-init=2, window-size-invalid=3, window-size-valid=3}
      transformer-class=SAFETY
      version=1.0.0
package /Communication/NMTP/DiagnosticConnections
  diagnostic connection DC_TT2_USDT_Req_From_TT2_To_EBCM_ETH_BCAN_On_BCAN_Cluster: functional-request=USDT_Req_From_TT2_To_AllNodes_AllNetworks_On_BCAN_Cluster, periodic-response-uudt=UUDT_Rsp_From_EBCM_ETH_BCAN_To_TT2_On_BCAN_Cluster_PDU_Triggering, physical-request=USDT_Req_From_TT2_To_EBCM_ETH_BCAN_On_BCAN_Cluster, response-on-event=USDT_Rsp_From_EBCM_ETH_BCAN_To_TT2_On_BCAN_Cluster, response=USDT_Rsp_From_EBCM_ETH_BCAN_To_TT2_On_BCAN_Cluster
package /Communication/NMTP/PDUs/DCM_PDUPkg/BCAN_PDUPkg
  dcm i pdu USDT_Req_From_TT2_To_AllNodes_AllNetworks_On_BCAN_Cluster: length=7, diag-pdu-type=DIAG-REQUEST
  dcm i pdu USDT_Req_From_TT2_To_EBCM_ETH_BCAN_On_BCAN_Cluster: length=4095, diag-pdu-type=DIAG-REQUEST
  dcm i pdu USDT_Rsp_From_EBCM_ETH_BCAN_To_TT2_On_BCAN_Cluster: length=4095, diag-pdu-type=DIAG-RESPONSE
package /Communication/NMTP/PDUs/DCM_PDUPkg/InVehicle_PDUPkg
  dcm i pdu OBD_Req_From_TT8_ZEV_To_AllOBDNodes_AllNetworks_On_InVehicleIP_connector: category=OBD_ZEV, length=7, diag-pdu-type=DIAG-REQUEST
  dcm i pdu OBD_Req_From_TT8_ZEV_To_EBCM_ETH_Eth2_On_InVehicleIP_connector: category=OBD_ZEV, length=4095, diag-pdu-type=DIAG-REQUEST
  dcm i pdu OBD_Rsp_From_EBCM_ETH_Eth2_InVehicleIP_To_TT8_ZEV_On_InVehicleIP_connector: category=OBD_ZEV, length=8185, diag-pdu-type=DIAG-RESPONSE
  dcm i pdu USDT_Req_From_TT1_To_AllNodes_AllNetworks_On_InVehicleIP_connector: category=DoSoAD, length=7, diag-pdu-type=DIAG-REQUEST
  dcm i pdu USDT_Req_From_TT1_To_EBCM_ETH_Eth2_On_InVehicleIP_connector: category=DoSoAD, length=4095, diag-pdu-type=DIAG-REQUEST
  dcm i pdu USDT_Req_From_TT3_To_AllNodes_AllNetworks_On_InVehicleIP_connector: category=DoSoAD, length=7, diag-pdu-type=DIAG-REQUEST
  dcm i pdu USDT_Req_From_TT3_To_EBCM_ETH_Eth2_On_InVehicleIP_connector: category=DoSoAD, length=4095, diag-pdu-type=DIAG-REQUEST
  dcm i pdu USDT_Req_From_TT4_To_AllNodes_AllNetworks_On_InVehicleIP_connector: category=DoSoAD, length=7, diag-pdu-type=DIAG-REQUEST
  dcm i pdu USDT_Req_From_TT4_To_EBCM_ETH_Eth2_On_InVehicleIP_connector: category=DoSoAD, length=4095, diag-pdu-type=DIAG-REQUEST
  dcm i pdu USDT_Req_From_TT5_To_AllNodes_AllNetworks_On_InVehicleIP_connector: category=DoSoAD, length=7, diag-pdu-type=DIAG-REQUEST
  dcm i pdu USDT_Req_From_TT5_To_EBCM_ETH_Eth1_On_InVehicleIP_connector: category=DoSoAD, length=4095, diag-pdu-type=DIAG-REQUEST
  dcm i pdu USDT_Req_From_TT8_To_AllNodes_AllNetworks_On_InVehicleIP_connector: category=DoSoAD, length=7, diag-pdu-type=DIAG-REQUEST
  dcm i pdu USDT_Req_From_TT8_To_EBCM_ETH_Eth2_On_InVehicleIP_connector: category=DoSoAD, length=4095, diag-pdu-type=DIAG-REQUEST
  dcm i pdu USDT_Rsp_From_EBCM_ETH_Eth1_InVehicleIP_To_TT5_On_InVehicleIP_connector: category=DoSoAD, length=65527, diag-pdu-type=DIAG-RESPONSE
  dcm i pdu USDT_Rsp_From_EBCM_ETH_Eth2_InVehicleIP_To_TT1_On_InVehicleIP_connector: category=DoSoAD, length=4095, diag-pdu-type=DIAG-RESPONSE
  dcm i pdu USDT_Rsp_From_EBCM_ETH_Eth2_InVehicleIP_To_TT3_On_InVehicleIP_connector: category=DoSoAD, length=65527, diag-pdu-type=DIAG-RESPONSE
  dcm i pdu USDT_Rsp_From_EBCM_ETH_Eth2_InVehicleIP_To_TT4_On_InVehicleIP_connector: category=DoSoAD, length=65527, diag-pdu-type=DIAG-RESPONSE
  dcm i pdu USDT_Rsp_From_EBCM_ETH_Eth2_InVehicleIP_To_TT8_On_InVehicleIP_connector: category=DoSoAD, length=65527, diag-pdu-type=DIAG-RESPONSE
  dcm i pdu UUDT_Rsp_From_EBCM_ETH_Eth1_InVehicleIP_To_TT5_On_InVehicleIP_connector: category=DoSoAD, length=1448, diag-pdu-type=DIAG-RESPONSE
  dcm i pdu UUDT_Rsp_From_EBCM_ETH_Eth2_InVehicleIP_To_TT1_On_InVehicleIP_connector: category=DoSoAD, length=1448, diag-pdu-type=DIAG-RESPONSE
  dcm i pdu UUDT_Rsp_From_EBCM_ETH_Eth2_InVehicleIP_To_TT3_On_InVehicleIP_connector: category=DoSoAD, length=1448, diag-pdu-type=DIAG-RESPONSE
  dcm i pdu UUDT_Rsp_From_EBCM_ETH_Eth2_InVehicleIP_To_TT4_On_InVehicleIP_connector: category=DoSoAD, length=1448, diag-pdu-type=DIAG-RESPONSE
  dcm i pdu UUDT_Rsp_From_EBCM_ETH_Eth2_InVehicleIP_To_TT8_On_InVehicleIP_connector: category=DoSoAD, length=1448, diag-pdu-type=DIAG-RESPONSE
package /Communication/NMTP/TP
  can tp config BCAN_Cluster: communication-cluster=BCAN_Cluster, can-tp-ecu=EBCM_ETH
    can tp channel TestTool2_TPChannel: channel-id=149, channel-mode=FULL-DUPLEX-MODE
    can tp channel TestTool2_TPChannel_Func: channel-id=148, channel-mode=FULL-DUPLEX-MODE
    can-tp-connection addressing-format=NORMALFIXED, can-tp-channel=TestTool2_TPChannel_Func, data-pdu=USDT_Req_From_TT2_To_AllNodes_AllNetworks_On_BCAN_Cluster_Tp, padding-activation=true, receiver=[EBCM_ETH_BCAN_connector, SBM_BCAN_connector], ta-type=FUNCTIONAL, timeout-br=0.1, timeout-bs=0.25, timeout-cr=0.25, timeout-cs=0.1, tp-sdu=USDT_Req_From_TT2_To_AllNodes_AllNetworks_On_BCAN_Cluster, transmitter=TestTool2_BCAN_connector:
      ident USDT_Req_From_TT2_To_AllNodes_AllNetworks_On_BCAN_Cluster
    can-tp-connection addressing-format=NORMALFIXED, can-tp-channel=TestTool2_TPChannel, data-pdu=USDT_Req_From_TT2_To_EBCM_ETH_BCAN_On_BCAN_Cluster_Tp, flow-control-pdu=USDT_Rsp_From_EBCM_ETH_BCAN_To_TT2_On_BCAN_Cluster_Tp, padding-activation=true, receiver=EBCM_ETH_BCAN_connector, ta-type=PHYSICAL, timeout-br=0.1, timeout-bs=0.25, timeout-cr=0.25, timeout-cs=0.1, tp-sdu=USDT_Req_From_TT2_To_EBCM_ETH_BCAN_On_BCAN_Cluster, transmitter=TestTool2_BCAN_connector:
      ident USDT_Req_From_TT2_To_EBCM_ETH_BCAN_On_BCAN_Cluster
    can-tp-connection addressing-format=NORMALFIXED, can-tp-channel=TestTool2_TPChannel, data-pdu=USDT_Rsp_From_EBCM_ETH_BCAN_To_TT2_On_BCAN_Cluster_Tp, flow-control-pdu=USDT_Req_From_TT2_To_EBCM_ETH_BCAN_On_BCAN_Cluster_Tp, padding-activation=true, receiver=TestTool2_BCAN_connector, ta-type=PHYSICAL, timeout-br=0.1, timeout-bs=0.25, timeout-cr=0.25, timeout-cs=0.1, tp-sdu=USDT_Rsp_From_EBCM_ETH_BCAN_To_TT2_On_BCAN_Cluster, transmitter=EBCM_ETH_BCAN_connector:
      ident USDT_Rsp_From_EBCM_ETH_BCAN_To_TT2_On_BCAN_Cluster
    can tp node EBCM_ETH_BCAN_connector: connector=EBCM_ETH_BCAN_connector, max-fc-wait=0, st-min=0.0, timeout-ar=0.25, timeout-as=0.25
    can tp node SBM_BCAN_connector: max-fc-wait=0, st-min=0.0, timeout-ar=0.25, timeout-as=0.25
    can tp node TestTool2_BCAN_connector: max-fc-wait=0, st-min=0.0, timeout-ar=0.25, timeout-as=0.25
package /Communication/PDU_Groups_Package/BCAN_Package
  i signal i pdu group BCAN_Package_EBCM_ETH_BCAN_IN: communication-direction=IN, i-signal-i-pdus=[SrlDat638_PDU, SrlDat639_PDU, SrlDat673_PDU, SrlDat674_PDU]
  i signal i pdu group BCAN_Package_EBCM_ETH_BCAN_OUT: communication-direction=OUT, i-signal-i-pdus=[SrlDat636_PDU, SrlDat637_PDU, SrlDat675_PDU]
package /Communication/SocketConnectionIPDUIdentifierPackage/Identifier_Eth_v52
  socket connection ipdu identifier set Identifier_Eth_v52
    23 x so con i pdu identifier:
      OBD_Req_From_TT8_ZEV_To_AllOBDNodes_AllNetworks_To_EBCM_ETH_Eth2_On_InVehicleIP_connector_SoAD_ID: header-id=234938368, pdu-triggering=OBD_Req_From_TT8_ZEV_To_AllOBDNodes_AllNetworks_On_InVehicleIP_connector_PDU_Triggering
      OBD_Req_From_TT8_ZEV_To_EBCM_ETH_Eth2_On_InVehicleIP_connector_SoAD_ID: header-id=234884140, pdu-triggering=OBD_Req_From_TT8_ZEV_To_EBCM_ETH_Eth2_On_InVehicleIP_connector_PDU_Triggering
      OBD_Rsp_From_EBCM_ETH_Eth2_InVehicleIP_To_TT8_ZEV_On_InVehicleIP_connector_SoAD_ID: header-id=204213760, pdu-triggering=OBD_Rsp_From_EBCM_ETH_Eth2_InVehicleIP_To_TT8_ZEV_On_InVehicleIP_connector_PDU_Triggering
      USDT_Req_From_TT1_To_AllNodes_AllNetworks_To_EBCM_ETH_Eth2_On_InVehicleIP_connector_SoAD_ID: header-id=250736638, pdu-triggering=USDT_Req_From_TT1_To_AllNodes_AllNetworks_On_InVehicleIP_connector_PDU_Triggering
      USDT_Req_From_TT1_To_EBCM_ETH_Eth2_On_InVehicleIP_connector_SoAD_ID: header-id=250678316, pdu-triggering=USDT_Req_From_TT1_To_EBCM_ETH_Eth2_On_InVehicleIP_connector_PDU_Triggering
      USDT_Req_From_TT3_To_AllNodes_AllNetworks_To_EBCM_ETH_Eth2_On_InVehicleIP_connector_SoAD_ID: header-id=254865406, pdu-triggering=USDT_Req_From_TT3_To_AllNodes_AllNetworks_On_InVehicleIP_connector_PDU_Triggering
      USDT_Req_From_TT3_To_EBCM_ETH_Eth2_On_InVehicleIP_connector_SoAD_ID: header-id=254807084, pdu-triggering=USDT_Req_From_TT3_To_EBCM_ETH_Eth2_On_InVehicleIP_connector_PDU_Triggering
      USDT_Req_From_TT4_To_AllNodes_AllNetworks_To_EBCM_ETH_Eth2_On_InVehicleIP_connector_SoAD_ID: header-id=255913982, pdu-triggering=USDT_Req_From_TT4_To_AllNodes_AllNetworks_On_InVehicleIP_connector_PDU_Triggering
      USDT_Req_From_TT4_To_EBCM_ETH_Eth2_On_InVehicleIP_connector_SoAD_ID: header-id=255855660, pdu-triggering=USDT_Req_From_TT4_To_EBCM_ETH_Eth2_On_InVehicleIP_connector_PDU_Triggering
      USDT_Req_From_TT5_To_AllNodes_AllNetworks_To_EBCM_ETH_Eth1_On_InVehicleIP_connector_SoAD_ID: header-id=256962558, pdu-triggering=USDT_Req_From_TT5_To_AllNodes_AllNetworks_On_InVehicleIP_connector_PDU_Triggering
      USDT_Req_From_TT5_To_EBCM_ETH_Eth1_On_InVehicleIP_connector_SoAD_ID: header-id=256904236, pdu-triggering=USDT_Req_From_TT5_To_EBCM_ETH_Eth1_On_InVehicleIP_connector_PDU_Triggering
      USDT_Req_From_TT8_To_AllNodes_AllNetworks_To_EBCM_ETH_Eth2_On_InVehicleIP_connector_SoAD_ID: header-id=243331070, pdu-triggering=USDT_Req_From_TT8_To_AllNodes_AllNetworks_On_InVehicleIP_connector_PDU_Triggering
      USDT_Req_From_TT8_To_EBCM_ETH_Eth2_On_InVehicleIP_connector_SoAD_ID: header-id=243272748, pdu-triggering=USDT_Req_From_TT8_To_EBCM_ETH_Eth2_On_InVehicleIP_connector_PDU_Triggering
      USDT_Rsp_From_EBCM_ETH_Eth1_InVehicleIP_To_TT5_On_InVehicleIP_connector_SoAD_ID: header-id=204214096, pdu-triggering=USDT_Rsp_From_EBCM_ETH_Eth1_InVehicleIP_To_TT5_On_InVehicleIP_connector_PDU_Triggering
      USDT_Rsp_From_EBCM_ETH_Eth2_InVehicleIP_To_TT1_On_InVehicleIP_connector_SoAD_ID: header-id=204214001, pdu-triggering=USDT_Rsp_From_EBCM_ETH_Eth2_InVehicleIP_To_TT1_On_InVehicleIP_connector_PDU_Triggering
      USDT_Rsp_From_EBCM_ETH_Eth2_InVehicleIP_To_TT3_On_InVehicleIP_connector_SoAD_ID: header-id=204214064, pdu-triggering=USDT_Rsp_From_EBCM_ETH_Eth2_InVehicleIP_To_TT3_On_InVehicleIP_connector_PDU_Triggering
      USDT_Rsp_From_EBCM_ETH_Eth2_InVehicleIP_To_TT4_On_InVehicleIP_connector_SoAD_ID: header-id=204214080, pdu-triggering=USDT_Rsp_From_EBCM_ETH_Eth2_InVehicleIP_To_TT4_On_InVehicleIP_connector_PDU_Triggering
      USDT_Rsp_From_EBCM_ETH_Eth2_InVehicleIP_To_TT8_On_InVehicleIP_connector_SoAD_ID: header-id=204213888, pdu-triggering=USDT_Rsp_From_EBCM_ETH_Eth2_InVehicleIP_To_TT8_On_InVehicleIP_connector_PDU_Triggering
      UUDT_Rsp_From_EBCM_ETH_Eth1_InVehicleIP_To_TT5_On_InVehicleIP_connector_SoAD_ID: header-id=472649552, pdu-triggering=UUDT_Rsp_From_EBCM_ETH_Eth1_InVehicleIP_To_TT5_On_InVehicleIP_connector_PDU_Triggering
      UUDT_Rsp_From_EBCM_ETH_Eth2_InVehicleIP_To_TT1_On_InVehicleIP_connector_SoAD_ID: header-id=472649457, pdu-triggering=UUDT_Rsp_From_EBCM_ETH_Eth2_InVehicleIP_To_TT1_On_InVehicleIP_connector_PDU_Triggering
      UUDT_Rsp_From_EBCM_ETH_Eth2_InVehicleIP_To_TT3_On_InVehicleIP_connector_SoAD_ID: header-id=472649520, pdu-triggering=UUDT_Rsp_From_EBCM_ETH_Eth2_InVehicleIP_To_TT3_On_InVehicleIP_connector_PDU_Triggering
      UUDT_Rsp_From_EBCM_ETH_Eth2_InVehicleIP_To_TT4_On_InVehicleIP_connector_SoAD_ID: header-id=472649536, pdu-triggering=UUDT_Rsp_From_EBCM_ETH_Eth2_InVehicleIP_To_TT4_On_InVehicleIP_connector_PDU_Triggering
      UUDT_Rsp_From_EBCM_ETH_Eth2_InVehicleIP_To_TT8_On_InVehicleIP_connector_SoAD_ID: header-id=472649344, pdu-triggering=UUDT_Rsp_From_EBCM_ETH_Eth2_InVehicleIP_To_TT8_On_InVehicleIP_connector_PDU_Triggering
package /Communication/TimeSynchronizationPackage
  8 x global time domain, all with category=SYNCHRONIZED, domain-id=0, sync-loss-timeout=1.0:
    CAN_Global_Time_Domain_CAN_{1..5}: debounce-time=0.0, follow-up-timeout-value=0.0
    CAN_Global_Time_Domain_CAN_8: debounce-time=0.0, follow-up-timeout-value=0.0
    Ethernet_Global_Time_Domain_Ethernet_1: debounce-time=0.0, follow-up-timeout-value=0.0, global-time-domain-propertys=eth-global-time-domain-props=message-compliance=IEEE802-1AS
      global-time-sub-domains:
        CAN_Global_Time_Domain_CAN_{1..5}
        CAN_Global_Time_Domain_CAN_8
      global time eth slave Global_Time_Ethernet_Follower_EBCM_ETH: communication-connector=EBCM_ETH_Eth_TimeSyncUntagged_1, follow-up-timeout-value=0.0, crc-validated=CRC-IGNORED
    Global_Time_Domain: global-time-sub-domains=Ethernet_Global_Time_Domain_Ethernet_1
package /PortInterfaces
  data type mapping set EBCM_ETH_DataTypeMappingSet
    data-type-maps:
      application-data-type=AppBoolean, implementation-data-type=ImpBoolean
      application-data-type=AppEnum, implementation-data-type=ImpEnum
      application-data-type=AppSint16, implementation-data-type=ImpSint16
      application-data-type=ApplicationTypes/AppUint16, implementation-data-type=ImplementationTypes/ImpUint16
      application-data-type=AppUint64, implementation-data-type=ImpUint64
      application-data-type=ApplicationTypes/AppUint8, implementation-data-type=ImplementationTypes/ImpUint8
      application-data-type=SrlDat{636..639}, implementation-data-type=SrlDat{636..639}
      application-data-type=SrlDat{673..675}, implementation-data-type=SrlDat{673..675}
  data type mapping set SystemDataTypeMappingSets
    data-type-maps:
      application-data-type=AppUint32, implementation-data-type=TYPES_Library/ImpUint32
      application-data-type=ApplicationDataTypes/AppUint8, implementation-data-type=TYPES_Library/ImpUint8
      application-data-type=ApplicationDataTypes/AppUint16, implementation-data-type=TYPES_Library/ImpUint16
      application-data-type=AppDataType/ProfileRequestPayLoadDataType_SvcAppStruct, implementation-data-type=ImpDataType/ProfileRequestPayLoadDataType_SvcStruct
      application-data-type=AppDataType/ProfileRequestDataType_SvcAppStruct, implementation-data-type=ImpDataType/ProfileRequestDataType_SvcStruct
      application-data-type=AppDataType/RequestStatusProfileStatePayLoadDataType_SvcAppStruct, implementation-data-type=ImpDataType/RequestStatusProfileStatePayLoadDataType_SvcStruct
      application-data-type=AppDataType/RequestStatusProfileStateDataType_SvcAppStruct, implementation-data-type=ImpDataType/RequestStatusProfileStateDataType_SvcStruct
      application-data-type=MechatronicsT1S_Eth2_SwMgrInfoRx_Evt_EventAppType, implementation-data-type=MechatronicsT1S_Eth2_SwMgrInfoRx_Evt_EventImpType
      application-data-type=hcSVC_CnsldtnSecEBST_evt_YeBACR_e_eBstActrModeRfS_TeBARR_e_ActrMode_SvcAppEnum, implementation-data-type=hcSVC_CnsldtnSecEBST_evt_YeBACR_e_eBstActrModeRfS_TeBARR_e_ActrMode_SvcEnum
      application-data-type=TbBOOLEAN, implementation-data-type=TbBOOLEAN
      application-data-type=T_v_MetersPerSec, implementation-data-type=T_v_MetersPerSec
      application-data-type=T_p_bar, implementation-data-type=T_p_bar
      application-data-type=hcSVC_CnsldtnSecEBST_evt_YeBACR_e_eBstActrModeLfS_TeBARR_e_ActrMode_SvcAppEnum, implementation-data-type=hcSVC_CnsldtnSecEBST_evt_YeBACR_e_eBstActrModeLfS_TeBARR_e_ActrMode_SvcEnum
      application-data-type=T_a_MetersPerSec2, implementation-data-type=T_a_MetersPerSec2
      application-data-type=T_Pct_Percent, implementation-data-type=T_Pct_Percent
      application-data-type=T_M_NewtonMeters, implementation-data-type=T_M_NewtonMeters
      application-data-type=hcSVC_CnsldtnSecEBST_evt_YeBACR_e_eBstActrModeLrS_TeBARR_e_ActrMode_SvcAppEnum, implementation-data-type=hcSVC_CnsldtnSecEBST_evt_YeBACR_e_eBstActrModeLrS_TeBARR_e_ActrMode_SvcEnum
      application-data-type=hcSVC_CnsldtnSecEBST_evt_VeBACR_e_eBstBrkSysPwrModeS_TeBCSR_e_BrkSysPwrMode_SvcAppEnum, implementation-data-type=hcSVC_CnsldtnSecEBST_evt_VeBACR_e_eBstBrkSysPwrModeS_TeBCSR_e_BrkSysPwrMode_SvcEnum
      application-data-type=hcSVC_CnsldtnSecEBST_evt_YeBACR_e_eBstBrkCmdTypeLrS_TeBARR_e_BrkCmdTyp_SvcAppEnum, implementation-data-type=hcSVC_CnsldtnSecEBST_evt_YeBACR_e_eBstBrkCmdTypeLrS_TeBARR_e_BrkCmdTyp_SvcEnum
      application-data-type=hcSVC_CnsldtnSecEBST_evt_YeBACR_e_eBstActrModeRrS_TeBARR_e_ActrMode_SvcAppEnum, implementation-data-type=hcSVC_CnsldtnSecEBST_evt_YeBACR_e_eBstActrModeRrS_TeBARR_e_ActrMode_SvcEnum
      application-data-type=hcSVC_CnsldtnSecEBST_evt_VeBACR_e_eBstEPB_CmdS_TePBKR_e_ApplyReleaseReq_SvcAppEnum, implementation-data-type=hcSVC_CnsldtnSecEBST_evt_VeBACR_e_eBstEPB_CmdS_TePBKR_e_ApplyReleaseReq_SvcEnum
      application-data-type=T_T_Celsius, implementation-data-type=T_T_Celsius
      application-data-type=T_I_Amps, implementation-data-type=T_I_Amps
      application-data-type=T_F_Newtons, implementation-data-type=T_F_Newtons
      application-data-type=hcSVC_CnsldtnSecEBST_evt_YeBACR_e_eBstBrkCmdTypeLfS_TeBARR_e_BrkCmdTyp_SvcAppEnum, implementation-data-type=hcSVC_CnsldtnSecEBST_evt_YeBACR_e_eBstBrkCmdTypeLfS_TeBARR_e_BrkCmdTyp_SvcEnum
      application-data-type=T_l_Kilometers, implementation-data-type=T_l_Kilometers
      application-data-type=hcSVC_CnsldtnSecEBST_evt_YeBACR_e_eBstBrkCmdTypeRrS_TeBARR_e_BrkCmdTyp_SvcAppEnum, implementation-data-type=hcSVC_CnsldtnSecEBST_evt_YeBACR_e_eBstBrkCmdTypeRrS_TeBARR_e_BrkCmdTyp_SvcEnum
      application-data-type=T_phi_Rad, implementation-data-type=T_phi_Rad
      application-data-type=hcSVC_CnsldtnSecEBST_evt_YeBACR_e_eBstHydFuncStCmdS_TeBRMR_e_EBCM_eBstSt_SvcAppEnum, implementation-data-type=hcSVC_CnsldtnSecEBST_evt_YeBACR_e_eBstHydFuncStCmdS_TeBRMR_e_EBCM_eBstSt_SvcEnum
      application-data-type=hcSVC_CnsldtnSecEBST_evt_YeBACR_e_eBstBrkCmdTypeRfS_TeBARR_e_BrkCmdTyp_SvcAppEnum, implementation-data-type=hcSVC_CnsldtnSecEBST_evt_YeBACR_e_eBstBrkCmdTypeRfS_TeBARR_e_BrkCmdTyp_SvcEnum
      application-data-type=hcSVC_CnsldtnSecEBST_evt_VeBACR_e_eBstTransLvrPstnS_TeTRGR_e_TrnLeverPstn_SvcAppEnum, implementation-data-type=hcSVC_CnsldtnSecEBST_evt_VeBACR_e_eBstTransLvrPstnS_TeTRGR_e_TrnLeverPstn_SvcEnum
      application-data-type=hcSVC_CnsldtnSecEBST_evt_VeBACR_e_eBstPriPwrModeS_TeVSM_e_SystemPowerMode_SvcAppEnum, implementation-data-type=hcSVC_CnsldtnSecEBST_evt_VeBACR_e_eBstPriPwrModeS_TeVSM_e_SystemPowerMode_SvcEnum
      application-data-type=BYTE, implementation-data-type=BYTE
      application-data-type=hcSVC_CnsldtnSecEBST_evt_VeBACR_e_eBstBkupPwrModeS_TeVSM_e_SystemPowerMode_SvcAppEnum, implementation-data-type=hcSVC_CnsldtnSecEBST_evt_VeBACR_e_eBstBkupPwrModeS_TeVSM_e_SystemPowerMode_SvcEnum
      application-data-type=T_KPH_UW_07, implementation-data-type=T_KPH_UW_07
      application-data-type=T_V_Millimeters3, implementation-data-type=T_V_Millimeters3
      application-data-type=hcSVC_CnsldtnSecEBST_evt_YeBACR_e_eBstBrkOprtnRqstS_TeBCSR_e_CCU_BrkOprtnRqst_SvcAppEnum, implementation-data-type=hcSVC_CnsldtnSecEBST_evt_YeBACR_e_eBstBrkOprtnRqstS_TeBCSR_e_CCU_BrkOprtnRqst_SvcEnum
      application-data-type=LONGWORD, implementation-data-type=LONGWORD
      application-data-type=hcSVC_CnsldtnSecEBST_evt_VeBACR_e_eBstRplnshTriggerS_TeBARR_e_RplnshTrigger_SvcAppEnum, implementation-data-type=hcSVC_CnsldtnSecEBST_evt_VeBACR_e_eBstRplnshTriggerS_TeBARR_e_RplnshTrigger_SvcEnum
      application-data-type=T_m_Kilograms, implementation-data-type=T_m_Kilograms
      application-data-type=T_l_Meters, implementation-data-type=T_l_Meters
      application-data-type=hcSVC_CnsldtnSecEBST_evt_VeBACR_e_PrimDiagStReqS_TeBACR_e_DiagStSts_SvcAppEnum, implementation-data-type=hcSVC_CnsldtnSecEBST_evt_VeBACR_e_PrimDiagStReqS_TeBACR_e_DiagStSts_SvcEnum
      application-data-type=hcSVC_CnsldtnSecEBST_evt_DeBACR_e_eBstLV_LdPrioLvlS_TeLVDR_e_LV_LdPrioLvl_SvcAppEnum, implementation-data-type=hcSVC_CnsldtnSecEBST_evt_DeBACR_e_eBstLV_LdPrioLvlS_TeLVDR_e_LV_LdPrioLvl_SvcEnum
      application-data-type=hcSVC_CnsldtnSecEBST_evt_EventAppType, implementation-data-type=hcSVC_CnsldtnSecEBST_evt_EventImpType
      application-data-type=MechatronicsT1S_Eth2_PwrMgrHeartbeatTx_Evt_EventAppType, implementation-data-type=MechatronicsT1S_Eth2_PwrMgrHeartbeatTx_Evt_EventImpType
      application-data-type=MechatronicsT1S_Eth2_PwrMgrWakeupTx_Evt_EventAppType, implementation-data-type=MechatronicsT1S_Eth2_PwrMgrWakeupTx_Evt_EventImpType
      application-data-type=AppDataType/ProfileRequestPayLoadDataType_SvcAppStruct, implementation-data-type=ImpDataType/ProfileRequestPayLoadDataType_SvcStruct
      application-data-type=AppDataType/ProfileRequestDataType_SvcAppStruct, implementation-data-type=ImpDataType/ProfileRequestDataType_SvcStruct
      application-data-type=AppDataType/RequestStatusProfileStatePayLoadDataType_SvcAppStruct, implementation-data-type=ImpDataType/RequestStatusProfileStatePayLoadDataType_SvcStruct
      application-data-type=AppDataType/RequestStatusProfileStateDataType_SvcAppStruct, implementation-data-type=ImpDataType/RequestStatusProfileStateDataType_SvcStruct
      application-data-type=MechatronicsT1S_Eth2_SwMgrInfoTx_Evt_EventAppType, implementation-data-type=MechatronicsT1S_Eth2_SwMgrInfoTx_Evt_EventImpType
      application-data-type=T_COUNT_WORD, implementation-data-type=T_COUNT_WORD
      application-data-type=T_COUNT_BYTE, implementation-data-type=T_COUNT_BYTE
      application-data-type=T_COUNT_LONG, implementation-data-type=T_COUNT_LONG
      application-data-type=hSVC_eBstActrSec_evt_VeBACR_e_eBstEPB_StateLtS_TeBACR_e_EPB_State_SvcAppEnum, implementation-data-type=hSVC_eBstActrSec_evt_VeBACR_e_eBstEPB_StateLtS_TeBACR_e_EPB_State_SvcEnum
      application-data-type=hSVC_eBstActrSec_evt_VeBACR_e_eBstEPB_AchModeLtS_TeBACR_e_EPB_AchMode_SvcAppEnum, implementation-data-type=hSVC_eBstActrSec_evt_VeBACR_e_eBstEPB_AchModeLtS_TeBACR_e_EPB_AchMode_SvcEnum
      application-data-type=WORD, implementation-data-type=WORD
      application-data-type=T_l_Millimeters, implementation-data-type=T_l_Millimeters
      application-data-type=hSVC_eBstActrSec_evt_VeBACR_e_eBstEPB_StateRtS_TeBACR_e_EPB_State_SvcAppEnum, implementation-data-type=hSVC_eBstActrSec_evt_VeBACR_e_eBstEPB_StateRtS_TeBACR_e_EPB_State_SvcEnum
      application-data-type=hSVC_eBstActrSec_evt_VeBACR_e_eBstMC_StsS_TeBACR_e_VldTrvlSnsrs_SvcAppEnum, implementation-data-type=hSVC_eBstActrSec_evt_VeBACR_e_eBstMC_StsS_TeBACR_e_VldTrvlSnsrs_SvcEnum
      application-data-type=hSVC_eBstActrSec_evt_YeBACR_e_eBstEBOS_EBCMStateS_TeBACR_e_EBOS_EBCM_State_SvcAppEnum, implementation-data-type=hSVC_eBstActrSec_evt_YeBACR_e_eBstEBOS_EBCMStateS_TeBACR_e_EBOS_EBCM_State_SvcEnum
      application-data-type=hSVC_eBstActrSec_evt_VeBACR_e_eBstIntrSelfTstStsS_TeBACR_e_IntrSelfTstSts_SvcAppEnum, implementation-data-type=hSVC_eBstActrSec_evt_VeBACR_e_eBstIntrSelfTstStsS_TeBACR_e_IntrSelfTstSts_SvcEnum
      application-data-type=hSVC_eBstActrSec_evt_VeBACR_e_eBstFluidLvlRawS_TeBACR_e_BrkFluidLvl_SvcAppEnum, implementation-data-type=hSVC_eBstActrSec_evt_VeBACR_e_eBstFluidLvlRawS_TeBACR_e_BrkFluidLvl_SvcEnum
      application-data-type=hSVC_eBstActrSec_evt_VeBACR_e_eBstPlngrPosnStsS_TeBPRR_e_ActPosnSts_SvcAppEnum, implementation-data-type=hSVC_eBstActrSec_evt_VeBACR_e_eBstPlngrPosnStsS_TeBPRR_e_ActPosnSts_SvcEnum
      application-data-type=hSVC_eBstActrSec_evt_VeBACR_e_eBstEPB_AchModeRtS_TeBACR_e_EPB_AchMode_SvcAppEnum, implementation-data-type=hSVC_eBstActrSec_evt_VeBACR_e_eBstEPB_AchModeRtS_TeBACR_e_EPB_AchMode_SvcEnum
      application-data-type=T_U_Volts, implementation-data-type=T_U_Volts
      application-data-type=hSVC_eBstActrSec_evt_VeBACR_e_eBstRplnshStsS_TeBACR_e_RplnshSts_SvcAppEnum, implementation-data-type=hSVC_eBstActrSec_evt_VeBACR_e_eBstRplnshStsS_TeBACR_e_RplnshSts_SvcEnum
      application-data-type=hSVC_eBstActrSec_evt_VeBACR_e_eBstVDA_PbcHPO_ReqS_TeBACR_e_VDA_PbcHPO_Req_SvcAppEnum, implementation-data-type=hSVC_eBstActrSec_evt_VeBACR_e_eBstVDA_PbcHPO_ReqS_TeBACR_e_VDA_PbcHPO_Req_SvcEnum
      application-data-type=hSVC_eBstActrSec_evt_VeBACR_e_eBstHydFuncStS_TeBACR_e_eBstHydState_SvcAppEnum, implementation-data-type=hSVC_eBstActrSec_evt_VeBACR_e_eBstHydFuncStS_TeBACR_e_eBstHydState_SvcEnum
      application-data-type=hSVC_eBstActrSec_evt_VeBACR_e_SbmPrimDiagStStsS_TeBACR_e_SbmDiagStSts_SvcAppEnum, implementation-data-type=hSVC_eBstActrSec_evt_VeBACR_e_SbmPrimDiagStStsS_TeBACR_e_SbmDiagStSts_SvcEnum
      application-data-type=hSVC_eBstActrSec_evt_VeBACR_e_eBstWhlCntrlStsLfS_TeBACR_e_WhlCntrlSts_SvcAppEnum, implementation-data-type=hSVC_eBstActrSec_evt_VeBACR_e_eBstWhlCntrlStsLfS_TeBACR_e_WhlCntrlSts_SvcEnum
      application-data-type=hSVC_eBstActrSec_evt_YeBACR_e_eBstEPB_StatusRtS_TeBACR_e_EPB_Status_SvcAppEnum, implementation-data-type=hSVC_eBstActrSec_evt_YeBACR_e_eBstEPB_StatusRtS_TeBACR_e_EPB_Status_SvcEnum
      application-data-type=hSVC_eBstActrSec_evt_VeBACR_e_eBstWhlCntrlStsRrS_TeBACR_e_WhlCntrlSts_SvcAppEnum, implementation-data-type=hSVC_eBstActrSec_evt_VeBACR_e_eBstWhlCntrlStsRrS_TeBACR_e_WhlCntrlSts_SvcEnum
      application-data-type=hSVC_eBstActrSec_evt_VeBACR_e_eBstWhlCntrlStsLrS_TeBACR_e_WhlCntrlSts_SvcAppEnum, implementation-data-type=hSVC_eBstActrSec_evt_VeBACR_e_eBstWhlCntrlStsLrS_TeBACR_e_WhlCntrlSts_SvcEnum
      application-data-type=hSVC_eBstActrSec_evt_VeBACR_e_eBstWhlCntrlStsRfS_TeBACR_e_WhlCntrlSts_SvcAppEnum, implementation-data-type=hSVC_eBstActrSec_evt_VeBACR_e_eBstWhlCntrlStsRfS_TeBACR_e_WhlCntrlSts_SvcEnum
      application-data-type=hSVC_eBstActrSec_evt_YeBACR_e_eBstEPB_StatusLtS_TeBACR_e_EPB_Status_SvcAppEnum, implementation-data-type=hSVC_eBstActrSec_evt_YeBACR_e_eBstEPB_StatusLtS_TeBACR_e_EPB_Status_SvcEnum
      application-data-type=hSVC_eBstActrSec_evt_VeBACR_e_PrimDiagStStsS_TeBACR_e_DiagStSts_SvcAppEnum, implementation-data-type=hSVC_eBstActrSec_evt_VeBACR_e_PrimDiagStStsS_TeBACR_e_DiagStSts_SvcEnum
      application-data-type=hSVC_eBstActrSec_evt_VeBACR_e_eBstPCanCommStsS_TeBACR_e_PCanCommSts_SvcAppEnum, implementation-data-type=hSVC_eBstActrSec_evt_VeBACR_e_eBstPCanCommStsS_TeBACR_e_PCanCommSts_SvcEnum
      application-data-type=hSVC_eBstActrSec_evt_EventAppType, implementation-data-type=hSVC_eBstActrSec_evt_EventImpType
      application-data-type=PwrMgrMulti_PwrMgrHeartbeatRx_Evt_EventAppType, implementation-data-type=PwrMgrMulti_PwrMgrHeartbeatRx_Evt_EventImpType
      application-data-type=PwrMgrMulti_PwrMgrWakeupRx_Evt_EventAppType, implementation-data-type=PwrMgrMulti_PwrMgrWakeupRx_Evt_EventImpType
      application-data-type=AppDataType/ProfileRequestPayLoadDataType_SvcAppStruct, implementation-data-type=ImpDataType/ProfileRequestPayLoadDataType_SvcStruct
      application-data-type=AppDataType/ProfileRequestDataType_SvcAppStruct, implementation-data-type=ImpDataType/ProfileRequestDataType_SvcStruct
      application-data-type=AppDataType/RequestStatusProfileStatePayLoadDataType_SvcAppStruct, implementation-data-type=ImpDataType/RequestStatusProfileStatePayLoadDataType_SvcStruct
      application-data-type=AppDataType/RequestStatusProfileStateDataType_SvcAppStruct, implementation-data-type=ImpDataType/RequestStatusProfileStateDataType_SvcStruct
      application-data-type=MechatronicsT1S_SwMgrInfoRx_Evt_EventAppType, implementation-data-type=MechatronicsT1S_SwMgrInfoRx_Evt_EventImpType
      application-data-type=hcSVC_CnsldtnEBST_evt_YeBACR_e_eBstActrModeRfP_TeBARR_e_ActrMode_SvcAppEnum, implementation-data-type=hcSVC_CnsldtnEBST_evt_YeBACR_e_eBstActrModeRfP_TeBARR_e_ActrMode_SvcEnum
      application-data-type=hcSVC_CnsldtnEBST_evt_YeBACR_e_eBstBrkCmdTypeLfP_TeBARR_e_BrkCmdTyp_SvcAppEnum, implementation-data-type=hcSVC_CnsldtnEBST_evt_YeBACR_e_eBstBrkCmdTypeLfP_TeBARR_e_BrkCmdTyp_SvcEnum
      application-data-type=hcSVC_CnsldtnEBST_evt_YeBACR_e_eBstBrkCmdTypeRrP_TeBARR_e_BrkCmdTyp_SvcAppEnum, implementation-data-type=hcSVC_CnsldtnEBST_evt_YeBACR_e_eBstBrkCmdTypeRrP_TeBARR_e_BrkCmdTyp_SvcEnum
      application-data-type=hcSVC_CnsldtnEBST_evt_YeBACR_e_eBstActrModeLfP_TeBARR_e_ActrMode_SvcAppEnum, implementation-data-type=hcSVC_CnsldtnEBST_evt_YeBACR_e_eBstActrModeLfP_TeBARR_e_ActrMode_SvcEnum
      application-data-type=hcSVC_CnsldtnEBST_evt_VeBACR_e_eBstEPB_CmdP_TePBKR_e_ApplyReleaseReq_SvcAppEnum, implementation-data-type=hcSVC_CnsldtnEBST_evt_VeBACR_e_eBstEPB_CmdP_TePBKR_e_ApplyReleaseReq_SvcEnum
      application-data-type=hcSVC_CnsldtnEBST_evt_VeBACR_e_eBstBrkSysPwrModeP_TeBCSR_e_BrkSysPwrMode_SvcAppEnum, implementation-data-type=hcSVC_CnsldtnEBST_evt_VeBACR_e_eBstBrkSysPwrModeP_TeBCSR_e_BrkSysPwrMode_SvcEnum
      application-data-type=hcSVC_CnsldtnEBST_evt_YeBACR_e_eBstActrModeLrP_TeBARR_e_ActrMode_SvcAppEnum, implementation-data-type=hcSVC_CnsldtnEBST_evt_YeBACR_e_eBstActrModeLrP_TeBARR_e_ActrMode_SvcEnum
      application-data-type=hcSVC_CnsldtnEBST_evt_YeBACR_e_eBstHydFuncStCmdP_TeBRMR_e_EBCM_eBstSt_SvcAppEnum, implementation-data-type=hcSVC_CnsldtnEBST_evt_YeBACR_e_eBstHydFuncStCmdP_TeBRMR_e_EBCM_eBstSt_SvcEnum
      application-data-type=hcSVC_CnsldtnEBST_evt_YeBACR_e_eBstActrModeRrP_TeBARR_e_ActrMode_SvcAppEnum, implementation-data-type=hcSVC_CnsldtnEBST_evt_YeBACR_e_eBstActrModeRrP_TeBARR_e_ActrMode_SvcEnum
      application-data-type=hcSVC_CnsldtnEBST_evt_YeBACR_e_eBstBrkCmdTypeRfP_TeBARR_e_BrkCmdTyp_SvcAppEnum, implementation-data-type=hcSVC_CnsldtnEBST_evt_YeBACR_e_eBstBrkCmdTypeRfP_TeBARR_e_BrkCmdTyp_SvcEnum
      application-data-type=hcSVC_CnsldtnEBST_evt_YeBACR_e_eBstBrkCmdTypeLrP_TeBARR_e_BrkCmdTyp_SvcAppEnum, implementation-data-type=hcSVC_CnsldtnEBST_evt_YeBACR_e_eBstBrkCmdTypeLrP_TeBARR_e_BrkCmdTyp_SvcEnum
      application-data-type=hcSVC_CnsldtnEBST_evt_VeBACR_e_eBstTransLvrPstnP_TeTRGR_e_TrnLeverPstn_SvcAppEnum, implementation-data-type=hcSVC_CnsldtnEBST_evt_VeBACR_e_eBstTransLvrPstnP_TeTRGR_e_TrnLeverPstn_SvcEnum
      application-data-type=hcSVC_CnsldtnEBST_evt_VeBACR_e_eBstPriPwrModeP_TeVSM_e_SystemPowerMode_SvcAppEnum, implementation-data-type=hcSVC_CnsldtnEBST_evt_VeBACR_e_eBstPriPwrModeP_TeVSM_e_SystemPowerMode_SvcEnum
      application-data-type=hcSVC_CnsldtnEBST_evt_VeBACR_e_eBstBkupPwrModeP_TeVSM_e_SystemPowerMode_SvcAppEnum, implementation-data-type=hcSVC_CnsldtnEBST_evt_VeBACR_e_eBstBkupPwrModeP_TeVSM_e_SystemPowerMode_SvcEnum
      application-data-type=hcSVC_CnsldtnEBST_evt_YeBACR_e_eBstBrkOprtnRqstP_TeBCSR_e_CCU_BrkOprtnRqst_SvcAppEnum, implementation-data-type=hcSVC_CnsldtnEBST_evt_YeBACR_e_eBstBrkOprtnRqstP_TeBCSR_e_CCU_BrkOprtnRqst_SvcEnum
      application-data-type=hcSVC_CnsldtnEBST_evt_VeBACR_e_eBstRplnshTriggerP_TeBARR_e_RplnshTrigger_SvcAppEnum, implementation-data-type=hcSVC_CnsldtnEBST_evt_VeBACR_e_eBstRplnshTriggerP_TeBARR_e_RplnshTrigger_SvcEnum
      application-data-type=hcSVC_CnsldtnEBST_evt_VeBACR_e_PrimDiagStReqP_TeBACR_e_DiagStSts_SvcAppEnum, implementation-data-type=hcSVC_CnsldtnEBST_evt_VeBACR_e_PrimDiagStReqP_TeBACR_e_DiagStSts_SvcEnum
      application-data-type=hcSVC_CnsldtnEBST_evt_DeBACR_e_eBstLV_LdPrioLvlP_TeLVDR_e_LV_LdPrioLvl_SvcAppEnum, implementation-data-type=hcSVC_CnsldtnEBST_evt_DeBACR_e_eBstLV_LdPrioLvlP_TeLVDR_e_LV_LdPrioLvl_SvcEnum
      application-data-type=hcSVC_CnsldtnEBST_evt_EventAppType, implementation-data-type=hcSVC_CnsldtnEBST_evt_EventImpType
      application-data-type=MechatronicsT1S_PwrMgrWakeupTx_Evt_EventAppType, implementation-data-type=MechatronicsT1S_PwrMgrWakeupTx_Evt_EventImpType
      application-data-type=AppDataType/ProfileRequestPayLoadDataType_SvcAppStruct, implementation-data-type=ImpDataType/ProfileRequestPayLoadDataType_SvcStruct
      application-data-type=AppDataType/ProfileRequestDataType_SvcAppStruct, implementation-data-type=ImpDataType/ProfileRequestDataType_SvcStruct
      application-data-type=AppDataType/RequestStatusProfileStatePayLoadDataType_SvcAppStruct, implementation-data-type=ImpDataType/RequestStatusProfileStatePayLoadDataType_SvcStruct
      application-data-type=AppDataType/RequestStatusProfileStateDataType_SvcAppStruct, implementation-data-type=ImpDataType/RequestStatusProfileStateDataType_SvcStruct
      application-data-type=MechatronicsT1S_SwMgrInfoTx_Evt_EventAppType, implementation-data-type=MechatronicsT1S_SwMgrInfoTx_Evt_EventImpType
      application-data-type=MechatronicsT1S_PwrMgrHeartbeatTx_Evt_EventAppType, implementation-data-type=MechatronicsT1S_PwrMgrHeartbeatTx_Evt_EventImpType
      application-data-type=hSVC_eBstActrPri_evt_VeBACR_e_eBstEPB_StateLtP_TeBACR_e_EPB_State_SvcAppEnum, implementation-data-type=hSVC_eBstActrPri_evt_VeBACR_e_eBstEPB_StateLtP_TeBACR_e_EPB_State_SvcEnum
      application-data-type=hSVC_eBstActrPri_evt_VeBACR_e_eBstPlngrPosnStsP_TeBPRR_e_ActPosnSts_SvcAppEnum, implementation-data-type=hSVC_eBstActrPri_evt_VeBACR_e_eBstPlngrPosnStsP_TeBPRR_e_ActPosnSts_SvcEnum
      application-data-type=hSVC_eBstActrPri_evt_VeBACR_e_eBstMC_StsP_TeBACR_e_VldTrvlSnsrs_SvcAppEnum, implementation-data-type=hSVC_eBstActrPri_evt_VeBACR_e_eBstMC_StsP_TeBACR_e_VldTrvlSnsrs_SvcEnum
      application-data-type=hSVC_eBstActrPri_evt_VeBACR_e_eBstEPB_AchModeRtP_TeBACR_e_EPB_AchMode_SvcAppEnum, implementation-data-type=hSVC_eBstActrPri_evt_VeBACR_e_eBstEPB_AchModeRtP_TeBACR_e_EPB_AchMode_SvcEnum
      application-data-type=hSVC_eBstActrPri_evt_VeBACR_e_eBstFluidLvlRawP_TeBACR_e_BrkFluidLvl_SvcAppEnum, implementation-data-type=hSVC_eBstActrPri_evt_VeBACR_e_eBstFluidLvlRawP_TeBACR_e_BrkFluidLvl_SvcEnum
      application-data-type=hSVC_eBstActrPri_evt_YeBACR_e_eBstEBOS_EBCMStateP_TeBACR_e_EBOS_EBCM_State_SvcAppEnum, implementation-data-type=hSVC_eBstActrPri_evt_YeBACR_e_eBstEBOS_EBCMStateP_TeBACR_e_EBOS_EBCM_State_SvcEnum
      application-data-type=hSVC_eBstActrPri_evt_VeBACR_e_eBstIntrSelfTstStsP_TeBACR_e_IntrSelfTstSts_SvcAppEnum, implementation-data-type=hSVC_eBstActrPri_evt_VeBACR_e_eBstIntrSelfTstStsP_TeBACR_e_IntrSelfTstSts_SvcEnum
      application-data-type=hSVC_eBstActrPri_evt_VeBACR_e_eBstEPB_StateRtP_TeBACR_e_EPB_State_SvcAppEnum, implementation-data-type=hSVC_eBstActrPri_evt_VeBACR_e_eBstEPB_StateRtP_TeBACR_e_EPB_State_SvcEnum
      application-data-type=hSVC_eBstActrPri_evt_VeBACR_e_eBstEPB_AchModeLtP_TeBACR_e_EPB_AchMode_SvcAppEnum, implementation-data-type=hSVC_eBstActrPri_evt_VeBACR_e_eBstEPB_AchModeLtP_TeBACR_e_EPB_AchMode_SvcEnum
      application-data-type=hSVC_eBstActrPri_evt_VeBACR_e_eBstRplnshStsP_TeBACR_e_RplnshSts_SvcAppEnum, implementation-data-type=hSVC_eBstActrPri_evt_VeBACR_e_eBstRplnshStsP_TeBACR_e_RplnshSts_SvcEnum
      application-data-type=hSVC_eBstActrPri_evt_VeBACR_e_eBstVDA_PbcHPO_ReqP_TeBACR_e_VDA_PbcHPO_Req_SvcAppEnum, implementation-data-type=hSVC_eBstActrPri_evt_VeBACR_e_eBstVDA_PbcHPO_ReqP_TeBACR_e_VDA_PbcHPO_Req_SvcEnum
      application-data-type=hSVC_eBstActrPri_evt_VeBACR_e_eBstHydFuncStP_TeBACR_e_eBstHydState_SvcAppEnum, implementation-data-type=hSVC_eBstActrPri_evt_VeBACR_e_eBstHydFuncStP_TeBACR_e_eBstHydState_SvcEnum
      application-data-type=hSVC_eBstActrPri_evt_VeBACR_e_SbmPrimDiagStStsP_TeBACR_e_SbmDiagStSts_SvcAppEnum, implementation-data-type=hSVC_eBstActrPri_evt_VeBACR_e_SbmPrimDiagStStsP_TeBACR_e_SbmDiagStSts_SvcEnum
      application-data-type=hSVC_eBstActrPri_evt_VeBACR_e_eBstWhlCntrlStsLfP_TeBACR_e_WhlCntrlSts_SvcAppEnum, implementation-data-type=hSVC_eBstActrPri_evt_VeBACR_e_eBstWhlCntrlStsLfP_TeBACR_e_WhlCntrlSts_SvcEnum
      application-data-type=hSVC_eBstActrPri_evt_YeBACR_e_eBstEPB_StatusRtP_TeBACR_e_EPB_Status_SvcAppEnum, implementation-data-type=hSVC_eBstActrPri_evt_YeBACR_e_eBstEPB_StatusRtP_TeBACR_e_EPB_Status_SvcEnum
      application-data-type=hSVC_eBstActrPri_evt_VeBACR_e_eBstWhlCntrlStsRrP_TeBACR_e_WhlCntrlSts_SvcAppEnum, implementation-data-type=hSVC_eBstActrPri_evt_VeBACR_e_eBstWhlCntrlStsRrP_TeBACR_e_WhlCntrlSts_SvcEnum
      application-data-type=hSVC_eBstActrPri_evt_VeBACR_e_eBstWhlCntrlStsLrP_TeBACR_e_WhlCntrlSts_SvcAppEnum, implementation-data-type=hSVC_eBstActrPri_evt_VeBACR_e_eBstWhlCntrlStsLrP_TeBACR_e_WhlCntrlSts_SvcEnum
      application-data-type=hSVC_eBstActrPri_evt_VeBACR_e_eBstWhlCntrlStsRfP_TeBACR_e_WhlCntrlSts_SvcAppEnum, implementation-data-type=hSVC_eBstActrPri_evt_VeBACR_e_eBstWhlCntrlStsRfP_TeBACR_e_WhlCntrlSts_SvcEnum
      application-data-type=hSVC_eBstActrPri_evt_YeBACR_e_eBstEPB_StatusLtP_TeBACR_e_EPB_Status_SvcAppEnum, implementation-data-type=hSVC_eBstActrPri_evt_YeBACR_e_eBstEPB_StatusLtP_TeBACR_e_EPB_Status_SvcEnum
      application-data-type=hSVC_eBstActrPri_evt_VeBACR_e_PrimDiagStStsP_TeBACR_e_DiagStSts_SvcAppEnum, implementation-data-type=hSVC_eBstActrPri_evt_VeBACR_e_PrimDiagStStsP_TeBACR_e_DiagStSts_SvcEnum
      application-data-type=hSVC_eBstActrPri_evt_VeBACR_e_eBstPCanCommStsP_TeBACR_e_PCanCommSts_SvcAppEnum, implementation-data-type=hSVC_eBstActrPri_evt_VeBACR_e_eBstPCanCommStsP_TeBACR_e_PCanCommSts_SvcEnum
      application-data-type=hSVC_eBstActrPri_evt_EventAppType, implementation-data-type=hSVC_eBstActrPri_evt_EventImpType
      application-data-type=ARPLearning_Evt_EventAppType, implementation-data-type=ARPLearning_Evt_EventImpType
      application-data-type=AppDataType/ProfileRequestPayLoadDataType_SvcAppStruct, implementation-data-type=ImpDataType/ProfileRequestPayLoadDataType_SvcStruct
      application-data-type=AppDataType/ProfileRequestDataType_SvcAppStruct, implementation-data-type=ImpDataType/ProfileRequestDataType_SvcStruct
      application-data-type=AppDataType/RequestStatusProfileStatePayLoadDataType_SvcAppStruct, implementation-data-type=ImpDataType/RequestStatusProfileStatePayLoadDataType_SvcStruct
      application-data-type=AppDataType/RequestStatusProfileStateDataType_SvcAppStruct, implementation-data-type=ImpDataType/RequestStatusProfileStateDataType_SvcStruct
      application-data-type=Mechatronics_Eth2_SwMgrInfoRx_Evt_EventAppType, implementation-data-type=Mechatronics_Eth2_SwMgrInfoRx_Evt_EventImpType
      application-data-type=AppDataType/ProfileRequestPayLoadDataType_SvcAppStruct, implementation-data-type=ImpDataType/ProfileRequestPayLoadDataType_SvcStruct
      application-data-type=AppDataType/ProfileRequestDataType_SvcAppStruct, implementation-data-type=ImpDataType/ProfileRequestDataType_SvcStruct
      application-data-type=AppDataType/RequestStatusProfileStatePayLoadDataType_SvcAppStruct, implementation-data-type=ImpDataType/RequestStatusProfileStatePayLoadDataType_SvcStruct
      application-data-type=AppDataType/RequestStatusProfileStateDataType_SvcAppStruct, implementation-data-type=ImpDataType/RequestStatusProfileStateDataType_SvcStruct
      application-data-type=Mechatronics_Eth2_SwMgrInfoTx_Evt_EventAppType, implementation-data-type=Mechatronics_Eth2_SwMgrInfoTx_Evt_EventImpType
package /SDSIG_SDV_Hierarchy/SDSIG_SDV_DOM_Body
  unit PerCent: display-name=%  # Per Cent
package /SDSIG_SDV_Hierarchy/SDSIG_SDV_DOM_Chassis
  unit RevolutionsPerSecond: display-name=rps  # Revolutions Per Second
package /SDSIG_SDV_Hierarchy/SDSIG_SDV_ElecArch_System
  compu method BrkSysPriBrkModToSecBrkModRtnRq_CompuMethod: 0=None, 1=SBM Basic Functional Test (SBM_Basic_Functional_Test), 2=Evac and Fill (Evac_and_Fill)
  compu method EBCMSlfTstInfo_CompuMethod: 0=IPB_RBUSelfTest_PreCondNotMet, 1=IPB_RBUSelfTest_InProgress, 2=IPB_RBUSelfTest_Prepared, 3=IPB_RBUSelfTest_PR_WithoutLEM, 4=IPB_RBUSelfTest_PR_SlotPending, 5=IPB_RBUSelfTest_PR_SlotGranted, 6=IPB_RBUSelfTest_PR_IPB_UV, 7=IPB_RBUSelfTest_Aborted, 8=IPB_RBUSelfTest_IPBFailure, 9=IPB_RBUSelfTest_BATPlausiFault, 10=IPB_RBUSelfTest_PreCondMet
  compu method HydrlcBrkFncStatAchvd_CompuMethod: 0=Normal Boost (Normal_Boost), 1=Hydraulic Leak Detection (Hydraulic_Leak_Detection), 2=Half System 1 (Half_System_1), 3=Half System 2 (Half_System_2), 4=No Boost with Isolation (No_Boost_with_Isolation), 5=No Boost (No_Boost), 6=Boost with Request Deferred (Boost_with_Request_Deferred)
  compu method MnAutoCtlrBrkOprtlModeReq_CompuMethod: 0=Not Operational (Not_Operational), 1=No Fail Over (No_Fail_Over), 2=LoC Braking (LoC_Braking), 3=LVM Braking (LVM_Braking), 4=Fail Over (Fail_Over)
  compu method PriBrkModFncTstTypActv_CompuMethod: 0=None, 1=Plunger Test (Plunger_Test), 2=Internal Test (Internal_Test), 3=External Test (External_Test), 4=Single Wheel Test (Single_Wheel_Test), 5=Cooperative Test (Cooperative_Test), 6=PBM Basic Test (PBM_Basic_Test), 7=Flush, 8=APC, 9=EPB Test (EPB_Test), 10=Tester Wheel Brake Pressure Control (Tester_Wheel_Brake_Pressure_Control)
  compu method SBMSlfTstInfo_CompuMethod: 0=RBUSelfTest_PreCondNotMet, 1=RBUSelfTest_Aborted, 2=RBUSelfTest_InProgress, 3=RBUSelfTest_PreCondMet, 4=RBUSelfTest_Request, 5=RBUSelfTest_Prepared
  7 x sender receiver interface:
    SrlDat636_Gen
      data SrlDat636: type=SrlDat636
    SrlDat637_Gen
      data SrlDat637: type=SrlDat637
    SrlDat638_Gen
      data SrlDat638: type=SrlDat638
    SrlDat639_Gen
      data SrlDat639: type=SrlDat639
    SrlDat673_Gen
      data SrlDat673: type=SrlDat673
    SrlDat674_Gen
      data SrlDat674: type=SrlDat674
    SrlDat675_Gen
      data SrlDat675: type=SrlDat675
  unit MilliMeter: display-name=mm  # Milli-Meter
  unit RevolutionsPerMinute: display-name=rpm  # Revolutions Per Minute
package /SVC_DEF_Hierarchy/SVC_CnsldtnEBSTDef
  collection hcSVC_CnsldtnEBST: category=SET, element=hcSVC_CnsldtnEBST_evt
  sender receiver interface hcSVC_CnsldtnEBST_evt
    data hcSVC_CnsldtnEBST_evt: type=hcSVC_CnsldtnEBST_evt_EventAppType
package /SVC_DEF_Hierarchy/SVC_CnsldtnEBSTDef/AppDataType
  5 x application array data type, all with category=ARRAY:
    VaBACR_y_UpIntegrationInputP_VaBACR_y_UpIntegrationInputP
      element hcSVC_CnsldtnEBSTVaBACR_y_UpIntegrationInputP_D0S312: category=VALUE, type=BYTE, max-number-of-elements=312
    VaBACR_y_eBstTmSyncMsgP_VaBACR_y_eBstTmSyncMsgP
      element hcSVC_CnsldtnEBSTVaBACR_y_eBstTmSyncMsgP_D0S8: category=VALUE, type=BYTE, max-number-of-elements=8
    VaBACR_y_eBstVIN_Arr10_17_P_VaBACR_y_eBstVIN_Arr10_17_P
      element hcSVC_CnsldtnEBSTVaBACR_y_eBstVIN_Arr10_17_P_D0S8: category=VALUE, type=BYTE, max-number-of-elements=8
    VaBACR_y_eBstVIN_Arr2_9_P_VaBACR_y_eBstVIN_Arr2_9_P
      element hcSVC_CnsldtnEBSTVaBACR_y_eBstVIN_Arr2_9_P_D0S8: category=VALUE, type=BYTE, max-number-of-elements=8
    VaBACR_y_eBstVIN_FirstDigitP_VaBACR_y_eBstVIN_FirstDigitP
      element hcSVC_CnsldtnEBSTVaBACR_y_eBstVIN_FirstDigitP_D0S1: category=VALUE, type=BYTE, max-number-of-elements=1
  18 x app type, all with category=VALUE:
    hcSVC_CnsldtnEBST_evt_DeBACR_e_eBstLV_LdPrioLvlP_TeLVDR_e_LV_LdPrioLvl_SvcAppEnum
    hcSVC_CnsldtnEBST_evt_VeBACR_e_PrimDiagStReqP_TeBACR_e_DiagStSts_SvcAppEnum
    hcSVC_CnsldtnEBST_evt_VeBACR_e_eBstBkupPwrModeP_TeVSM_e_SystemPowerMode_SvcAppEnum
    hcSVC_CnsldtnEBST_evt_VeBACR_e_eBstBrkSysPwrModeP_TeBCSR_e_BrkSysPwrMode_SvcAppEnum
    hcSVC_CnsldtnEBST_evt_VeBACR_e_eBstEPB_CmdP_TePBKR_e_ApplyReleaseReq_SvcAppEnum
    hcSVC_CnsldtnEBST_evt_VeBACR_e_eBstPriPwrModeP_TeVSM_e_SystemPowerMode_SvcAppEnum
    hcSVC_CnsldtnEBST_evt_VeBACR_e_eBstRplnshTriggerP_TeBARR_e_RplnshTrigger_SvcAppEnum
    hcSVC_CnsldtnEBST_evt_VeBACR_e_eBstTransLvrPstnP_TeTRGR_e_TrnLeverPstn_SvcAppEnum
    hcSVC_CnsldtnEBST_evt_YeBACR_e_eBstActrModeLfP_TeBARR_e_ActrMode_SvcAppEnum
    hcSVC_CnsldtnEBST_evt_YeBACR_e_eBstActrModeLrP_TeBARR_e_ActrMode_SvcAppEnum
    hcSVC_CnsldtnEBST_evt_YeBACR_e_eBstActrModeRfP_TeBARR_e_ActrMode_SvcAppEnum
    hcSVC_CnsldtnEBST_evt_YeBACR_e_eBstActrModeRrP_TeBARR_e_ActrMode_SvcAppEnum
    hcSVC_CnsldtnEBST_evt_YeBACR_e_eBstBrkCmdTypeLfP_TeBARR_e_BrkCmdTyp_SvcAppEnum
    hcSVC_CnsldtnEBST_evt_YeBACR_e_eBstBrkCmdTypeLrP_TeBARR_e_BrkCmdTyp_SvcAppEnum
    hcSVC_CnsldtnEBST_evt_YeBACR_e_eBstBrkCmdTypeRfP_TeBARR_e_BrkCmdTyp_SvcAppEnum
    hcSVC_CnsldtnEBST_evt_YeBACR_e_eBstBrkCmdTypeRrP_TeBARR_e_BrkCmdTyp_SvcAppEnum
    hcSVC_CnsldtnEBST_evt_YeBACR_e_eBstBrkOprtnRqstP_TeBCSR_e_CCU_BrkOprtnRqst_SvcAppEnum
    hcSVC_CnsldtnEBST_evt_YeBACR_e_eBstHydFuncStCmdP_TeBRMR_e_EBCM_eBstSt_SvcAppEnum
  application record data type hcSVC_CnsldtnEBST_evt_EventAppType: category=STRUCTURE
    70 x application record element:
      VeBACR_b_eBstTransSIP_P: category=VALUE, type=TbBOOLEAN
      YeBACR_M_eBstTotAxlTrqActP: category=VALUE, type=T_M_NewtonMeters
      VeBACR_b_eBstFuncTstAllwdP: category=VALUE, type=TbBOOLEAN
      YeBACR_p_eBstBrkTgtRrP: category=VALUE, type=T_p_bar
      VeBACR_phi_eBstStrWhlAngP: category=VALUE, type=T_phi_Rad
      YeBACR_e_eBstActrModeRfP: category=VALUE, type=hcSVC_CnsldtnEBST_evt_YeBACR_e_eBstActrModeRfP_TeBARR_e_ActrMode_SvcAppEnum
      YeBACR_e_eBstBrkCmdTypeLfP: category=VALUE, type=hcSVC_CnsldtnEBST_evt_YeBACR_e_eBstBrkCmdTypeLfP_TeBARR_e_BrkCmdTyp_SvcAppEnum
      VeBACR_b_eBstOAT_InvP: category=VALUE, type=TbBOOLEAN
      VeBACR_v_eBstWhlSpdRfP: category=VALUE, type=T_v_MetersPerSec
      YeBACR_I_eBstPwrMgmtSinkLimP: category=VALUE, type=T_I_Amps
      VeBACR_b_eBstWhlSpdLfInvP: category=VALUE, type=TbBOOLEAN
      VeBACR_a_eBstVehAyP: category=VALUE, type=T_a_MetersPerSec2
      YeBACR_p_eBstBrkTgtLfP: category=VALUE, type=T_p_bar
      VeBACR_b_eBstRmtPrgActvP: category=VALUE, type=TbBOOLEAN
      VeBACR_T_eBstOAT_CorrP: category=VALUE, type=T_T_Celsius
      YeBACR_e_eBstBrkCmdTypeRrP: category=VALUE, type=hcSVC_CnsldtnEBST_evt_YeBACR_e_eBstBrkCmdTypeRrP_TeBARR_e_BrkCmdTyp_SvcAppEnum
      YeBACR_p_eBstBrkTgtRfP: category=VALUE, type=T_p_bar
      YeBACR_I_eBstPwrMgmtGenLimP: category=VALUE, type=T_I_Amps
      YeBACR_e_eBstActrModeLfP: category=VALUE, type=hcSVC_CnsldtnEBST_evt_YeBACR_e_eBstActrModeLfP_TeBARR_e_ActrMode_SvcAppEnum
      VeBACR_v_eBstWhlSpdLfP: category=VALUE, type=T_v_MetersPerSec
      VeBACR_v_eBstWhlSpdRrP: category=VALUE, type=T_v_MetersPerSec
      VeBACR_e_eBstEPB_CmdP: category=VALUE, type=hcSVC_CnsldtnEBST_evt_VeBACR_e_eBstEPB_CmdP_TePBKR_e_ApplyReleaseReq_SvcAppEnum
      VeBACR_F_eBstEPB_StateCmdLtP: category=VALUE, type=T_F_Newtons
      VeBACR_e_eBstBrkSysPwrModeP: category=VALUE, type=hcSVC_CnsldtnEBST_evt_VeBACR_e_eBstBrkSysPwrModeP_TeBCSR_e_BrkSysPwrMode_SvcAppEnum
      YeBACR_e_eBstActrModeLrP: category=VALUE, type=hcSVC_CnsldtnEBST_evt_YeBACR_e_eBstActrModeLrP_TeBARR_e_ActrMode_SvcAppEnum
      YeBACR_e_eBstHydFuncStCmdP: category=VALUE, type=hcSVC_CnsldtnEBST_evt_YeBACR_e_eBstHydFuncStCmdP_TeBRMR_e_EBCM_eBstSt_SvcAppEnum
      YeBACR_b_eBstPwrMgmtReqP: category=VALUE, type=TbBOOLEAN
      VeBACR_Pct_eBstAccelEffPosP: category=VALUE, type=T_Pct_Percent
      YeBACR_a_eBstVeh_AxP: category=VALUE, type=T_a_MetersPerSec2
      VeBACR_F_eBstEPB_StateCmdRtP: category=VALUE, type=T_F_Newtons
      VeBACR_b_eBstWhlSpdRrInvP: category=VALUE, type=TbBOOLEAN
      YeBACR_e_eBstActrModeRrP: category=VALUE, type=hcSVC_CnsldtnEBST_evt_YeBACR_e_eBstActrModeRrP_TeBARR_e_ActrMode_SvcAppEnum
      VeBACR_b_eBstWhlSpdRfInvP: category=VALUE, type=TbBOOLEAN
      VeBACR_b_eBstVeh_AxInvP: category=VALUE, type=TbBOOLEAN
      VeBACR_l_eBstVehOdoBCM_P: category=VALUE, type=T_l_Kilometers
      YeBACR_e_eBstBrkCmdTypeRfP: category=VALUE, type=hcSVC_CnsldtnEBST_evt_YeBACR_e_eBstBrkCmdTypeRfP_TeBARR_e_BrkCmdTyp_SvcAppEnum
      VeBACR_b_eBstWhlSpdLrInvP: category=VALUE, type=TbBOOLEAN
      YeBACR_e_eBstBrkCmdTypeLrP: category=VALUE, type=hcSVC_CnsldtnEBST_evt_YeBACR_e_eBstBrkCmdTypeLrP_TeBARR_e_BrkCmdTyp_SvcAppEnum
      VeBACR_v_eBstWhlSpdLrP: category=VALUE, type=T_v_MetersPerSec
      YeBACR_p_eBstBrkTgtLrP: category=VALUE, type=T_p_bar
      VeBACR_e_eBstTransLvrPstnP: category=VALUE, type=hcSVC_CnsldtnEBST_evt_VeBACR_e_eBstTransLvrPstnP_TeTRGR_e_TrnLeverPstn_SvcAppEnum
      VeBACR_b_eBstWrmUpCyclCmptP: category=VALUE, type=TbBOOLEAN
      VaBACR_y_eBstVIN_FirstDigitP: category=ARRAY, type=VaBACR_y_eBstVIN_FirstDigitP_VaBACR_y_eBstVIN_FirstDigitP
      VeBACR_b_eBstRnCrnkActBkupP: category=VALUE, type=TbBOOLEAN
      VeBACR_e_eBstPriPwrModeP: category=VALUE, type=hcSVC_CnsldtnEBST_evt_VeBACR_e_eBstPriPwrModeP_TeVSM_e_SystemPowerMode_SvcAppEnum
      VeBACR_b_eBstRnCrnkActPriP: category=VALUE, type=TbBOOLEAN
      VeBACR_e_eBstBkupPwrModeP: category=VALUE, type=hcSVC_CnsldtnEBST_evt_VeBACR_e_eBstBkupPwrModeP_TeVSM_e_SystemPowerMode_SvcAppEnum
      VeBACR_y_eBstVehRegionCodeP: category=VALUE, type=BYTE
      VeBACR_b_PropSysActvP: category=VALUE, type=TbBOOLEAN
      VeBACR_v_eBstVehicleP: category=VALUE, type=T_KPH_UW_07
      VaBACR_y_eBstVIN_Arr2_9_P: category=ARRAY, type=VaBACR_y_eBstVIN_Arr2_9_P_VaBACR_y_eBstVIN_Arr2_9_P
      VaBACR_y_eBstTmSyncMsgP: category=ARRAY, type=VaBACR_y_eBstTmSyncMsgP_VaBACR_y_eBstTmSyncMsgP
      VaBACR_y_eBstVIN_Arr10_17_P: category=ARRAY, type=VaBACR_y_eBstVIN_Arr10_17_P_VaBACR_y_eBstVIN_Arr10_17_P
      VeBACR_V_eBstRplnshVolTrgtP: category=VALUE, type=T_V_Millimeters3
      VeBACR_p_eBstBkPrsTgtBaseP: category=VALUE, type=T_p_bar
      SSMR_0C598001_0CD68001_QoS: category=VALUE, type=BYTE
      YeBACR_e_eBstBrkOprtnRqstP: category=VALUE, type=hcSVC_CnsldtnEBST_evt_YeBACR_e_eBstBrkOprtnRqstP_TeBCSR_e_CCU_BrkOprtnRqst_SvcAppEnum
      NeBACR_b_eBstBrkFdSt2DiagP: category=VALUE, type=TbBOOLEAN
      NeBACR_t_eBstPropSysInactvP: category=VALUE, type=LONGWORD
      VeBACR_b_eBstEPB_HpoAvailP: category=VALUE, type=TbBOOLEAN
      VeBACR_e_eBstRplnshTriggerP: category=VALUE, type=hcSVC_CnsldtnEBST_evt_VeBACR_e_eBstRplnshTriggerP_TeBARR_e_RplnshTrigger_SvcAppEnum
      NeBACR_b_eBstBrkFdSt1DiagP: category=VALUE, type=TbBOOLEAN
      VaBACR_y_UpIntegrationInputP: category=ARRAY, type=VaBACR_y_UpIntegrationInputP_VaBACR_y_UpIntegrationInputP
      VeBACR_b_eBstEngStrtrCmdOnP: category=VALUE, type=TbBOOLEAN
      NeBACR_m_eBstVehMassP: category=VALUE, type=T_m_Kilograms
      NeBACR_l_eBstFrtTireRadiusP: category=VALUE, type=T_l_Meters
      VeBACR_M_eBstSysLvlBrkTrqP: category=VALUE, type=T_M_NewtonMeters
      VeBACR_e_PrimDiagStReqP: category=VALUE, type=hcSVC_CnsldtnEBST_evt_VeBACR_e_PrimDiagStReqP_TeBACR_e_DiagStSts_SvcAppEnum
      VeBACR_b_eBstVehAyInvP: category=VALUE, type=TbBOOLEAN
      DeBACR_e_eBstLV_LdPrioLvlP: category=VALUE, type=hcSVC_CnsldtnEBST_evt_DeBACR_e_eBstLV_LdPrioLvlP_TeLVDR_e_LV_LdPrioLvl_SvcAppEnum
package /SVC_DEF_Hierarchy/SVC_CnsldtnEBSTDef/ImpDataType
  19 x impl type:
    hcSVC_CnsldtnEBST_evt_DeBACR_e_eBstLV_LdPrioLvlP_TeLVDR_e_LV_LdPrioLvl_SvcEnum:
      category=VALUE
      base-type=sint16
      compu {4=Ce_hcSVC_CnsldtnEBST_evt_DeBACR_e_eBstLV_LdPrioLvlP_LVDR_e_LdPrioLvl_MedHi, 1=Ce_hcSVC_CnsldtnEBST_evt_DeBACR_e_eBstLV_LdPrioLvlP_LVDR_e_LdPrioLvl_Lo, 0=Ce_hcSVC_CnsldtnEBST_evt_DeBACR_e_eBstLV_LdPrioLvlP_LVDR_e_LdPrioLvl_Norm, 2=Ce_hcSVC_CnsldtnEBST_evt_DeBACR_e_eBstLV_LdPrioLvlP_LVDR_e_LdPrioLvl_MedLo, 5=Ce_hcSVC_CnsldtnEBST_evt_DeBACR_e_eBstLV_LdPrioLvlP_LVDR_e_LdPrioLvl_Hi, 3=Ce_hcSVC_CnsldtnEBST_evt_DeBACR_e_eBstLV_LdPrioLvlP_LVDR_e_LdPrioLvl_Med, 7=Ce_hcSVC_CnsldtnEBST_evt_DeBACR_e_eBstLV_LdPrioLvlP_LVDR_e_LdPrioLvl_Emergency, 8=Ce_hcSVC_CnsldtnEBST_evt_DeBACR_e_eBstLV_LdPrioLvlP_LVDR_e_LdPrioLvl_Ingress, 6=Ce_hcSVC_CnsldtnEBST_evt_DeBACR_e_eBstLV_LdPrioLvlP_LVDR_e_LdPrioLvl_Critical}
    hcSVC_CnsldtnEBST_evt_EventImpType: category=STRUCTURE
      70 x element:
        VeBACR_b_eBstTransSIP_P: implementation-data-type=TbBOOLEAN
        YeBACR_M_eBstTotAxlTrqActP: implementation-data-type=T_M_NewtonMeters
        VeBACR_b_eBstFuncTstAllwdP: implementation-data-type=TbBOOLEAN
        YeBACR_p_eBstBrkTgtRrP: implementation-data-type=T_p_bar
        VeBACR_phi_eBstStrWhlAngP: implementation-data-type=T_phi_Rad
        YeBACR_e_eBstActrModeRfP: implementation-data-type=hcSVC_CnsldtnEBST_evt_YeBACR_e_eBstActrModeRfP_TeBARR_e_ActrMode_SvcEnum
        YeBACR_e_eBstBrkCmdTypeLfP: implementation-data-type=hcSVC_CnsldtnEBST_evt_YeBACR_e_eBstBrkCmdTypeLfP_TeBARR_e_BrkCmdTyp_SvcEnum
        VeBACR_b_eBstOAT_InvP: implementation-data-type=TbBOOLEAN
        VeBACR_v_eBstWhlSpdRfP: implementation-data-type=T_v_MetersPerSec
        YeBACR_I_eBstPwrMgmtSinkLimP: implementation-data-type=T_I_Amps
        VeBACR_b_eBstWhlSpdLfInvP: implementation-data-type=TbBOOLEAN
        VeBACR_a_eBstVehAyP: implementation-data-type=T_a_MetersPerSec2
        YeBACR_p_eBstBrkTgtLfP: implementation-data-type=T_p_bar
        VeBACR_b_eBstRmtPrgActvP: implementation-data-type=TbBOOLEAN
        VeBACR_T_eBstOAT_CorrP: implementation-data-type=T_T_Celsius
        YeBACR_e_eBstBrkCmdTypeRrP: implementation-data-type=hcSVC_CnsldtnEBST_evt_YeBACR_e_eBstBrkCmdTypeRrP_TeBARR_e_BrkCmdTyp_SvcEnum
        YeBACR_p_eBstBrkTgtRfP: implementation-data-type=T_p_bar
        YeBACR_I_eBstPwrMgmtGenLimP: implementation-data-type=T_I_Amps
        YeBACR_e_eBstActrModeLfP: implementation-data-type=hcSVC_CnsldtnEBST_evt_YeBACR_e_eBstActrModeLfP_TeBARR_e_ActrMode_SvcEnum
        VeBACR_v_eBstWhlSpdLfP: implementation-data-type=T_v_MetersPerSec
        VeBACR_v_eBstWhlSpdRrP: implementation-data-type=T_v_MetersPerSec
        VeBACR_e_eBstEPB_CmdP: implementation-data-type=hcSVC_CnsldtnEBST_evt_VeBACR_e_eBstEPB_CmdP_TePBKR_e_ApplyReleaseReq_SvcEnum
        VeBACR_F_eBstEPB_StateCmdLtP: implementation-data-type=T_F_Newtons
        VeBACR_e_eBstBrkSysPwrModeP: implementation-data-type=hcSVC_CnsldtnEBST_evt_VeBACR_e_eBstBrkSysPwrModeP_TeBCSR_e_BrkSysPwrMode_SvcEnum
        YeBACR_e_eBstActrModeLrP: implementation-data-type=hcSVC_CnsldtnEBST_evt_YeBACR_e_eBstActrModeLrP_TeBARR_e_ActrMode_SvcEnum
        YeBACR_e_eBstHydFuncStCmdP: implementation-data-type=hcSVC_CnsldtnEBST_evt_YeBACR_e_eBstHydFuncStCmdP_TeBRMR_e_EBCM_eBstSt_SvcEnum
        YeBACR_b_eBstPwrMgmtReqP: implementation-data-type=TbBOOLEAN
        VeBACR_Pct_eBstAccelEffPosP: implementation-data-type=T_Pct_Percent
        YeBACR_a_eBstVeh_AxP: implementation-data-type=T_a_MetersPerSec2
        VeBACR_F_eBstEPB_StateCmdRtP: implementation-data-type=T_F_Newtons
        VeBACR_b_eBstWhlSpdRrInvP: implementation-data-type=TbBOOLEAN
        YeBACR_e_eBstActrModeRrP: implementation-data-type=hcSVC_CnsldtnEBST_evt_YeBACR_e_eBstActrModeRrP_TeBARR_e_ActrMode_SvcEnum
        VeBACR_b_eBstWhlSpdRfInvP: implementation-data-type=TbBOOLEAN
        VeBACR_b_eBstVeh_AxInvP: implementation-data-type=TbBOOLEAN
        VeBACR_l_eBstVehOdoBCM_P: implementation-data-type=T_l_Kilometers
        YeBACR_e_eBstBrkCmdTypeRfP: implementation-data-type=hcSVC_CnsldtnEBST_evt_YeBACR_e_eBstBrkCmdTypeRfP_TeBARR_e_BrkCmdTyp_SvcEnum
        VeBACR_b_eBstWhlSpdLrInvP: implementation-data-type=TbBOOLEAN
        YeBACR_e_eBstBrkCmdTypeLrP: implementation-data-type=hcSVC_CnsldtnEBST_evt_YeBACR_e_eBstBrkCmdTypeLrP_TeBARR_e_BrkCmdTyp_SvcEnum
        VeBACR_v_eBstWhlSpdLrP: implementation-data-type=T_v_MetersPerSec
        YeBACR_p_eBstBrkTgtLrP: implementation-data-type=T_p_bar
        VeBACR_e_eBstTransLvrPstnP: implementation-data-type=hcSVC_CnsldtnEBST_evt_VeBACR_e_eBstTransLvrPstnP_TeTRGR_e_TrnLeverPstn_SvcEnum
        VeBACR_b_eBstWrmUpCyclCmptP: implementation-data-type=TbBOOLEAN
        VaBACR_y_eBstVIN_FirstDigitP: category=ARRAY
          element hcSVC_CnsldtnEBSTVaBACR_y_eBstVIN_FirstDigitP_D0S1: array-size=1, implementation-data-type=BYTE
        VeBACR_b_eBstRnCrnkActBkupP: implementation-data-type=TbBOOLEAN
        VeBACR_e_eBstPriPwrModeP: implementation-data-type=hcSVC_CnsldtnEBST_evt_VeBACR_e_eBstPriPwrModeP_TeVSM_e_SystemPowerMode_SvcEnum
        VeBACR_b_eBstRnCrnkActPriP: implementation-data-type=TbBOOLEAN
        VeBACR_e_eBstBkupPwrModeP: implementation-data-type=hcSVC_CnsldtnEBST_evt_VeBACR_e_eBstBkupPwrModeP_TeVSM_e_SystemPowerMode_SvcEnum
        VeBACR_y_eBstVehRegionCodeP: implementation-data-type=BYTE
        VeBACR_b_PropSysActvP: implementation-data-type=TbBOOLEAN
        VeBACR_v_eBstVehicleP: implementation-data-type=T_KPH_UW_07
        VaBACR_y_eBstVIN_Arr2_9_P: category=ARRAY
          element hcSVC_CnsldtnEBSTVaBACR_y_eBstVIN_Arr2_9_P_D0S8: array-size=8, implementation-data-type=BYTE
        VaBACR_y_eBstTmSyncMsgP: category=ARRAY
          element hcSVC_CnsldtnEBSTVaBACR_y_eBstTmSyncMsgP_D0S8: array-size=8, implementation-data-type=BYTE
        VaBACR_y_eBstVIN_Arr10_17_P: category=ARRAY
          element hcSVC_CnsldtnEBSTVaBACR_y_eBstVIN_Arr10_17_P_D0S8: array-size=8, implementation-data-type=BYTE
        VeBACR_V_eBstRplnshVolTrgtP: implementation-data-type=T_V_Millimeters3
        VeBACR_p_eBstBkPrsTgtBaseP: implementation-data-type=T_p_bar
        SSMR_0C598001_0CD68001_QoS: implementation-data-type=BYTE
        YeBACR_e_eBstBrkOprtnRqstP: implementation-data-type=hcSVC_CnsldtnEBST_evt_YeBACR_e_eBstBrkOprtnRqstP_TeBCSR_e_CCU_BrkOprtnRqst_SvcEnum
        NeBACR_b_eBstBrkFdSt2DiagP: implementation-data-type=TbBOOLEAN
        NeBACR_t_eBstPropSysInactvP: implementation-data-type=LONGWORD
        VeBACR_b_eBstEPB_HpoAvailP: implementation-data-type=TbBOOLEAN
        VeBACR_e_eBstRplnshTriggerP: implementation-data-type=hcSVC_CnsldtnEBST_evt_VeBACR_e_eBstRplnshTriggerP_TeBARR_e_RplnshTrigger_SvcEnum
        NeBACR_b_eBstBrkFdSt1DiagP: implementation-data-type=TbBOOLEAN
        VaBACR_y_UpIntegrationInputP: category=ARRAY
          element hcSVC_CnsldtnEBSTVaBACR_y_UpIntegrationInputP_D0S312: array-size=312, implementation-data-type=BYTE
        VeBACR_b_eBstEngStrtrCmdOnP: implementation-data-type=TbBOOLEAN
        NeBACR_m_eBstVehMassP: implementation-data-type=T_m_Kilograms
        NeBACR_l_eBstFrtTireRadiusP: implementation-data-type=T_l_Meters
        VeBACR_M_eBstSysLvlBrkTrqP: implementation-data-type=T_M_NewtonMeters
        VeBACR_e_PrimDiagStReqP: implementation-data-type=hcSVC_CnsldtnEBST_evt_VeBACR_e_PrimDiagStReqP_TeBACR_e_DiagStSts_SvcEnum
        VeBACR_b_eBstVehAyInvP: implementation-data-type=TbBOOLEAN
        DeBACR_e_eBstLV_LdPrioLvlP: implementation-data-type=hcSVC_CnsldtnEBST_evt_DeBACR_e_eBstLV_LdPrioLvlP_TeLVDR_e_LV_LdPrioLvl_SvcEnum
    hcSVC_CnsldtnEBST_evt_VeBACR_e_PrimDiagStReqP_TeBACR_e_DiagStSts_SvcEnum:
      category=VALUE
      base-type=sint16
      compu {2=Ce_hcSVC_CnsldtnEBST_evt_VeBACR_e_PrimDiagStReqP_BACR_e_DiagSts_TestCmplt, 3=Ce_hcSVC_CnsldtnEBST_evt_VeBACR_e_PrimDiagStReqP_BACR_e_DiagSts_TestFail, 0=Ce_hcSVC_CnsldtnEBST_evt_VeBACR_e_PrimDiagStReqP_BACR_e_DiagSts_NotActv, 4=Ce_hcSVC_CnsldtnEBST_evt_VeBACR_e_PrimDiagStReqP_BACR_e_DiagSts_TstCndNtMet, 1=Ce_hcSVC_CnsldtnEBST_evt_VeBACR_e_PrimDiagStReqP_BACR_e_DiagSts_TestActv}
    hcSVC_CnsldtnEBST_evt_VeBACR_e_eBstBkupPwrModeP_TeVSM_e_SystemPowerMode_SvcEnum: category=VALUE, base-type=sint16, compu {2=Ce_hcSVC_CnsldtnEBST_evt_VeBACR_e_eBstBkupPwrModeP_VSM_PM_RUN, 1=Ce_hcSVC_CnsldtnEBST_evt_VeBACR_e_eBstBkupPwrModeP_VSM_PM_ACC, 0=Ce_hcSVC_CnsldtnEBST_evt_VeBACR_e_eBstBkupPwrModeP_VSM_PM_OFF, 4=Ce_hcSVC_CnsldtnEBST_evt_VeBACR_e_eBstBkupPwrModeP_VSM_PM_PROPULSION, 3=Ce_hcSVC_CnsldtnEBST_evt_VeBACR_e_eBstBkupPwrModeP_VSM_PM_START}
    hcSVC_CnsldtnEBST_evt_VeBACR_e_eBstBrkSysPwrModeP_TeBCSR_e_BrkSysPwrMode_SvcEnum: category=VALUE, base-type=sint16, compu {1=Ce_hcSVC_CnsldtnEBST_evt_VeBACR_e_eBstBrkSysPwrModeP_BCSR_e_BPM_Run, 2=Ce_hcSVC_CnsldtnEBST_evt_VeBACR_e_eBstBrkSysPwrModeP_BCSR_e_BPM_Start, 3=Ce_hcSVC_CnsldtnEBST_evt_VeBACR_e_eBstBrkSysPwrModeP_BCSR_e_BPM_ExtendedRun, 0=Ce_hcSVC_CnsldtnEBST_evt_VeBACR_e_eBstBrkSysPwrModeP_BCSR_e_BPM_Off}
    hcSVC_CnsldtnEBST_evt_VeBACR_e_eBstEPB_CmdP_TePBKR_e_ApplyReleaseReq_SvcEnum:
      category=VALUE
      base-type=sint16
      compu {34=Ce_hcSVC_CnsldtnEBST_evt_VeBACR_e_eBstEPB_CmdP_PBKR_Req_ServiceRelease, 2=Ce_hcSVC_CnsldtnEBST_evt_VeBACR_e_eBstEPB_CmdP_PBKR_Req_ParkApply, 37=Ce_hcSVC_CnsldtnEBST_evt_VeBACR_e_eBstEPB_CmdP_PBKR_Req_PadAdjustment, 35=Ce_hcSVC_CnsldtnEBST_evt_VeBACR_e_eBstEPB_CmdP_PBKR_Req_ForceControl, 4=Ce_hcSVC_CnsldtnEBST_evt_VeBACR_e_eBstEPB_CmdP_PBKR_Req_RollerBenchApply, 36=Ce_hcSVC_CnsldtnEBST_evt_VeBACR_e_eBstEPB_CmdP_PBKR_Req_DynamicApply, 0=Ce_hcSVC_CnsldtnEBST_evt_VeBACR_e_eBstEPB_CmdP_PBKR_Req_None, 33=Ce_hcSVC_CnsldtnEBST_evt_VeBACR_e_eBstEPB_CmdP_PBKR_Req_AssemblyCheck, 3=Ce_hcSVC_CnsldtnEBST_evt_VeBACR_e_eBstEPB_CmdP_PBKR_Req_MaxApply, 18=Ce_hcSVC_CnsldtnEBST_evt_VeBACR_e_eBstEPB_CmdP_PBKR_Req_Release}
    hcSVC_CnsldtnEBST_evt_VeBACR_e_eBstPriPwrModeP_TeVSM_e_SystemPowerMode_SvcEnum: category=VALUE, base-type=sint16, compu {0=Ce_hcSVC_CnsldtnEBST_evt_VeBACR_e_eBstPriPwrModeP_VSM_PM_OFF, 3=Ce_hcSVC_CnsldtnEBST_evt_VeBACR_e_eBstPriPwrModeP_VSM_PM_START, 1=Ce_hcSVC_CnsldtnEBST_evt_VeBACR_e_eBstPriPwrModeP_VSM_PM_ACC, 2=Ce_hcSVC_CnsldtnEBST_evt_VeBACR_e_eBstPriPwrModeP_VSM_PM_RUN, 4=Ce_hcSVC_CnsldtnEBST_evt_VeBACR_e_eBstPriPwrModeP_VSM_PM_PROPULSION}
    hcSVC_CnsldtnEBST_evt_VeBACR_e_eBstRplnshTriggerP_TeBARR_e_RplnshTrigger_SvcEnum: category=VALUE, base-type=sint16, compu {2=Ce_hcSVC_CnsldtnEBST_evt_VeBACR_e_eBstRplnshTriggerP_BARR_e_RplnshStndrd, 1=Ce_hcSVC_CnsldtnEBST_evt_VeBACR_e_eBstRplnshTriggerP_BARR_e_RplnshAbort, 3=Ce_hcSVC_CnsldtnEBST_evt_VeBACR_e_eBstRplnshTriggerP_BARR_e_RplnshCmfrt, 0=Ce_hcSVC_CnsldtnEBST_evt_VeBACR_e_eBstRplnshTriggerP_BARR_e_RplnshNoAction}
    hcSVC_CnsldtnEBST_evt_VeBACR_e_eBstTransLvrPstnP_TeTRGR_e_TrnLeverPstn_SvcEnum:
      category=VALUE
      base-type=sint16
      compu {15=Ce_hcSVC_CnsldtnEBST_evt_VeBACR_e_eBstTransLvrPstnP_TRGR_Cnt_TrnLeverPstnSize, 13=Ce_hcSVC_CnsldtnEBST_evt_VeBACR_e_eBstTransLvrPstnP_TRGR_e_ForwardRangeJ, 0=Ce_hcSVC_CnsldtnEBST_evt_VeBACR_e_eBstTransLvrPstnP_TRGR_e_BetweenRanges, 2=Ce_hcSVC_CnsldtnEBST_evt_VeBACR_e_eBstTransLvrPstnP_TRGR_e_ReverseRange, 14=Ce_hcSVC_CnsldtnEBST_evt_VeBACR_e_eBstTransLvrPstnP_TRGR_e_LeverPstnUnknown, 11=Ce_hcSVC_CnsldtnEBST_evt_VeBACR_e_eBstTransLvrPstnP_TRGR_e_ForwardRangeH, 12=Ce_hcSVC_CnsldtnEBST_evt_VeBACR_e_eBstTransLvrPstnP_TRGR_e_ForwardRangeI, 9=Ce_hcSVC_CnsldtnEBST_evt_VeBACR_e_eBstTransLvrPstnP_TRGR_e_ForwardRangeF, 10=Ce_hcSVC_CnsldtnEBST_evt_VeBACR_e_eBstTransLvrPstnP_TRGR_e_ForwardRangeG, 7=Ce_hcSVC_CnsldtnEBST_evt_VeBACR_e_eBstTransLvrPstnP_TRGR_e_ForwardRangeD, 8=Ce_hcSVC_CnsldtnEBST_evt_VeBACR_e_eBstTransLvrPstnP_TRGR_e_ForwardRangeE, 5=Ce_hcSVC_CnsldtnEBST_evt_VeBACR_e_eBstTransLvrPstnP_TRGR_e_ForwardRangeB, 3=Ce_hcSVC_CnsldtnEBST_evt_VeBACR_e_eBstTransLvrPstnP_TRGR_e_NeutralRange, 6=Ce_hcSVC_CnsldtnEBST_evt_VeBACR_e_eBstTransLvrPstnP_TRGR_e_ForwardRangeC, 1=Ce_hcSVC_CnsldtnEBST_evt_VeBACR_e_eBstTransLvrPstnP_TRGR_e_ParkRange, 4=Ce_hcSVC_CnsldtnEBST_evt_VeBACR_e_eBstTransLvrPstnP_TRGR_e_ForwardRangeA}
    hcSVC_CnsldtnEBST_evt_YeBACR_e_eBstActrModeLfP_TeBARR_e_ActrMode_SvcEnum:
      category=VALUE
      base-type=sint16
      compu {3=Ce_hcSVC_CnsldtnEBST_evt_YeBACR_e_eBstActrModeLfP_BARR_e_Reclamp, 1=Ce_hcSVC_CnsldtnEBST_evt_YeBACR_e_eBstActrModeLfP_BARR_e_Braking, 0=Ce_hcSVC_CnsldtnEBST_evt_YeBACR_e_eBstActrModeLfP_BARR_e_None, 5=Ce_hcSVC_CnsldtnEBST_evt_YeBACR_e_eBstActrModeLfP_BARR_e_SrvRel, 4=Ce_hcSVC_CnsldtnEBST_evt_YeBACR_e_eBstActrModeLfP_BARR_e_Position, 6=Ce_hcSVC_CnsldtnEBST_evt_YeBACR_e_eBstActrModeLfP_BARR_e_FlowCntrl, 2=Ce_hcSVC_CnsldtnEBST_evt_YeBACR_e_eBstActrModeLfP_BARR_e_Parking}
    hcSVC_CnsldtnEBST_evt_YeBACR_e_eBstActrModeLrP_TeBARR_e_ActrMode_SvcEnum:
      category=VALUE
      base-type=sint16
      compu {5=Ce_hcSVC_CnsldtnEBST_evt_YeBACR_e_eBstActrModeLrP_BARR_e_SrvRel, 6=Ce_hcSVC_CnsldtnEBST_evt_YeBACR_e_eBstActrModeLrP_BARR_e_FlowCntrl, 1=Ce_hcSVC_CnsldtnEBST_evt_YeBACR_e_eBstActrModeLrP_BARR_e_Braking, 0=Ce_hcSVC_CnsldtnEBST_evt_YeBACR_e_eBstActrModeLrP_BARR_e_None, 3=Ce_hcSVC_CnsldtnEBST_evt_YeBACR_e_eBstActrModeLrP_BARR_e_Reclamp, 4=Ce_hcSVC_CnsldtnEBST_evt_YeBACR_e_eBstActrModeLrP_BARR_e_Position, 2=Ce_hcSVC_CnsldtnEBST_evt_YeBACR_e_eBstActrModeLrP_BARR_e_Parking}
    hcSVC_CnsldtnEBST_evt_YeBACR_e_eBstActrModeRfP_TeBARR_e_ActrMode_SvcEnum:
      category=VALUE
      base-type=sint16
      compu {0=Ce_hcSVC_CnsldtnEBST_evt_YeBACR_e_eBstActrModeRfP_BARR_e_None, 1=Ce_hcSVC_CnsldtnEBST_evt_YeBACR_e_eBstActrModeRfP_BARR_e_Braking, 5=Ce_hcSVC_CnsldtnEBST_evt_YeBACR_e_eBstActrModeRfP_BARR_e_SrvRel, 4=Ce_hcSVC_CnsldtnEBST_evt_YeBACR_e_eBstActrModeRfP_BARR_e_Position, 6=Ce_hcSVC_CnsldtnEBST_evt_YeBACR_e_eBstActrModeRfP_BARR_e_FlowCntrl, 2=Ce_hcSVC_CnsldtnEBST_evt_YeBACR_e_eBstActrModeRfP_BARR_e_Parking, 3=Ce_hcSVC_CnsldtnEBST_evt_YeBACR_e_eBstActrModeRfP_BARR_e_Reclamp}
    hcSVC_CnsldtnEBST_evt_YeBACR_e_eBstActrModeRrP_TeBARR_e_ActrMode_SvcEnum:
      category=VALUE
      base-type=sint16
      compu {2=Ce_hcSVC_CnsldtnEBST_evt_YeBACR_e_eBstActrModeRrP_BARR_e_Parking, 0=Ce_hcSVC_CnsldtnEBST_evt_YeBACR_e_eBstActrModeRrP_BARR_e_None, 6=Ce_hcSVC_CnsldtnEBST_evt_YeBACR_e_eBstActrModeRrP_BARR_e_FlowCntrl, 4=Ce_hcSVC_CnsldtnEBST_evt_YeBACR_e_eBstActrModeRrP_BARR_e_Position, 5=Ce_hcSVC_CnsldtnEBST_evt_YeBACR_e_eBstActrModeRrP_BARR_e_SrvRel, 3=Ce_hcSVC_CnsldtnEBST_evt_YeBACR_e_eBstActrModeRrP_BARR_e_Reclamp, 1=Ce_hcSVC_CnsldtnEBST_evt_YeBACR_e_eBstActrModeRrP_BARR_e_Braking}
    hcSVC_CnsldtnEBST_evt_YeBACR_e_eBstBrkCmdTypeLfP_TeBARR_e_BrkCmdTyp_SvcEnum: category=VALUE, base-type=sint16, compu {2=Ce_hcSVC_CnsldtnEBST_evt_YeBACR_e_eBstBrkCmdTypeLfP_BARR_e_TCSActv, 0=Ce_hcSVC_CnsldtnEBST_evt_YeBACR_e_eBstBrkCmdTypeLfP_BARR_e_BaseBrk, 4=Ce_hcSVC_CnsldtnEBST_evt_YeBACR_e_eBstBrkCmdTypeLfP_BARR_e_ESCActv, 3=Ce_hcSVC_CnsldtnEBST_evt_YeBACR_e_eBstBrkCmdTypeLfP_BARR_e_ABSActv, 1=Ce_hcSVC_CnsldtnEBST_evt_YeBACR_e_eBstBrkCmdTypeLfP_BARR_e_DRPActv}
    hcSVC_CnsldtnEBST_evt_YeBACR_e_eBstBrkCmdTypeLrP_TeBARR_e_BrkCmdTyp_SvcEnum: category=VALUE, base-type=sint16, compu {3=Ce_hcSVC_CnsldtnEBST_evt_YeBACR_e_eBstBrkCmdTypeLrP_BARR_e_ABSActv, 2=Ce_hcSVC_CnsldtnEBST_evt_YeBACR_e_eBstBrkCmdTypeLrP_BARR_e_TCSActv, 4=Ce_hcSVC_CnsldtnEBST_evt_YeBACR_e_eBstBrkCmdTypeLrP_BARR_e_ESCActv, 0=Ce_hcSVC_CnsldtnEBST_evt_YeBACR_e_eBstBrkCmdTypeLrP_BARR_e_BaseBrk, 1=Ce_hcSVC_CnsldtnEBST_evt_YeBACR_e_eBstBrkCmdTypeLrP_BARR_e_DRPActv}
    hcSVC_CnsldtnEBST_evt_YeBACR_e_eBstBrkCmdTypeRfP_TeBARR_e_BrkCmdTyp_SvcEnum: category=VALUE, base-type=sint16, compu {2=Ce_hcSVC_CnsldtnEBST_evt_YeBACR_e_eBstBrkCmdTypeRfP_BARR_e_TCSActv, 4=Ce_hcSVC_CnsldtnEBST_evt_YeBACR_e_eBstBrkCmdTypeRfP_BARR_e_ESCActv, 1=Ce_hcSVC_CnsldtnEBST_evt_YeBACR_e_eBstBrkCmdTypeRfP_BARR_e_DRPActv, 3=Ce_hcSVC_CnsldtnEBST_evt_YeBACR_e_eBstBrkCmdTypeRfP_BARR_e_ABSActv, 0=Ce_hcSVC_CnsldtnEBST_evt_YeBACR_e_eBstBrkCmdTypeRfP_BARR_e_BaseBrk}
    hcSVC_CnsldtnEBST_evt_YeBACR_e_eBstBrkCmdTypeRrP_TeBARR_e_BrkCmdTyp_SvcEnum: category=VALUE, base-type=sint16, compu {0=Ce_hcSVC_CnsldtnEBST_evt_YeBACR_e_eBstBrkCmdTypeRrP_BARR_e_BaseBrk, 4=Ce_hcSVC_CnsldtnEBST_evt_YeBACR_e_eBstBrkCmdTypeRrP_BARR_e_ESCActv, 1=Ce_hcSVC_CnsldtnEBST_evt_YeBACR_e_eBstBrkCmdTypeRrP_BARR_e_DRPActv, 2=Ce_hcSVC_CnsldtnEBST_evt_YeBACR_e_eBstBrkCmdTypeRrP_BARR_e_TCSActv, 3=Ce_hcSVC_CnsldtnEBST_evt_YeBACR_e_eBstBrkCmdTypeRrP_BARR_e_ABSActv}
    hcSVC_CnsldtnEBST_evt_YeBACR_e_eBstBrkOprtnRqstP_TeBCSR_e_CCU_BrkOprtnRqst_SvcEnum: category=VALUE, base-type=sint16, compu {0=Ce_hcSVC_CnsldtnEBST_evt_YeBACR_e_eBstBrkOprtnRqstP_BCSR_e_BrkOpRqst_Off, 1=Ce_hcSVC_CnsldtnEBST_evt_YeBACR_e_eBstBrkOprtnRqstP_BCSR_e_BrkOpRqst_On, 2=Ce_hcSVC_CnsldtnEBST_evt_YeBACR_e_eBstBrkOprtnRqstP_BCSR_e_BrkOpRqst_BrakesOnly}
    hcSVC_CnsldtnEBST_evt_YeBACR_e_eBstHydFuncStCmdP_TeBRMR_e_EBCM_eBstSt_SvcEnum:
      category=VALUE
      base-type=sint16
      compu {2=Ce_hcSVC_CnsldtnEBST_evt_YeBACR_e_eBstHydFuncStCmdP_BRMR_e_eBstSt_Failed, 4=Ce_hcSVC_CnsldtnEBST_evt_YeBACR_e_eBstHydFuncStCmdP_BRMR_e_eBstSt_HalfSystem1, 5=Ce_hcSVC_CnsldtnEBST_evt_YeBACR_e_eBstHydFuncStCmdP_BRMR_e_eBstSt_HalfSystem2, 0=Ce_hcSVC_CnsldtnEBST_evt_YeBACR_e_eBstHydFuncStCmdP_BRMR_e_eBstSt_Init, 1=Ce_hcSVC_CnsldtnEBST_evt_YeBACR_e_eBstHydFuncStCmdP_BRMR_e_eBstSt_Normal, 3=Ce_hcSVC_CnsldtnEBST_evt_YeBACR_e_eBstHydFuncStCmdP_BRMR_e_eBstSt_Failed_wIso}
package /SVC_DEF_Hierarchy/SVC_CnsldtnSecEBSTDef
  collection hcSVC_CnsldtnSecEBST: category=SET, element=hcSVC_CnsldtnSecEBST_evt
  sender receiver interface hcSVC_CnsldtnSecEBST_evt
    data hcSVC_CnsldtnSecEBST_evt: type=hcSVC_CnsldtnSecEBST_evt_EventAppType
package /SVC_DEF_Hierarchy/SVC_CnsldtnSecEBSTDef/AppDataType
  5 x application array data type, all with category=ARRAY:
    VaBACR_y_UpIntegrationInputS_VaBACR_y_UpIntegrationInputS
      element hcSVC_CnsldtnSecEBSTVaBACR_y_UpIntegrationInputS_D0S312: category=VALUE, type=BYTE, max-number-of-elements=312
    VaBACR_y_eBstTmSyncMsgS_VaBACR_y_eBstTmSyncMsgS
      element hcSVC_CnsldtnSecEBSTVaBACR_y_eBstTmSyncMsgS_D0S8: category=VALUE, type=BYTE, max-number-of-elements=8
    VaBACR_y_eBstVIN_Arr10_17_S_VaBACR_y_eBstVIN_Arr10_17_S
      element hcSVC_CnsldtnSecEBSTVaBACR_y_eBstVIN_Arr10_17_S_D0S8: category=VALUE, type=BYTE, max-number-of-elements=8
    VaBACR_y_eBstVIN_Arr2_9_S_VaBACR_y_eBstVIN_Arr2_9_S
      element hcSVC_CnsldtnSecEBSTVaBACR_y_eBstVIN_Arr2_9_S_D0S8: category=VALUE, type=BYTE, max-number-of-elements=8
    VaBACR_y_eBstVIN_FirstDigitS_VaBACR_y_eBstVIN_FirstDigitS
      element hcSVC_CnsldtnSecEBSTVaBACR_y_eBstVIN_FirstDigitS_D0S1: category=VALUE, type=BYTE, max-number-of-elements=1
  18 x app type, all with category=VALUE:
    hcSVC_CnsldtnSecEBST_evt_DeBACR_e_eBstLV_LdPrioLvlS_TeLVDR_e_LV_LdPrioLvl_SvcAppEnum
    hcSVC_CnsldtnSecEBST_evt_VeBACR_e_PrimDiagStReqS_TeBACR_e_DiagStSts_SvcAppEnum
    hcSVC_CnsldtnSecEBST_evt_VeBACR_e_eBstBkupPwrModeS_TeVSM_e_SystemPowerMode_SvcAppEnum
    hcSVC_CnsldtnSecEBST_evt_VeBACR_e_eBstBrkSysPwrModeS_TeBCSR_e_BrkSysPwrMode_SvcAppEnum
    hcSVC_CnsldtnSecEBST_evt_VeBACR_e_eBstEPB_CmdS_TePBKR_e_ApplyReleaseReq_SvcAppEnum
    hcSVC_CnsldtnSecEBST_evt_VeBACR_e_eBstPriPwrModeS_TeVSM_e_SystemPowerMode_SvcAppEnum
    hcSVC_CnsldtnSecEBST_evt_VeBACR_e_eBstRplnshTriggerS_TeBARR_e_RplnshTrigger_SvcAppEnum
    hcSVC_CnsldtnSecEBST_evt_VeBACR_e_eBstTransLvrPstnS_TeTRGR_e_TrnLeverPstn_SvcAppEnum
    hcSVC_CnsldtnSecEBST_evt_YeBACR_e_eBstActrModeLfS_TeBARR_e_ActrMode_SvcAppEnum
    hcSVC_CnsldtnSecEBST_evt_YeBACR_e_eBstActrModeLrS_TeBARR_e_ActrMode_SvcAppEnum
    hcSVC_CnsldtnSecEBST_evt_YeBACR_e_eBstActrModeRfS_TeBARR_e_ActrMode_SvcAppEnum
    hcSVC_CnsldtnSecEBST_evt_YeBACR_e_eBstActrModeRrS_TeBARR_e_ActrMode_SvcAppEnum
    hcSVC_CnsldtnSecEBST_evt_YeBACR_e_eBstBrkCmdTypeLfS_TeBARR_e_BrkCmdTyp_SvcAppEnum
    hcSVC_CnsldtnSecEBST_evt_YeBACR_e_eBstBrkCmdTypeLrS_TeBARR_e_BrkCmdTyp_SvcAppEnum
    hcSVC_CnsldtnSecEBST_evt_YeBACR_e_eBstBrkCmdTypeRfS_TeBARR_e_BrkCmdTyp_SvcAppEnum
    hcSVC_CnsldtnSecEBST_evt_YeBACR_e_eBstBrkCmdTypeRrS_TeBARR_e_BrkCmdTyp_SvcAppEnum
    hcSVC_CnsldtnSecEBST_evt_YeBACR_e_eBstBrkOprtnRqstS_TeBCSR_e_CCU_BrkOprtnRqst_SvcAppEnum
    hcSVC_CnsldtnSecEBST_evt_YeBACR_e_eBstHydFuncStCmdS_TeBRMR_e_EBCM_eBstSt_SvcAppEnum
  application record data type hcSVC_CnsldtnSecEBST_evt_EventAppType: category=STRUCTURE
    70 x application record element:
      YeBACR_e_eBstActrModeRfS: category=VALUE, type=hcSVC_CnsldtnSecEBST_evt_YeBACR_e_eBstActrModeRfS_TeBARR_e_ActrMode_SvcAppEnum
      YeBACR_b_eBstPwrMgmtReqS: category=VALUE, type=TbBOOLEAN
      VeBACR_v_eBstWhlSpdRrS: category=VALUE, type=T_v_MetersPerSec
      YeBACR_p_eBstBrkTgtRrS: category=VALUE, type=T_p_bar
      YeBACR_p_eBstBrkTgtRfS: category=VALUE, type=T_p_bar
      VeBACR_b_eBstWhlSpdRrInvS: category=VALUE, type=TbBOOLEAN
      VeBACR_v_eBstWhlSpdLrS: category=VALUE, type=T_v_MetersPerSec
      VeBACR_b_eBstVeh_AxInvS: category=VALUE, type=TbBOOLEAN
      VeBACR_b_eBstRmtPrgActvS: category=VALUE, type=TbBOOLEAN
      YeBACR_e_eBstActrModeLfS: category=VALUE, type=hcSVC_CnsldtnSecEBST_evt_YeBACR_e_eBstActrModeLfS_TeBARR_e_ActrMode_SvcAppEnum
      VeBACR_v_eBstWhlSpdRfS: category=VALUE, type=T_v_MetersPerSec
      VeBACR_a_eBstVehAyS: category=VALUE, type=T_a_MetersPerSec2
      VeBACR_Pct_eBstAccelEffPosS: category=VALUE, type=T_Pct_Percent
      YeBACR_M_eBstTotAxlTrqActS: category=VALUE, type=T_M_NewtonMeters
      VeBACR_b_eBstWhlSpdRfInvS: category=VALUE, type=TbBOOLEAN
      YeBACR_e_eBstActrModeLrS: category=VALUE, type=hcSVC_CnsldtnSecEBST_evt_YeBACR_e_eBstActrModeLrS_TeBARR_e_ActrMode_SvcAppEnum
      VeBACR_b_eBstFuncTstAllwdS: category=VALUE, type=TbBOOLEAN
      VeBACR_e_eBstBrkSysPwrModeS: category=VALUE, type=hcSVC_CnsldtnSecEBST_evt_VeBACR_e_eBstBrkSysPwrModeS_TeBCSR_e_BrkSysPwrMode_SvcAppEnum
      YeBACR_p_eBstBrkTgtLfS: category=VALUE, type=T_p_bar
      YeBACR_e_eBstBrkCmdTypeLrS: category=VALUE, type=hcSVC_CnsldtnSecEBST_evt_YeBACR_e_eBstBrkCmdTypeLrS_TeBARR_e_BrkCmdTyp_SvcAppEnum
      YeBACR_p_eBstBrkTgtLrS: category=VALUE, type=T_p_bar
      VeBACR_b_eBstOAT_InvS: category=VALUE, type=TbBOOLEAN
      YeBACR_e_eBstActrModeRrS: category=VALUE, type=hcSVC_CnsldtnSecEBST_evt_YeBACR_e_eBstActrModeRrS_TeBARR_e_ActrMode_SvcAppEnum
      VeBACR_e_eBstEPB_CmdS: category=VALUE, type=hcSVC_CnsldtnSecEBST_evt_VeBACR_e_eBstEPB_CmdS_TePBKR_e_ApplyReleaseReq_SvcAppEnum
      VeBACR_T_eBstOAT_CorrS: category=VALUE, type=T_T_Celsius
      YeBACR_I_eBstPwrMgmtGenLimS: category=VALUE, type=T_I_Amps
      VeBACR_b_eBstWhlSpdLfInvS: category=VALUE, type=TbBOOLEAN
      VeBACR_F_eBstEPB_StateCmdRtS: category=VALUE, type=T_F_Newtons
      YeBACR_e_eBstBrkCmdTypeLfS: category=VALUE, type=hcSVC_CnsldtnSecEBST_evt_YeBACR_e_eBstBrkCmdTypeLfS_TeBARR_e_BrkCmdTyp_SvcAppEnum
      VeBACR_l_eBstVehOdoBCM_S: category=VALUE, type=T_l_Kilometers
      VeBACR_F_eBstEPB_StateCmdLtS: category=VALUE, type=T_F_Newtons
      VeBACR_v_eBstWhlSpdLfS: category=VALUE, type=T_v_MetersPerSec
      VeBACR_b_eBstWhlSpdLrInvS: category=VALUE, type=TbBOOLEAN
      YeBACR_I_eBstPwrMgmtSinkLimS: category=VALUE, type=T_I_Amps
      YeBACR_a_eBstVeh_AxS: category=VALUE, type=T_a_MetersPerSec2
      YeBACR_e_eBstBrkCmdTypeRrS: category=VALUE, type=hcSVC_CnsldtnSecEBST_evt_YeBACR_e_eBstBrkCmdTypeRrS_TeBARR_e_BrkCmdTyp_SvcAppEnum
      VeBACR_phi_eBstStrWhlAngS: category=VALUE, type=T_phi_Rad
      VeBACR_b_eBstTransSIP_S: category=VALUE, type=TbBOOLEAN
      YeBACR_e_eBstHydFuncStCmdS: category=VALUE, type=hcSVC_CnsldtnSecEBST_evt_YeBACR_e_eBstHydFuncStCmdS_TeBRMR_e_EBCM_eBstSt_SvcAppEnum
      YeBACR_e_eBstBrkCmdTypeRfS: category=VALUE, type=hcSVC_CnsldtnSecEBST_evt_YeBACR_e_eBstBrkCmdTypeRfS_TeBARR_e_BrkCmdTyp_SvcAppEnum
      VeBACR_b_eBstWrmUpCyclCmptS: category=VALUE, type=TbBOOLEAN
      VeBACR_e_eBstTransLvrPstnS: category=VALUE, type=hcSVC_CnsldtnSecEBST_evt_VeBACR_e_eBstTransLvrPstnS_TeTRGR_e_TrnLeverPstn_SvcAppEnum
      VeBACR_b_eBstRnCrnkActBkupS: category=VALUE, type=TbBOOLEAN
      VeBACR_e_eBstPriPwrModeS: category=VALUE, type=hcSVC_CnsldtnSecEBST_evt_VeBACR_e_eBstPriPwrModeS_TeVSM_e_SystemPowerMode_SvcAppEnum
      VaBACR_y_eBstVIN_FirstDigitS: category=ARRAY, type=VaBACR_y_eBstVIN_FirstDigitS_VaBACR_y_eBstVIN_FirstDigitS
      VeBACR_e_eBstBkupPwrModeS: category=VALUE, type=hcSVC_CnsldtnSecEBST_evt_VeBACR_e_eBstBkupPwrModeS_TeVSM_e_SystemPowerMode_SvcAppEnum
      VeBACR_b_PropSysActvS: category=VALUE, type=TbBOOLEAN
      VeBACR_y_eBstVehRegionCodeS: category=VALUE, type=BYTE
      VeBACR_v_eBstVehicleS: category=VALUE, type=T_KPH_UW_07
      VeBACR_b_eBstRnCrnkActPriS: category=VALUE, type=TbBOOLEAN
      VaBACR_y_eBstVIN_Arr2_9_S: category=ARRAY, type=VaBACR_y_eBstVIN_Arr2_9_S_VaBACR_y_eBstVIN_Arr2_9_S
      VaBACR_y_eBstVIN_Arr10_17_S: category=ARRAY, type=VaBACR_y_eBstVIN_Arr10_17_S_VaBACR_y_eBstVIN_Arr10_17_S
      VaBACR_y_eBstTmSyncMsgS: category=ARRAY, type=VaBACR_y_eBstTmSyncMsgS_VaBACR_y_eBstTmSyncMsgS
      VeBACR_V_eBstRplnshVolTrgtS: category=VALUE, type=T_V_Millimeters3
      SSMR_0C5A8001_0D8B8001_QoS: category=VALUE, type=BYTE
      VeBACR_p_eBstBkPrsTgtBaseS: category=VALUE, type=T_p_bar
      YeBACR_e_eBstBrkOprtnRqstS: category=VALUE, type=hcSVC_CnsldtnSecEBST_evt_YeBACR_e_eBstBrkOprtnRqstS_TeBCSR_e_CCU_BrkOprtnRqst_SvcAppEnum
      NeBACR_t_eBstPropSysInactvS: category=VALUE, type=LONGWORD
      NeBACR_b_eBstBrkFdSt2DiagS: category=VALUE, type=TbBOOLEAN
      VeBACR_b_eBstEPB_HpoAvailS: category=VALUE, type=TbBOOLEAN
      NeBACR_b_eBstBrkFdSt1DiagS: category=VALUE, type=TbBOOLEAN
      VeBACR_e_eBstRplnshTriggerS: category=VALUE, type=hcSVC_CnsldtnSecEBST_evt_VeBACR_e_eBstRplnshTriggerS_TeBARR_e_RplnshTrigger_SvcAppEnum
      VaBACR_y_UpIntegrationInputS: category=ARRAY, type=VaBACR_y_UpIntegrationInputS_VaBACR_y_UpIntegrationInputS
      NeBACR_m_eBstVehMassS: category=VALUE, type=T_m_Kilograms
      VeBACR_b_eBstEngStrtrCmdOnS: category=VALUE, type=TbBOOLEAN
      NeBACR_l_eBstFrtTireRadiusS: category=VALUE, type=T_l_Meters
      VeBACR_M_eBstSysLvlBrkTrqS: category=VALUE, type=T_M_NewtonMeters
      VeBACR_e_PrimDiagStReqS: category=VALUE, type=hcSVC_CnsldtnSecEBST_evt_VeBACR_e_PrimDiagStReqS_TeBACR_e_DiagStSts_SvcAppEnum
      VeBACR_b_eBstVehAyInvS: category=VALUE, type=TbBOOLEAN
      DeBACR_e_eBstLV_LdPrioLvlS: category=VALUE, type=hcSVC_CnsldtnSecEBST_evt_DeBACR_e_eBstLV_LdPrioLvlS_TeLVDR_e_LV_LdPrioLvl_SvcAppEnum
package /SVC_DEF_Hierarchy/SVC_CnsldtnSecEBSTDef/ImpDataType
  19 x impl type:
    hcSVC_CnsldtnSecEBST_evt_DeBACR_e_eBstLV_LdPrioLvlS_TeLVDR_e_LV_LdPrioLvl_SvcEnum:
      category=VALUE
      base-type=sint16
      compu {0=Ce_hcSVC_CnsldtnSecEBST_evt_DeBACR_e_eBstLV_LdPrioLvlS_LVDR_e_LdPrioLvl_Norm, 8=Ce_hcSVC_CnsldtnSecEBST_evt_DeBACR_e_eBstLV_LdPrioLvlS_LVDR_e_LdPrioLvl_Ingress, 4=Ce_hcSVC_CnsldtnSecEBST_evt_DeBACR_e_eBstLV_LdPrioLvlS_LVDR_e_LdPrioLvl_MedHi, 7=Ce_hcSVC_CnsldtnSecEBST_evt_DeBACR_e_eBstLV_LdPrioLvlS_LVDR_e_LdPrioLvl_Emergency, 5=Ce_hcSVC_CnsldtnSecEBST_evt_DeBACR_e_eBstLV_LdPrioLvlS_LVDR_e_LdPrioLvl_Hi, 2=Ce_hcSVC_CnsldtnSecEBST_evt_DeBACR_e_eBstLV_LdPrioLvlS_LVDR_e_LdPrioLvl_MedLo, 1=Ce_hcSVC_CnsldtnSecEBST_evt_DeBACR_e_eBstLV_LdPrioLvlS_LVDR_e_LdPrioLvl_Lo, 3=Ce_hcSVC_CnsldtnSecEBST_evt_DeBACR_e_eBstLV_LdPrioLvlS_LVDR_e_LdPrioLvl_Med, 6=Ce_hcSVC_CnsldtnSecEBST_evt_DeBACR_e_eBstLV_LdPrioLvlS_LVDR_e_LdPrioLvl_Critical}
    hcSVC_CnsldtnSecEBST_evt_EventImpType: category=STRUCTURE
      70 x element:
        YeBACR_e_eBstActrModeRfS: implementation-data-type=hcSVC_CnsldtnSecEBST_evt_YeBACR_e_eBstActrModeRfS_TeBARR_e_ActrMode_SvcEnum
        YeBACR_b_eBstPwrMgmtReqS: implementation-data-type=TbBOOLEAN
        VeBACR_v_eBstWhlSpdRrS: implementation-data-type=T_v_MetersPerSec
        YeBACR_p_eBstBrkTgtRrS: implementation-data-type=T_p_bar
        YeBACR_p_eBstBrkTgtRfS: implementation-data-type=T_p_bar
        VeBACR_b_eBstWhlSpdRrInvS: implementation-data-type=TbBOOLEAN
        VeBACR_v_eBstWhlSpdLrS: implementation-data-type=T_v_MetersPerSec
        VeBACR_b_eBstVeh_AxInvS: implementation-data-type=TbBOOLEAN
        VeBACR_b_eBstRmtPrgActvS: implementation-data-type=TbBOOLEAN
        YeBACR_e_eBstActrModeLfS: implementation-data-type=hcSVC_CnsldtnSecEBST_evt_YeBACR_e_eBstActrModeLfS_TeBARR_e_ActrMode_SvcEnum
        VeBACR_v_eBstWhlSpdRfS: implementation-data-type=T_v_MetersPerSec
        VeBACR_a_eBstVehAyS: implementation-data-type=T_a_MetersPerSec2
        VeBACR_Pct_eBstAccelEffPosS: implementation-data-type=T_Pct_Percent
        YeBACR_M_eBstTotAxlTrqActS: implementation-data-type=T_M_NewtonMeters
        VeBACR_b_eBstWhlSpdRfInvS: implementation-data-type=TbBOOLEAN
        YeBACR_e_eBstActrModeLrS: implementation-data-type=hcSVC_CnsldtnSecEBST_evt_YeBACR_e_eBstActrModeLrS_TeBARR_e_ActrMode_SvcEnum
        VeBACR_b_eBstFuncTstAllwdS: implementation-data-type=TbBOOLEAN
        VeBACR_e_eBstBrkSysPwrModeS: implementation-data-type=hcSVC_CnsldtnSecEBST_evt_VeBACR_e_eBstBrkSysPwrModeS_TeBCSR_e_BrkSysPwrMode_SvcEnum
        YeBACR_p_eBstBrkTgtLfS: implementation-data-type=T_p_bar
        YeBACR_e_eBstBrkCmdTypeLrS: implementation-data-type=hcSVC_CnsldtnSecEBST_evt_YeBACR_e_eBstBrkCmdTypeLrS_TeBARR_e_BrkCmdTyp_SvcEnum
        YeBACR_p_eBstBrkTgtLrS: implementation-data-type=T_p_bar
        VeBACR_b_eBstOAT_InvS: implementation-data-type=TbBOOLEAN
        YeBACR_e_eBstActrModeRrS: implementation-data-type=hcSVC_CnsldtnSecEBST_evt_YeBACR_e_eBstActrModeRrS_TeBARR_e_ActrMode_SvcEnum
        VeBACR_e_eBstEPB_CmdS: implementation-data-type=hcSVC_CnsldtnSecEBST_evt_VeBACR_e_eBstEPB_CmdS_TePBKR_e_ApplyReleaseReq_SvcEnum
        VeBACR_T_eBstOAT_CorrS: implementation-data-type=T_T_Celsius
        YeBACR_I_eBstPwrMgmtGenLimS: implementation-data-type=T_I_Amps
        VeBACR_b_eBstWhlSpdLfInvS: implementation-data-type=TbBOOLEAN
        VeBACR_F_eBstEPB_StateCmdRtS: implementation-data-type=T_F_Newtons
        YeBACR_e_eBstBrkCmdTypeLfS: implementation-data-type=hcSVC_CnsldtnSecEBST_evt_YeBACR_e_eBstBrkCmdTypeLfS_TeBARR_e_BrkCmdTyp_SvcEnum
        VeBACR_l_eBstVehOdoBCM_S: implementation-data-type=T_l_Kilometers
        VeBACR_F_eBstEPB_StateCmdLtS: implementation-data-type=T_F_Newtons
        VeBACR_v_eBstWhlSpdLfS: implementation-data-type=T_v_MetersPerSec
        VeBACR_b_eBstWhlSpdLrInvS: implementation-data-type=TbBOOLEAN
        YeBACR_I_eBstPwrMgmtSinkLimS: implementation-data-type=T_I_Amps
        YeBACR_a_eBstVeh_AxS: implementation-data-type=T_a_MetersPerSec2
        YeBACR_e_eBstBrkCmdTypeRrS: implementation-data-type=hcSVC_CnsldtnSecEBST_evt_YeBACR_e_eBstBrkCmdTypeRrS_TeBARR_e_BrkCmdTyp_SvcEnum
        VeBACR_phi_eBstStrWhlAngS: implementation-data-type=T_phi_Rad
        VeBACR_b_eBstTransSIP_S: implementation-data-type=TbBOOLEAN
        YeBACR_e_eBstHydFuncStCmdS: implementation-data-type=hcSVC_CnsldtnSecEBST_evt_YeBACR_e_eBstHydFuncStCmdS_TeBRMR_e_EBCM_eBstSt_SvcEnum
        YeBACR_e_eBstBrkCmdTypeRfS: implementation-data-type=hcSVC_CnsldtnSecEBST_evt_YeBACR_e_eBstBrkCmdTypeRfS_TeBARR_e_BrkCmdTyp_SvcEnum
        VeBACR_b_eBstWrmUpCyclCmptS: implementation-data-type=TbBOOLEAN
        VeBACR_e_eBstTransLvrPstnS: implementation-data-type=hcSVC_CnsldtnSecEBST_evt_VeBACR_e_eBstTransLvrPstnS_TeTRGR_e_TrnLeverPstn_SvcEnum
        VeBACR_b_eBstRnCrnkActBkupS: implementation-data-type=TbBOOLEAN
        VeBACR_e_eBstPriPwrModeS: implementation-data-type=hcSVC_CnsldtnSecEBST_evt_VeBACR_e_eBstPriPwrModeS_TeVSM_e_SystemPowerMode_SvcEnum
        VaBACR_y_eBstVIN_FirstDigitS: category=ARRAY
          element hcSVC_CnsldtnSecEBSTVaBACR_y_eBstVIN_FirstDigitS_D0S1: array-size=1, implementation-data-type=BYTE
        VeBACR_e_eBstBkupPwrModeS: implementation-data-type=hcSVC_CnsldtnSecEBST_evt_VeBACR_e_eBstBkupPwrModeS_TeVSM_e_SystemPowerMode_SvcEnum
        VeBACR_b_PropSysActvS: implementation-data-type=TbBOOLEAN
        VeBACR_y_eBstVehRegionCodeS: implementation-data-type=BYTE
        VeBACR_v_eBstVehicleS: implementation-data-type=T_KPH_UW_07
        VeBACR_b_eBstRnCrnkActPriS: implementation-data-type=TbBOOLEAN
        VaBACR_y_eBstVIN_Arr2_9_S: category=ARRAY
          element hcSVC_CnsldtnSecEBSTVaBACR_y_eBstVIN_Arr2_9_S_D0S8: array-size=8, implementation-data-type=BYTE
        VaBACR_y_eBstVIN_Arr10_17_S: category=ARRAY
          element hcSVC_CnsldtnSecEBSTVaBACR_y_eBstVIN_Arr10_17_S_D0S8: array-size=8, implementation-data-type=BYTE
        VaBACR_y_eBstTmSyncMsgS: category=ARRAY
          element hcSVC_CnsldtnSecEBSTVaBACR_y_eBstTmSyncMsgS_D0S8: array-size=8, implementation-data-type=BYTE
        VeBACR_V_eBstRplnshVolTrgtS: implementation-data-type=T_V_Millimeters3
        SSMR_0C5A8001_0D8B8001_QoS: implementation-data-type=BYTE
        VeBACR_p_eBstBkPrsTgtBaseS: implementation-data-type=T_p_bar
        YeBACR_e_eBstBrkOprtnRqstS: implementation-data-type=hcSVC_CnsldtnSecEBST_evt_YeBACR_e_eBstBrkOprtnRqstS_TeBCSR_e_CCU_BrkOprtnRqst_SvcEnum
        NeBACR_t_eBstPropSysInactvS: implementation-data-type=LONGWORD
        NeBACR_b_eBstBrkFdSt2DiagS: implementation-data-type=TbBOOLEAN
        VeBACR_b_eBstEPB_HpoAvailS: implementation-data-type=TbBOOLEAN
        NeBACR_b_eBstBrkFdSt1DiagS: implementation-data-type=TbBOOLEAN
        VeBACR_e_eBstRplnshTriggerS: implementation-data-type=hcSVC_CnsldtnSecEBST_evt_VeBACR_e_eBstRplnshTriggerS_TeBARR_e_RplnshTrigger_SvcEnum
        VaBACR_y_UpIntegrationInputS: category=ARRAY
          element hcSVC_CnsldtnSecEBSTVaBACR_y_UpIntegrationInputS_D0S312: array-size=312, implementation-data-type=BYTE
        NeBACR_m_eBstVehMassS: implementation-data-type=T_m_Kilograms
        VeBACR_b_eBstEngStrtrCmdOnS: implementation-data-type=TbBOOLEAN
        NeBACR_l_eBstFrtTireRadiusS: implementation-data-type=T_l_Meters
        VeBACR_M_eBstSysLvlBrkTrqS: implementation-data-type=T_M_NewtonMeters
        VeBACR_e_PrimDiagStReqS: implementation-data-type=hcSVC_CnsldtnSecEBST_evt_VeBACR_e_PrimDiagStReqS_TeBACR_e_DiagStSts_SvcEnum
        VeBACR_b_eBstVehAyInvS: implementation-data-type=TbBOOLEAN
        DeBACR_e_eBstLV_LdPrioLvlS: implementation-data-type=hcSVC_CnsldtnSecEBST_evt_DeBACR_e_eBstLV_LdPrioLvlS_TeLVDR_e_LV_LdPrioLvl_SvcEnum
    hcSVC_CnsldtnSecEBST_evt_VeBACR_e_PrimDiagStReqS_TeBACR_e_DiagStSts_SvcEnum:
      category=VALUE
      base-type=sint16
      compu {0=Ce_hcSVC_CnsldtnSecEBST_evt_VeBACR_e_PrimDiagStReqS_BACR_e_DiagSts_NotActv, 4=Ce_hcSVC_CnsldtnSecEBST_evt_VeBACR_e_PrimDiagStReqS_BACR_e_DiagSts_TstCndNtMet, 2=Ce_hcSVC_CnsldtnSecEBST_evt_VeBACR_e_PrimDiagStReqS_BACR_e_DiagSts_TestCmplt, 1=Ce_hcSVC_CnsldtnSecEBST_evt_VeBACR_e_PrimDiagStReqS_BACR_e_DiagSts_TestActv, 3=Ce_hcSVC_CnsldtnSecEBST_evt_VeBACR_e_PrimDiagStReqS_BACR_e_DiagSts_TestFail}
    hcSVC_CnsldtnSecEBST_evt_VeBACR_e_eBstBkupPwrModeS_TeVSM_e_SystemPowerMode_SvcEnum: category=VALUE, base-type=sint16, compu {1=Ce_hcSVC_CnsldtnSecEBST_evt_VeBACR_e_eBstBkupPwrModeS_VSM_PM_ACC, 4=Ce_hcSVC_CnsldtnSecEBST_evt_VeBACR_e_eBstBkupPwrModeS_VSM_PM_PROPULSION, 2=Ce_hcSVC_CnsldtnSecEBST_evt_VeBACR_e_eBstBkupPwrModeS_VSM_PM_RUN, 0=Ce_hcSVC_CnsldtnSecEBST_evt_VeBACR_e_eBstBkupPwrModeS_VSM_PM_OFF, 3=Ce_hcSVC_CnsldtnSecEBST_evt_VeBACR_e_eBstBkupPwrModeS_VSM_PM_START}
    hcSVC_CnsldtnSecEBST_evt_VeBACR_e_eBstBrkSysPwrModeS_TeBCSR_e_BrkSysPwrMode_SvcEnum: category=VALUE, base-type=sint16, compu {1=Ce_hcSVC_CnsldtnSecEBST_evt_VeBACR_e_eBstBrkSysPwrModeS_BCSR_e_BPM_Run, 3=Ce_hcSVC_CnsldtnSecEBST_evt_VeBACR_e_eBstBrkSysPwrModeS_BCSR_e_BPM_ExtendedRun, 2=Ce_hcSVC_CnsldtnSecEBST_evt_VeBACR_e_eBstBrkSysPwrModeS_BCSR_e_BPM_Start, 0=Ce_hcSVC_CnsldtnSecEBST_evt_VeBACR_e_eBstBrkSysPwrModeS_BCSR_e_BPM_Off}
    hcSVC_CnsldtnSecEBST_evt_VeBACR_e_eBstEPB_CmdS_TePBKR_e_ApplyReleaseReq_SvcEnum:
      category=VALUE
      base-type=sint16
      compu {36=Ce_hcSVC_CnsldtnSecEBST_evt_VeBACR_e_eBstEPB_CmdS_PBKR_Req_DynamicApply, 4=Ce_hcSVC_CnsldtnSecEBST_evt_VeBACR_e_eBstEPB_CmdS_PBKR_Req_RollerBenchApply, 33=Ce_hcSVC_CnsldtnSecEBST_evt_VeBACR_e_eBstEPB_CmdS_PBKR_Req_AssemblyCheck, 35=Ce_hcSVC_CnsldtnSecEBST_evt_VeBACR_e_eBstEPB_CmdS_PBKR_Req_ForceControl, 18=Ce_hcSVC_CnsldtnSecEBST_evt_VeBACR_e_eBstEPB_CmdS_PBKR_Req_Release, 2=Ce_hcSVC_CnsldtnSecEBST_evt_VeBACR_e_eBstEPB_CmdS_PBKR_Req_ParkApply, 34=Ce_hcSVC_CnsldtnSecEBST_evt_VeBACR_e_eBstEPB_CmdS_PBKR_Req_ServiceRelease, 37=Ce_hcSVC_CnsldtnSecEBST_evt_VeBACR_e_eBstEPB_CmdS_PBKR_Req_PadAdjustment, 0=Ce_hcSVC_CnsldtnSecEBST_evt_VeBACR_e_eBstEPB_CmdS_PBKR_Req_None, 3=Ce_hcSVC_CnsldtnSecEBST_evt_VeBACR_e_eBstEPB_CmdS_PBKR_Req_MaxApply}
    hcSVC_CnsldtnSecEBST_evt_VeBACR_e_eBstPriPwrModeS_TeVSM_e_SystemPowerMode_SvcEnum: category=VALUE, base-type=sint16, compu {2=Ce_hcSVC_CnsldtnSecEBST_evt_VeBACR_e_eBstPriPwrModeS_VSM_PM_RUN, 3=Ce_hcSVC_CnsldtnSecEBST_evt_VeBACR_e_eBstPriPwrModeS_VSM_PM_START, 4=Ce_hcSVC_CnsldtnSecEBST_evt_VeBACR_e_eBstPriPwrModeS_VSM_PM_PROPULSION, 0=Ce_hcSVC_CnsldtnSecEBST_evt_VeBACR_e_eBstPriPwrModeS_VSM_PM_OFF, 1=Ce_hcSVC_CnsldtnSecEBST_evt_VeBACR_e_eBstPriPwrModeS_VSM_PM_ACC}
    hcSVC_CnsldtnSecEBST_evt_VeBACR_e_eBstRplnshTriggerS_TeBARR_e_RplnshTrigger_SvcEnum: category=VALUE, base-type=sint16, compu {2=Ce_hcSVC_CnsldtnSecEBST_evt_VeBACR_e_eBstRplnshTriggerS_BARR_e_RplnshStndrd, 0=Ce_hcSVC_CnsldtnSecEBST_evt_VeBACR_e_eBstRplnshTriggerS_BARR_e_RplnshNoAction, 1=Ce_hcSVC_CnsldtnSecEBST_evt_VeBACR_e_eBstRplnshTriggerS_BARR_e_RplnshAbort, 3=Ce_hcSVC_CnsldtnSecEBST_evt_VeBACR_e_eBstRplnshTriggerS_BARR_e_RplnshCmfrt}
    hcSVC_CnsldtnSecEBST_evt_VeBACR_e_eBstTransLvrPstnS_TeTRGR_e_TrnLeverPstn_SvcEnum:
      category=VALUE
      base-type=sint16
      compu {11=Ce_hcSVC_CnsldtnSecEBST_evt_VeBACR_e_eBstTransLvrPstnS_TRGR_e_ForwardRangeH, 12=Ce_hcSVC_CnsldtnSecEBST_evt_VeBACR_e_eBstTransLvrPstnS_TRGR_e_ForwardRangeI, 13=Ce_hcSVC_CnsldtnSecEBST_evt_VeBACR_e_eBstTransLvrPstnS_TRGR_e_ForwardRangeJ, 0=Ce_hcSVC_CnsldtnSecEBST_evt_VeBACR_e_eBstTransLvrPstnS_TRGR_e_BetweenRanges, 7=Ce_hcSVC_CnsldtnSecEBST_evt_VeBACR_e_eBstTransLvrPstnS_TRGR_e_ForwardRangeD, 8=Ce_hcSVC_CnsldtnSecEBST_evt_VeBACR_e_eBstTransLvrPstnS_TRGR_e_ForwardRangeE, 9=Ce_hcSVC_CnsldtnSecEBST_evt_VeBACR_e_eBstTransLvrPstnS_TRGR_e_ForwardRangeF, 10=Ce_hcSVC_CnsldtnSecEBST_evt_VeBACR_e_eBstTransLvrPstnS_TRGR_e_ForwardRangeG, 1=Ce_hcSVC_CnsldtnSecEBST_evt_VeBACR_e_eBstTransLvrPstnS_TRGR_e_ParkRange, 3=Ce_hcSVC_CnsldtnSecEBST_evt_VeBACR_e_eBstTransLvrPstnS_TRGR_e_NeutralRange, 14=Ce_hcSVC_CnsldtnSecEBST_evt_VeBACR_e_eBstTransLvrPstnS_TRGR_e_LeverPstnUnknown, 2=Ce_hcSVC_CnsldtnSecEBST_evt_VeBACR_e_eBstTransLvrPstnS_TRGR_e_ReverseRange, 4=Ce_hcSVC_CnsldtnSecEBST_evt_VeBACR_e_eBstTransLvrPstnS_TRGR_e_ForwardRangeA, 5=Ce_hcSVC_CnsldtnSecEBST_evt_VeBACR_e_eBstTransLvrPstnS_TRGR_e_ForwardRangeB, 6=Ce_hcSVC_CnsldtnSecEBST_evt_VeBACR_e_eBstTransLvrPstnS_TRGR_e_ForwardRangeC, 15=Ce_hcSVC_CnsldtnSecEBST_evt_VeBACR_e_eBstTransLvrPstnS_TRGR_Cnt_TrnLeverPstnSize}
    hcSVC_CnsldtnSecEBST_evt_YeBACR_e_eBstActrModeLfS_TeBARR_e_ActrMode_SvcEnum:
      category=VALUE
      base-type=sint16
      compu {0=Ce_hcSVC_CnsldtnSecEBST_evt_YeBACR_e_eBstActrModeLfS_BARR_e_None, 5=Ce_hcSVC_CnsldtnSecEBST_evt_YeBACR_e_eBstActrModeLfS_BARR_e_SrvRel, 6=Ce_hcSVC_CnsldtnSecEBST_evt_YeBACR_e_eBstActrModeLfS_BARR_e_FlowCntrl, 2=Ce_hcSVC_CnsldtnSecEBST_evt_YeBACR_e_eBstActrModeLfS_BARR_e_Parking, 4=Ce_hcSVC_CnsldtnSecEBST_evt_YeBACR_e_eBstActrModeLfS_BARR_e_Position, 3=Ce_hcSVC_CnsldtnSecEBST_evt_YeBACR_e_eBstActrModeLfS_BARR_e_Reclamp, 1=Ce_hcSVC_CnsldtnSecEBST_evt_YeBACR_e_eBstActrModeLfS_BARR_e_Braking}
    hcSVC_CnsldtnSecEBST_evt_YeBACR_e_eBstActrModeLrS_TeBARR_e_ActrMode_SvcEnum:
      category=VALUE
      base-type=sint16
      compu {1=Ce_hcSVC_CnsldtnSecEBST_evt_YeBACR_e_eBstActrModeLrS_BARR_e_Braking, 5=Ce_hcSVC_CnsldtnSecEBST_evt_YeBACR_e_eBstActrModeLrS_BARR_e_SrvRel, 3=Ce_hcSVC_CnsldtnSecEBST_evt_YeBACR_e_eBstActrModeLrS_BARR_e_Reclamp, 2=Ce_hcSVC_CnsldtnSecEBST_evt_YeBACR_e_eBstActrModeLrS_BARR_e_Parking, 4=Ce_hcSVC_CnsldtnSecEBST_evt_YeBACR_e_eBstActrModeLrS_BARR_e_Position, 6=Ce_hcSVC_CnsldtnSecEBST_evt_YeBACR_e_eBstActrModeLrS_BARR_e_FlowCntrl, 0=Ce_hcSVC_CnsldtnSecEBST_evt_YeBACR_e_eBstActrModeLrS_BARR_e_None}
    hcSVC_CnsldtnSecEBST_evt_YeBACR_e_eBstActrModeRfS_TeBARR_e_ActrMode_SvcEnum:
      category=VALUE
      base-type=sint16
      compu {0=Ce_hcSVC_CnsldtnSecEBST_evt_YeBACR_e_eBstActrModeRfS_BARR_e_None, 2=Ce_hcSVC_CnsldtnSecEBST_evt_YeBACR_e_eBstActrModeRfS_BARR_e_Parking, 5=Ce_hcSVC_CnsldtnSecEBST_evt_YeBACR_e_eBstActrModeRfS_BARR_e_SrvRel, 3=Ce_hcSVC_CnsldtnSecEBST_evt_YeBACR_e_eBstActrModeRfS_BARR_e_Reclamp, 1=Ce_hcSVC_CnsldtnSecEBST_evt_YeBACR_e_eBstActrModeRfS_BARR_e_Braking, 6=Ce_hcSVC_CnsldtnSecEBST_evt_YeBACR_e_eBstActrModeRfS_BARR_e_FlowCntrl, 4=Ce_hcSVC_CnsldtnSecEBST_evt_YeBACR_e_eBstActrModeRfS_BARR_e_Position}
    hcSVC_CnsldtnSecEBST_evt_YeBACR_e_eBstActrModeRrS_TeBARR_e_ActrMode_SvcEnum:
      category=VALUE
      base-type=sint16
      compu {4=Ce_hcSVC_CnsldtnSecEBST_evt_YeBACR_e_eBstActrModeRrS_BARR_e_Position, 3=Ce_hcSVC_CnsldtnSecEBST_evt_YeBACR_e_eBstActrModeRrS_BARR_e_Reclamp, 1=Ce_hcSVC_CnsldtnSecEBST_evt_YeBACR_e_eBstActrModeRrS_BARR_e_Braking, 6=Ce_hcSVC_CnsldtnSecEBST_evt_YeBACR_e_eBstActrModeRrS_BARR_e_FlowCntrl, 2=Ce_hcSVC_CnsldtnSecEBST_evt_YeBACR_e_eBstActrModeRrS_BARR_e_Parking, 0=Ce_hcSVC_CnsldtnSecEBST_evt_YeBACR_e_eBstActrModeRrS_BARR_e_None, 5=Ce_hcSVC_CnsldtnSecEBST_evt_YeBACR_e_eBstActrModeRrS_BARR_e_SrvRel}
    hcSVC_CnsldtnSecEBST_evt_YeBACR_e_eBstBrkCmdTypeLfS_TeBARR_e_BrkCmdTyp_SvcEnum:
      category=VALUE
      base-type=sint16
      compu {2=Ce_hcSVC_CnsldtnSecEBST_evt_YeBACR_e_eBstBrkCmdTypeLfS_BARR_e_TCSActv, 0=Ce_hcSVC_CnsldtnSecEBST_evt_YeBACR_e_eBstBrkCmdTypeLfS_BARR_e_BaseBrk, 4=Ce_hcSVC_CnsldtnSecEBST_evt_YeBACR_e_eBstBrkCmdTypeLfS_BARR_e_ESCActv, 3=Ce_hcSVC_CnsldtnSecEBST_evt_YeBACR_e_eBstBrkCmdTypeLfS_BARR_e_ABSActv, 1=Ce_hcSVC_CnsldtnSecEBST_evt_YeBACR_e_eBstBrkCmdTypeLfS_BARR_e_DRPActv}
    hcSVC_CnsldtnSecEBST_evt_YeBACR_e_eBstBrkCmdTypeLrS_TeBARR_e_BrkCmdTyp_SvcEnum:
      category=VALUE
      base-type=sint16
      compu {3=Ce_hcSVC_CnsldtnSecEBST_evt_YeBACR_e_eBstBrkCmdTypeLrS_BARR_e_ABSActv, 2=Ce_hcSVC_CnsldtnSecEBST_evt_YeBACR_e_eBstBrkCmdTypeLrS_BARR_e_TCSActv, 4=Ce_hcSVC_CnsldtnSecEBST_evt_YeBACR_e_eBstBrkCmdTypeLrS_BARR_e_ESCActv, 1=Ce_hcSVC_CnsldtnSecEBST_evt_YeBACR_e_eBstBrkCmdTypeLrS_BARR_e_DRPActv, 0=Ce_hcSVC_CnsldtnSecEBST_evt_YeBACR_e_eBstBrkCmdTypeLrS_BARR_e_BaseBrk}
    hcSVC_CnsldtnSecEBST_evt_YeBACR_e_eBstBrkCmdTypeRfS_TeBARR_e_BrkCmdTyp_SvcEnum:
      category=VALUE
      base-type=sint16
      compu {1=Ce_hcSVC_CnsldtnSecEBST_evt_YeBACR_e_eBstBrkCmdTypeRfS_BARR_e_DRPActv, 2=Ce_hcSVC_CnsldtnSecEBST_evt_YeBACR_e_eBstBrkCmdTypeRfS_BARR_e_TCSActv, 4=Ce_hcSVC_CnsldtnSecEBST_evt_YeBACR_e_eBstBrkCmdTypeRfS_BARR_e_ESCActv, 3=Ce_hcSVC_CnsldtnSecEBST_evt_YeBACR_e_eBstBrkCmdTypeRfS_BARR_e_ABSActv, 0=Ce_hcSVC_CnsldtnSecEBST_evt_YeBACR_e_eBstBrkCmdTypeRfS_BARR_e_BaseBrk}
    hcSVC_CnsldtnSecEBST_evt_YeBACR_e_eBstBrkCmdTypeRrS_TeBARR_e_BrkCmdTyp_SvcEnum:
      category=VALUE
      base-type=sint16
      compu {0=Ce_hcSVC_CnsldtnSecEBST_evt_YeBACR_e_eBstBrkCmdTypeRrS_BARR_e_BaseBrk, 1=Ce_hcSVC_CnsldtnSecEBST_evt_YeBACR_e_eBstBrkCmdTypeRrS_BARR_e_DRPActv, 4=Ce_hcSVC_CnsldtnSecEBST_evt_YeBACR_e_eBstBrkCmdTypeRrS_BARR_e_ESCActv, 2=Ce_hcSVC_CnsldtnSecEBST_evt_YeBACR_e_eBstBrkCmdTypeRrS_BARR_e_TCSActv, 3=Ce_hcSVC_CnsldtnSecEBST_evt_YeBACR_e_eBstBrkCmdTypeRrS_BARR_e_ABSActv}
    hcSVC_CnsldtnSecEBST_evt_YeBACR_e_eBstBrkOprtnRqstS_TeBCSR_e_CCU_BrkOprtnRqst_SvcEnum: category=VALUE, base-type=sint16, compu {0=Ce_hcSVC_CnsldtnSecEBST_evt_YeBACR_e_eBstBrkOprtnRqstS_BCSR_e_BrkOpRqst_Off, 1=Ce_hcSVC_CnsldtnSecEBST_evt_YeBACR_e_eBstBrkOprtnRqstS_BCSR_e_BrkOpRqst_On, 2=Ce_hcSVC_CnsldtnSecEBST_evt_YeBACR_e_eBstBrkOprtnRqstS_BCSR_e_BrkOpRqst_BrakesOnly}
    hcSVC_CnsldtnSecEBST_evt_YeBACR_e_eBstHydFuncStCmdS_TeBRMR_e_EBCM_eBstSt_SvcEnum:
      category=VALUE
      base-type=sint16
      compu {4=Ce_hcSVC_CnsldtnSecEBST_evt_YeBACR_e_eBstHydFuncStCmdS_BRMR_e_eBstSt_HalfSystem1, 2=Ce_hcSVC_CnsldtnSecEBST_evt_YeBACR_e_eBstHydFuncStCmdS_BRMR_e_eBstSt_Failed, 1=Ce_hcSVC_CnsldtnSecEBST_evt_YeBACR_e_eBstHydFuncStCmdS_BRMR_e_eBstSt_Normal, 0=Ce_hcSVC_CnsldtnSecEBST_evt_YeBACR_e_eBstHydFuncStCmdS_BRMR_e_eBstSt_Init, 5=Ce_hcSVC_CnsldtnSecEBST_evt_YeBACR_e_eBstHydFuncStCmdS_BRMR_e_eBstSt_HalfSystem2, 3=Ce_hcSVC_CnsldtnSecEBST_evt_YeBACR_e_eBstHydFuncStCmdS_BRMR_e_eBstSt_Failed_wIso}
package /SVC_DEF_Hierarchy/SVC_SYS_ARPLearningDef
  collection ARPLearning: category=SET, element=ARPLearning_Evt
  sender receiver interface ARPLearning_Evt
    data ARPLearning_Evt: sw-impl-policy=QUEUED, type=ARPLearning_Evt_EventAppType
package /SVC_DEF_Hierarchy/SVC_SYS_ARPLearningDef/AppDataType
  application record data type ARPLearning_Evt_EventAppType: category=STRUCTURE
    application record element LearningEnabled: category=VALUE, type=ApplicationDataTypes/AppUint8
package /SVC_DEF_Hierarchy/SVC_SYS_ARPLearningDef/ImpDataType
  impl type ARPLearning_Evt_EventImpType: category=STRUCTURE
    element LearningEnabled: implementation-data-type=TYPES_Library/ImpUint8
package /SVC_DEF_Hierarchy/SVC_SYS_MechatronicsT1S_Eth2_PwrMgrHeartbeatDefTx
  collection MechatronicsT1S_Eth2_PwrMgrHeartbeatTx: category=SET, element=MechatronicsT1S_Eth2_PwrMgrHeartbeatTx_Evt
  sender receiver interface MechatronicsT1S_Eth2_PwrMgrHeartbeatTx_Evt: meta-data-item-set{data-element=MechatronicsT1S_Eth2_PwrMgrHeartbeatTx_Evt, meta-data-item=length=10}
    data MechatronicsT1S_Eth2_PwrMgrHeartbeatTx_Evt: sw-impl-policy=QUEUED, type=MechatronicsT1S_Eth2_PwrMgrHeartbeatTx_Evt_EventAppType
package /SVC_DEF_Hierarchy/SVC_SYS_MechatronicsT1S_Eth2_PwrMgrHeartbeatDefTx/AppDataType
  application record data type MechatronicsT1S_Eth2_PwrMgrHeartbeatTx_Evt_EventAppType: category=STRUCTURE
    application record element SrcPMId: category=VALUE, type=AppUint32
    application record element HrtBtCntr: category=VALUE, type=AppUint32
    application record element NmbrPrfAct: category=VALUE, type=ApplicationDataTypes/AppUint16
package /SVC_DEF_Hierarchy/SVC_SYS_MechatronicsT1S_Eth2_PwrMgrHeartbeatDefTx/ImpDataType
  impl type MechatronicsT1S_Eth2_PwrMgrHeartbeatTx_Evt_EventImpType: category=STRUCTURE
    element SrcPMId: implementation-data-type=TYPES_Library/ImpUint32
    element HrtBtCntr: implementation-data-type=TYPES_Library/ImpUint32
    element NmbrPrfAct: implementation-data-type=TYPES_Library/ImpUint16
package /SVC_DEF_Hierarchy/SVC_SYS_MechatronicsT1S_Eth2_PwrMgrWakeupDefTx
  collection MechatronicsT1S_Eth2_PwrMgrWakeupTx: category=SET, element=MechatronicsT1S_Eth2_PwrMgrWakeupTx_Evt
  sender receiver interface MechatronicsT1S_Eth2_PwrMgrWakeupTx_Evt: meta-data-item-set{data-element=MechatronicsT1S_Eth2_PwrMgrWakeupTx_Evt, meta-data-item=length=10}
    data MechatronicsT1S_Eth2_PwrMgrWakeupTx_Evt: sw-impl-policy=QUEUED, type=MechatronicsT1S_Eth2_PwrMgrWakeupTx_Evt_EventAppType
package /SVC_DEF_Hierarchy/SVC_SYS_MechatronicsT1S_Eth2_PwrMgrWakeupDefTx/AppDataType
  application array data type WakeupFrameA_WakeupFrameA: category=ARRAY
    element MechatronicsT1S_Eth2_PwrMgrWakeupTxWakeupFrameA_D0S8: category=VALUE, type=ApplicationDataTypes/AppUint8, max-number-of-elements=8
  application array data type WakeupFrameB_WakeupFrameB: category=ARRAY
    element MechatronicsT1S_Eth2_PwrMgrWakeupTxWakeupFrameB_D0S8: category=VALUE, type=ApplicationDataTypes/AppUint8, max-number-of-elements=8
  application array data type WakeupFrameC_WakeupFrameC: category=ARRAY
    element MechatronicsT1S_Eth2_PwrMgrWakeupTxWakeupFrameC_D0S8: category=VALUE, type=ApplicationDataTypes/AppUint8, max-number-of-elements=8
  application record data type MechatronicsT1S_Eth2_PwrMgrWakeupTx_Evt_EventAppType: category=STRUCTURE
    4 x application record element:
      SrcPMId: category=VALUE, type=AppUint32
      WakeupFrameA: category=ARRAY, type=AppDataType/WakeupFrameA_WakeupFrameA
      WakeupFrameB: category=ARRAY, type=AppDataType/WakeupFrameB_WakeupFrameB
      WakeupFrameC: category=ARRAY, type=AppDataType/WakeupFrameC_WakeupFrameC
package /SVC_DEF_Hierarchy/SVC_SYS_MechatronicsT1S_Eth2_PwrMgrWakeupDefTx/ImpDataType
  impl type MechatronicsT1S_Eth2_PwrMgrWakeupTx_Evt_EventImpType: category=STRUCTURE
    4 x element:
      SrcPMId: implementation-data-type=TYPES_Library/ImpUint32
      WakeupFrameA: category=ARRAY
        element MechatronicsT1S_Eth2_PwrMgrWakeupTxWakeupFrameA_D0S8: array-size=8, implementation-data-type=TYPES_Library/ImpUint8
      WakeupFrameB: category=ARRAY
        element MechatronicsT1S_Eth2_PwrMgrWakeupTxWakeupFrameB_D0S8: array-size=8, implementation-data-type=TYPES_Library/ImpUint8
      WakeupFrameC: category=ARRAY
        element MechatronicsT1S_Eth2_PwrMgrWakeupTxWakeupFrameC_D0S8: array-size=8, implementation-data-type=TYPES_Library/ImpUint8
package /SVC_DEF_Hierarchy/SVC_SYS_MechatronicsT1S_Eth2_SwMgrInfoDefRx
  collection MechatronicsT1S_Eth2_SwMgrInfoRx: category=SET, element=MechatronicsT1S_Eth2_SwMgrInfoRx_Evt
  sender receiver interface MechatronicsT1S_Eth2_SwMgrInfoRx_Evt: meta-data-item-set{data-element=MechatronicsT1S_Eth2_SwMgrInfoRx_Evt, meta-data-item=length=10}
    data MechatronicsT1S_Eth2_SwMgrInfoRx_Evt: sw-impl-policy=QUEUED, type=MechatronicsT1S_Eth2_SwMgrInfoRx_Evt_EventAppType
package /SVC_DEF_Hierarchy/SVC_SYS_MechatronicsT1S_Eth2_SwMgrInfoDefRx/AppDataType
  application array data type ProfileRequest_ProfileRequestPayLoad: category=ARRAY
    element MechatronicsT1S_Eth2_SwMgrInfoRxProfileRequest_D0S115: category=STRUCTURE, type=AppDataType/ProfileRequestPayLoadDataType_SvcAppStruct, array-size-semantics=VARIABLE-SIZE, max-number-of-elements=100
  application array data type RequestStatusProfileState_RequestStatusProfileStatePayLoad: category=ARRAY
    element MechatronicsT1S_Eth2_SwMgrInfoRxRequestStatusProfileState_D0S98: category=STRUCTURE, type=AppDataType/RequestStatusProfileStatePayLoadDataType_SvcAppStruct, array-size-semantics=VARIABLE-SIZE, max-number-of-elements=100
  5 x application record data type, all with category=STRUCTURE:
    MechatronicsT1S_Eth2_SwMgrInfoRx_Evt_EventAppType
      6 x application record element:
        PMSrcId: category=VALUE, type=AppUint32
        PMDestId: category=VALUE, type=AppUint32
        PR_MsgType: category=VALUE, type=ApplicationDataTypes/AppUint8
        ProfileRequest: category=STRUCTURE, type=AppDataType/ProfileRequestDataType_SvcAppStruct
        RSPS_MsgType: category=VALUE, type=ApplicationDataTypes/AppUint8
        RequestStatusProfileState: category=STRUCTURE, type=AppDataType/RequestStatusProfileStateDataType_SvcAppStruct
    ProfileRequestDataType_SvcAppStruct
      application record element Size_Indicator: category=VALUE, type=ApplicationDataTypes/AppUint16
      application record element ProfileRequestPayLoad: category=ARRAY, type=AppDataType/ProfileRequest_ProfileRequestPayLoad
    ProfileRequestPayLoadDataType_SvcAppStruct
      application record element ProfileID_SWID: category=VALUE, type=AppUint32
      application record element ProfileID_ProfileNumber: category=VALUE, type=ApplicationDataTypes/AppUint8
      application record element RequestType: category=VALUE, type=ApplicationDataTypes/AppUint8
    RequestStatusProfileStateDataType_SvcAppStruct
      application record element Size_Indicator: category=VALUE, type=ApplicationDataTypes/AppUint16
      application record element RequestStatusProfileStatePayLoad: category=ARRAY, type=AppDataType/RequestStatusProfileState_RequestStatusProfileStatePayLoad
    RequestStatusProfileStatePayLoadDataType_SvcAppStruct
      4 x application record element, all with category=VALUE:
        ProfileID_SWID: type=AppUint32
        ProfileID_ProfileNumber: type=ApplicationDataTypes/AppUint8
        RequestStatus: type=ApplicationDataTypes/AppUint8
        ProfileStatus: type=ApplicationDataTypes/AppUint8
package /SVC_DEF_Hierarchy/SVC_SYS_MechatronicsT1S_Eth2_SwMgrInfoDefRx/ImpDataType
  5 x impl type, all with category=STRUCTURE:
    MechatronicsT1S_Eth2_SwMgrInfoRx_Evt_EventImpType
      6 x element, all with category=TYPE_REFERENCE:
        PMSrcId: implementation-data-type=TYPES_Library/ImpUint32
        PMDestId: implementation-data-type=TYPES_Library/ImpUint32
        PR_MsgType: implementation-data-type=TYPES_Library/ImpUint8
        ProfileRequest: implementation-data-type=ImpDataType/ProfileRequestDataType_SvcStruct
        RSPS_MsgType: implementation-data-type=TYPES_Library/ImpUint8
        RequestStatusProfileState: implementation-data-type=ImpDataType/RequestStatusProfileStateDataType_SvcStruct
    ProfileRequestDataType_SvcStruct: dynamic-array-size-profile=VSA_LINEAR
      element Size_Indicator: implementation-data-type=TYPES_Library/ImpUint16
      element ProfileRequestPayLoad: category=ARRAY
        element MechatronicsT1S_Eth2_SwMgrInfoRxProfileRequest_D0S115: array-size=100, array-size-handling=ALL-INDICES-SAME-ARRAY-SIZE, array-size-semantics=VARIABLE-SIZE, implementation-data-type=ImpDataType/ProfileRequestPayLoadDataType_SvcStruct
    ProfileRequestPayLoadDataType_SvcStruct
      element ProfileID_SWID: implementation-data-type=TYPES_Library/ImpUint32
      element ProfileID_ProfileNumber: implementation-data-type=TYPES_Library/ImpUint8
      element RequestType: implementation-data-type=TYPES_Library/ImpUint8
    RequestStatusProfileStateDataType_SvcStruct: dynamic-array-size-profile=VSA_LINEAR
      element Size_Indicator: implementation-data-type=TYPES_Library/ImpUint16
      element RequestStatusProfileStatePayLoad: category=ARRAY
        element MechatronicsT1S_Eth2_SwMgrInfoRxRequestStatusProfileState_D0S98: array-size=100, array-size-handling=ALL-INDICES-SAME-ARRAY-SIZE, array-size-semantics=VARIABLE-SIZE, implementation-data-type=ImpDataType/RequestStatusProfileStatePayLoadDataType_SvcStruct
    RequestStatusProfileStatePayLoadDataType_SvcStruct
      4 x element, all with category=TYPE_REFERENCE:
        ProfileID_SWID: implementation-data-type=TYPES_Library/ImpUint32
        ProfileID_ProfileNumber: implementation-data-type=TYPES_Library/ImpUint8
        RequestStatus: implementation-data-type=TYPES_Library/ImpUint8
        ProfileStatus: implementation-data-type=TYPES_Library/ImpUint8
package /SVC_DEF_Hierarchy/SVC_SYS_MechatronicsT1S_Eth2_SwMgrInfoDefTx
  collection MechatronicsT1S_Eth2_SwMgrInfoTx: category=SET, element=MechatronicsT1S_Eth2_SwMgrInfoTx_Evt
  sender receiver interface MechatronicsT1S_Eth2_SwMgrInfoTx_Evt: meta-data-item-set{data-element=MechatronicsT1S_Eth2_SwMgrInfoTx_Evt, meta-data-item=length=10}
    data MechatronicsT1S_Eth2_SwMgrInfoTx_Evt: sw-impl-policy=QUEUED, type=MechatronicsT1S_Eth2_SwMgrInfoTx_Evt_EventAppType
package /SVC_DEF_Hierarchy/SVC_SYS_MechatronicsT1S_Eth2_SwMgrInfoDefTx/AppDataType
  application array data type ProfileRequest_ProfileRequestPayLoad: category=ARRAY
    element MechatronicsT1S_Eth2_SwMgrInfoTxProfileRequest_D0S115: category=STRUCTURE, type=AppDataType/ProfileRequestPayLoadDataType_SvcAppStruct, array-size-semantics=VARIABLE-SIZE, max-number-of-elements=100
  application array data type RequestStatusProfileState_RequestStatusProfileStatePayLoad: category=ARRAY
    element MechatronicsT1S_Eth2_SwMgrInfoTxRequestStatusProfileState_D0S98: category=STRUCTURE, type=AppDataType/RequestStatusProfileStatePayLoadDataType_SvcAppStruct, array-size-semantics=VARIABLE-SIZE, max-number-of-elements=100
  5 x application record data type, all with category=STRUCTURE:
    MechatronicsT1S_Eth2_SwMgrInfoTx_Evt_EventAppType
      6 x application record element:
        PMSrcId: category=VALUE, type=AppUint32
        PMDestId: category=VALUE, type=AppUint32
        PR_MsgType: category=VALUE, type=ApplicationDataTypes/AppUint8
        ProfileRequest: category=STRUCTURE, type=AppDataType/ProfileRequestDataType_SvcAppStruct
        RSPS_MsgType: category=VALUE, type=ApplicationDataTypes/AppUint8
        RequestStatusProfileState: category=STRUCTURE, type=AppDataType/RequestStatusProfileStateDataType_SvcAppStruct
    ProfileRequestDataType_SvcAppStruct
      application record element Size_Indicator: category=VALUE, type=ApplicationDataTypes/AppUint16
      application record element ProfileRequestPayLoad: category=ARRAY, type=AppDataType/ProfileRequest_ProfileRequestPayLoad
    ProfileRequestPayLoadDataType_SvcAppStruct
      application record element ProfileID_SWID: category=VALUE, type=AppUint32
      application record element ProfileID_ProfileNumber: category=VALUE, type=ApplicationDataTypes/AppUint8
      application record element RequestType: category=VALUE, type=ApplicationDataTypes/AppUint8
    RequestStatusProfileStateDataType_SvcAppStruct
      application record element Size_Indicator: category=VALUE, type=ApplicationDataTypes/AppUint16
      application record element RequestStatusProfileStatePayLoad: category=ARRAY, type=AppDataType/RequestStatusProfileState_RequestStatusProfileStatePayLoad
    RequestStatusProfileStatePayLoadDataType_SvcAppStruct
      4 x application record element, all with category=VALUE:
        ProfileID_SWID: type=AppUint32
        ProfileID_ProfileNumber: type=ApplicationDataTypes/AppUint8
        RequestStatus: type=ApplicationDataTypes/AppUint8
        ProfileStatus: type=ApplicationDataTypes/AppUint8
package /SVC_DEF_Hierarchy/SVC_SYS_MechatronicsT1S_Eth2_SwMgrInfoDefTx/ImpDataType
  5 x impl type, all with category=STRUCTURE:
    MechatronicsT1S_Eth2_SwMgrInfoTx_Evt_EventImpType
      6 x element, all with category=TYPE_REFERENCE:
        PMSrcId: implementation-data-type=TYPES_Library/ImpUint32
        PMDestId: implementation-data-type=TYPES_Library/ImpUint32
        PR_MsgType: implementation-data-type=TYPES_Library/ImpUint8
        ProfileRequest: implementation-data-type=ImpDataType/ProfileRequestDataType_SvcStruct
        RSPS_MsgType: implementation-data-type=TYPES_Library/ImpUint8
        RequestStatusProfileState: implementation-data-type=ImpDataType/RequestStatusProfileStateDataType_SvcStruct
    ProfileRequestDataType_SvcStruct: dynamic-array-size-profile=VSA_LINEAR
      element Size_Indicator: implementation-data-type=TYPES_Library/ImpUint16
      element ProfileRequestPayLoad: category=ARRAY
        element MechatronicsT1S_Eth2_SwMgrInfoTxProfileRequest_D0S115: array-size=100, array-size-handling=ALL-INDICES-SAME-ARRAY-SIZE, array-size-semantics=VARIABLE-SIZE, implementation-data-type=ImpDataType/ProfileRequestPayLoadDataType_SvcStruct
    ProfileRequestPayLoadDataType_SvcStruct
      element ProfileID_SWID: implementation-data-type=TYPES_Library/ImpUint32
      element ProfileID_ProfileNumber: implementation-data-type=TYPES_Library/ImpUint8
      element RequestType: implementation-data-type=TYPES_Library/ImpUint8
    RequestStatusProfileStateDataType_SvcStruct: dynamic-array-size-profile=VSA_LINEAR
      element Size_Indicator: implementation-data-type=TYPES_Library/ImpUint16
      element RequestStatusProfileStatePayLoad: category=ARRAY
        element MechatronicsT1S_Eth2_SwMgrInfoTxRequestStatusProfileState_D0S98: array-size=100, array-size-handling=ALL-INDICES-SAME-ARRAY-SIZE, array-size-semantics=VARIABLE-SIZE, implementation-data-type=ImpDataType/RequestStatusProfileStatePayLoadDataType_SvcStruct
    RequestStatusProfileStatePayLoadDataType_SvcStruct
      4 x element, all with category=TYPE_REFERENCE:
        ProfileID_SWID: implementation-data-type=TYPES_Library/ImpUint32
        ProfileID_ProfileNumber: implementation-data-type=TYPES_Library/ImpUint8
        RequestStatus: implementation-data-type=TYPES_Library/ImpUint8
        ProfileStatus: implementation-data-type=TYPES_Library/ImpUint8
package /SVC_DEF_Hierarchy/SVC_SYS_MechatronicsT1S_PwrMgrHeartbeatDefTx
  collection MechatronicsT1S_PwrMgrHeartbeatTx: category=SET, element=MechatronicsT1S_PwrMgrHeartbeatTx_Evt
  sender receiver interface MechatronicsT1S_PwrMgrHeartbeatTx_Evt: meta-data-item-set{data-element=MechatronicsT1S_PwrMgrHeartbeatTx_Evt, meta-data-item=length=10}
    data MechatronicsT1S_PwrMgrHeartbeatTx_Evt: sw-impl-policy=QUEUED, type=MechatronicsT1S_PwrMgrHeartbeatTx_Evt_EventAppType
package /SVC_DEF_Hierarchy/SVC_SYS_MechatronicsT1S_PwrMgrHeartbeatDefTx/AppDataType
  application record data type MechatronicsT1S_PwrMgrHeartbeatTx_Evt_EventAppType: category=STRUCTURE
    application record element SrcPMId: category=VALUE, type=AppUint32
    application record element HrtBtCntr: category=VALUE, type=AppUint32
    application record element NmbrPrfAct: category=VALUE, type=ApplicationDataTypes/AppUint16
package /SVC_DEF_Hierarchy/SVC_SYS_MechatronicsT1S_PwrMgrHeartbeatDefTx/ImpDataType
  impl type MechatronicsT1S_PwrMgrHeartbeatTx_Evt_EventImpType: category=STRUCTURE
    element SrcPMId: implementation-data-type=TYPES_Library/ImpUint32
    element HrtBtCntr: implementation-data-type=TYPES_Library/ImpUint32
    element NmbrPrfAct: implementation-data-type=TYPES_Library/ImpUint16
package /SVC_DEF_Hierarchy/SVC_SYS_MechatronicsT1S_PwrMgrWakeupDef
  collection MechatronicsT1S_PwrMgrWakeupTx: category=SET, element=MechatronicsT1S_PwrMgrWakeupTx_Evt
  sender receiver interface MechatronicsT1S_PwrMgrWakeupTx_Evt: meta-data-item-set{data-element=MechatronicsT1S_PwrMgrWakeupTx_Evt, meta-data-item=length=10}
    data MechatronicsT1S_PwrMgrWakeupTx_Evt: sw-impl-policy=QUEUED, type=MechatronicsT1S_PwrMgrWakeupTx_Evt_EventAppType
package /SVC_DEF_Hierarchy/SVC_SYS_MechatronicsT1S_PwrMgrWakeupDef/AppDataType
  application array data type WakeupFrameA_WakeupFrameA: category=ARRAY
    element MechatronicsT1S_PwrMgrWakeupTxWakeupFrameA_D0S8: category=VALUE, type=ApplicationDataTypes/AppUint8, max-number-of-elements=8
  application array data type WakeupFrameB_WakeupFrameB: category=ARRAY
    element MechatronicsT1S_PwrMgrWakeupTxWakeupFrameB_D0S8: category=VALUE, type=ApplicationDataTypes/AppUint8, max-number-of-elements=8
  application array data type WakeupFrameC_WakeupFrameC: category=ARRAY
    element MechatronicsT1S_PwrMgrWakeupTxWakeupFrameC_D0S8: category=VALUE, type=ApplicationDataTypes/AppUint8, max-number-of-elements=8
  application record data type MechatronicsT1S_PwrMgrWakeupTx_Evt_EventAppType: category=STRUCTURE
    4 x application record element:
      SrcPMId: category=VALUE, type=AppUint32
      WakeupFrameA: category=ARRAY, type=AppDataType/WakeupFrameA_WakeupFrameA
      WakeupFrameB: category=ARRAY, type=AppDataType/WakeupFrameB_WakeupFrameB
      WakeupFrameC: category=ARRAY, type=AppDataType/WakeupFrameC_WakeupFrameC
package /SVC_DEF_Hierarchy/SVC_SYS_MechatronicsT1S_PwrMgrWakeupDef/ImpDataType
  impl type MechatronicsT1S_PwrMgrWakeupTx_Evt_EventImpType: category=STRUCTURE
    4 x element:
      SrcPMId: implementation-data-type=TYPES_Library/ImpUint32
      WakeupFrameA: category=ARRAY
        element MechatronicsT1S_PwrMgrWakeupTxWakeupFrameA_D0S8: array-size=8, implementation-data-type=TYPES_Library/ImpUint8
      WakeupFrameB: category=ARRAY
        element MechatronicsT1S_PwrMgrWakeupTxWakeupFrameB_D0S8: array-size=8, implementation-data-type=TYPES_Library/ImpUint8
      WakeupFrameC: category=ARRAY
        element MechatronicsT1S_PwrMgrWakeupTxWakeupFrameC_D0S8: array-size=8, implementation-data-type=TYPES_Library/ImpUint8
package /SVC_DEF_Hierarchy/SVC_SYS_MechatronicsT1S_SwMgrInfoDef
  collection MechatronicsT1S_SwMgrInfoTx: category=SET, element=MechatronicsT1S_SwMgrInfoTx_Evt
  sender receiver interface MechatronicsT1S_SwMgrInfoTx_Evt: meta-data-item-set{data-element=MechatronicsT1S_SwMgrInfoTx_Evt, meta-data-item=length=10}
    data MechatronicsT1S_SwMgrInfoTx_Evt: sw-impl-policy=QUEUED, type=MechatronicsT1S_SwMgrInfoTx_Evt_EventAppType
package /SVC_DEF_Hierarchy/SVC_SYS_MechatronicsT1S_SwMgrInfoDef/AppDataType
  application array data type ProfileRequest_ProfileRequestPayLoad: category=ARRAY
    element MechatronicsT1S_SwMgrInfoTxProfileRequest_D0S115: category=STRUCTURE, type=AppDataType/ProfileRequestPayLoadDataType_SvcAppStruct, array-size-semantics=VARIABLE-SIZE, max-number-of-elements=100
  application array data type RequestStatusProfileState_RequestStatusProfileStatePayLoad: category=ARRAY
    element MechatronicsT1S_SwMgrInfoTxRequestStatusProfileState_D0S98: category=STRUCTURE, type=AppDataType/RequestStatusProfileStatePayLoadDataType_SvcAppStruct, array-size-semantics=VARIABLE-SIZE, max-number-of-elements=100
  5 x application record data type, all with category=STRUCTURE:
    MechatronicsT1S_SwMgrInfoTx_Evt_EventAppType
      6 x application record element:
        PMSrcId: category=VALUE, type=AppUint32
        PMDestId: category=VALUE, type=AppUint32
        PR_MsgType: category=VALUE, type=ApplicationDataTypes/AppUint8
        ProfileRequest: category=STRUCTURE, type=AppDataType/ProfileRequestDataType_SvcAppStruct
        RSPS_MsgType: category=VALUE, type=ApplicationDataTypes/AppUint8
        RequestStatusProfileState: category=STRUCTURE, type=AppDataType/RequestStatusProfileStateDataType_SvcAppStruct
    ProfileRequestDataType_SvcAppStruct
      application record element Size_Indicator: category=VALUE, type=ApplicationDataTypes/AppUint16
      application record element ProfileRequestPayLoad: category=ARRAY, type=AppDataType/ProfileRequest_ProfileRequestPayLoad
    ProfileRequestPayLoadDataType_SvcAppStruct
      application record element ProfileID_SWID: category=VALUE, type=AppUint32
      application record element ProfileID_ProfileNumber: category=VALUE, type=ApplicationDataTypes/AppUint8
      application record element RequestType: category=VALUE, type=ApplicationDataTypes/AppUint8
    RequestStatusProfileStateDataType_SvcAppStruct
      application record element Size_Indicator: category=VALUE, type=ApplicationDataTypes/AppUint16
      application record element RequestStatusProfileStatePayLoad: category=ARRAY, type=AppDataType/RequestStatusProfileState_RequestStatusProfileStatePayLoad
    RequestStatusProfileStatePayLoadDataType_SvcAppStruct
      4 x application record element, all with category=VALUE:
        ProfileID_SWID: type=AppUint32
        ProfileID_ProfileNumber: type=ApplicationDataTypes/AppUint8
        RequestStatus: type=ApplicationDataTypes/AppUint8
        ProfileStatus: type=ApplicationDataTypes/AppUint8
package /SVC_DEF_Hierarchy/SVC_SYS_MechatronicsT1S_SwMgrInfoDef/ImpDataType
  5 x impl type, all with category=STRUCTURE:
    MechatronicsT1S_SwMgrInfoTx_Evt_EventImpType
      6 x element, all with category=TYPE_REFERENCE:
        PMSrcId: implementation-data-type=TYPES_Library/ImpUint32
        PMDestId: implementation-data-type=TYPES_Library/ImpUint32
        PR_MsgType: implementation-data-type=TYPES_Library/ImpUint8
        ProfileRequest: implementation-data-type=ImpDataType/ProfileRequestDataType_SvcStruct
        RSPS_MsgType: implementation-data-type=TYPES_Library/ImpUint8
        RequestStatusProfileState: implementation-data-type=ImpDataType/RequestStatusProfileStateDataType_SvcStruct
    ProfileRequestDataType_SvcStruct: dynamic-array-size-profile=VSA_LINEAR
      element Size_Indicator: implementation-data-type=TYPES_Library/ImpUint16
      element ProfileRequestPayLoad: category=ARRAY
        element MechatronicsT1S_SwMgrInfoTxProfileRequest_D0S115: array-size=100, array-size-handling=ALL-INDICES-SAME-ARRAY-SIZE, array-size-semantics=VARIABLE-SIZE, implementation-data-type=ImpDataType/ProfileRequestPayLoadDataType_SvcStruct
    ProfileRequestPayLoadDataType_SvcStruct
      element ProfileID_SWID: implementation-data-type=TYPES_Library/ImpUint32
      element ProfileID_ProfileNumber: implementation-data-type=TYPES_Library/ImpUint8
      element RequestType: implementation-data-type=TYPES_Library/ImpUint8
    RequestStatusProfileStateDataType_SvcStruct: dynamic-array-size-profile=VSA_LINEAR
      element Size_Indicator: implementation-data-type=TYPES_Library/ImpUint16
      element RequestStatusProfileStatePayLoad: category=ARRAY
        element MechatronicsT1S_SwMgrInfoTxRequestStatusProfileState_D0S98: array-size=100, array-size-handling=ALL-INDICES-SAME-ARRAY-SIZE, array-size-semantics=VARIABLE-SIZE, implementation-data-type=ImpDataType/RequestStatusProfileStatePayLoadDataType_SvcStruct
    RequestStatusProfileStatePayLoadDataType_SvcStruct
      4 x element, all with category=TYPE_REFERENCE:
        ProfileID_SWID: implementation-data-type=TYPES_Library/ImpUint32
        ProfileID_ProfileNumber: implementation-data-type=TYPES_Library/ImpUint8
        RequestStatus: implementation-data-type=TYPES_Library/ImpUint8
        ProfileStatus: implementation-data-type=TYPES_Library/ImpUint8
package /SVC_DEF_Hierarchy/SVC_SYS_MechatronicsT1S_SwMgrInfoDefRx
  collection MechatronicsT1S_SwMgrInfoRx: category=SET, element=MechatronicsT1S_SwMgrInfoRx_Evt
  sender receiver interface MechatronicsT1S_SwMgrInfoRx_Evt: meta-data-item-set{data-element=MechatronicsT1S_SwMgrInfoRx_Evt, meta-data-item=length=10}
    data MechatronicsT1S_SwMgrInfoRx_Evt: sw-impl-policy=QUEUED, type=MechatronicsT1S_SwMgrInfoRx_Evt_EventAppType
package /SVC_DEF_Hierarchy/SVC_SYS_MechatronicsT1S_SwMgrInfoDefRx/AppDataType
  application array data type ProfileRequest_ProfileRequestPayLoad: category=ARRAY
    element MechatronicsT1S_SwMgrInfoRxProfileRequest_D0S115: category=STRUCTURE, type=AppDataType/ProfileRequestPayLoadDataType_SvcAppStruct, array-size-semantics=VARIABLE-SIZE, max-number-of-elements=100
  application array data type RequestStatusProfileState_RequestStatusProfileStatePayLoad: category=ARRAY
    element MechatronicsT1S_SwMgrInfoRxRequestStatusProfileState_D0S98: category=STRUCTURE, type=AppDataType/RequestStatusProfileStatePayLoadDataType_SvcAppStruct, array-size-semantics=VARIABLE-SIZE, max-number-of-elements=100
  5 x application record data type, all with category=STRUCTURE:
    MechatronicsT1S_SwMgrInfoRx_Evt_EventAppType
      6 x application record element:
        PMSrcId: category=VALUE, type=AppUint32
        PMDestId: category=VALUE, type=AppUint32
        PR_MsgType: category=VALUE, type=ApplicationDataTypes/AppUint8
        ProfileRequest: category=STRUCTURE, type=AppDataType/ProfileRequestDataType_SvcAppStruct
        RSPS_MsgType: category=VALUE, type=ApplicationDataTypes/AppUint8
        RequestStatusProfileState: category=STRUCTURE, type=AppDataType/RequestStatusProfileStateDataType_SvcAppStruct
    ProfileRequestDataType_SvcAppStruct
      application record element Size_Indicator: category=VALUE, type=ApplicationDataTypes/AppUint16
      application record element ProfileRequestPayLoad: category=ARRAY, type=AppDataType/ProfileRequest_ProfileRequestPayLoad
    ProfileRequestPayLoadDataType_SvcAppStruct
      application record element ProfileID_SWID: category=VALUE, type=AppUint32
      application record element ProfileID_ProfileNumber: category=VALUE, type=ApplicationDataTypes/AppUint8
      application record element RequestType: category=VALUE, type=ApplicationDataTypes/AppUint8
    RequestStatusProfileStateDataType_SvcAppStruct
      application record element Size_Indicator: category=VALUE, type=ApplicationDataTypes/AppUint16
      application record element RequestStatusProfileStatePayLoad: category=ARRAY, type=AppDataType/RequestStatusProfileState_RequestStatusProfileStatePayLoad
    RequestStatusProfileStatePayLoadDataType_SvcAppStruct
      4 x application record element, all with category=VALUE:
        ProfileID_SWID: type=AppUint32
        ProfileID_ProfileNumber: type=ApplicationDataTypes/AppUint8
        RequestStatus: type=ApplicationDataTypes/AppUint8
        ProfileStatus: type=ApplicationDataTypes/AppUint8
package /SVC_DEF_Hierarchy/SVC_SYS_MechatronicsT1S_SwMgrInfoDefRx/ImpDataType
  5 x impl type, all with category=STRUCTURE:
    MechatronicsT1S_SwMgrInfoRx_Evt_EventImpType
      6 x element, all with category=TYPE_REFERENCE:
        PMSrcId: implementation-data-type=TYPES_Library/ImpUint32
        PMDestId: implementation-data-type=TYPES_Library/ImpUint32
        PR_MsgType: implementation-data-type=TYPES_Library/ImpUint8
        ProfileRequest: implementation-data-type=ImpDataType/ProfileRequestDataType_SvcStruct
        RSPS_MsgType: implementation-data-type=TYPES_Library/ImpUint8
        RequestStatusProfileState: implementation-data-type=ImpDataType/RequestStatusProfileStateDataType_SvcStruct
    ProfileRequestDataType_SvcStruct: dynamic-array-size-profile=VSA_LINEAR
      element Size_Indicator: implementation-data-type=TYPES_Library/ImpUint16
      element ProfileRequestPayLoad: category=ARRAY
        element MechatronicsT1S_SwMgrInfoRxProfileRequest_D0S115: array-size=100, array-size-handling=ALL-INDICES-SAME-ARRAY-SIZE, array-size-semantics=VARIABLE-SIZE, implementation-data-type=ImpDataType/ProfileRequestPayLoadDataType_SvcStruct
    ProfileRequestPayLoadDataType_SvcStruct
      element ProfileID_SWID: implementation-data-type=TYPES_Library/ImpUint32
      element ProfileID_ProfileNumber: implementation-data-type=TYPES_Library/ImpUint8
      element RequestType: implementation-data-type=TYPES_Library/ImpUint8
    RequestStatusProfileStateDataType_SvcStruct: dynamic-array-size-profile=VSA_LINEAR
      element Size_Indicator: implementation-data-type=TYPES_Library/ImpUint16
      element RequestStatusProfileStatePayLoad: category=ARRAY
        element MechatronicsT1S_SwMgrInfoRxRequestStatusProfileState_D0S98: array-size=100, array-size-handling=ALL-INDICES-SAME-ARRAY-SIZE, array-size-semantics=VARIABLE-SIZE, implementation-data-type=ImpDataType/RequestStatusProfileStatePayLoadDataType_SvcStruct
    RequestStatusProfileStatePayLoadDataType_SvcStruct
      4 x element, all with category=TYPE_REFERENCE:
        ProfileID_SWID: implementation-data-type=TYPES_Library/ImpUint32
        ProfileID_ProfileNumber: implementation-data-type=TYPES_Library/ImpUint8
        RequestStatus: implementation-data-type=TYPES_Library/ImpUint8
        ProfileStatus: implementation-data-type=TYPES_Library/ImpUint8
package /SVC_DEF_Hierarchy/SVC_SYS_Mechatronics_Eth2_SwMgrInfoDefRx
  collection Mechatronics_Eth2_SwMgrInfoRx: category=SET, element=Mechatronics_Eth2_SwMgrInfoRx_Evt
  sender receiver interface Mechatronics_Eth2_SwMgrInfoRx_Evt: meta-data-item-set{data-element=Mechatronics_Eth2_SwMgrInfoRx_Evt, meta-data-item=length=10}
    data Mechatronics_Eth2_SwMgrInfoRx_Evt: sw-impl-policy=QUEUED, type=Mechatronics_Eth2_SwMgrInfoRx_Evt_EventAppType
package /SVC_DEF_Hierarchy/SVC_SYS_Mechatronics_Eth2_SwMgrInfoDefRx/AppDataType
  application array data type ProfileRequest_ProfileRequestPayLoad: category=ARRAY
    element Mechatronics_Eth2_SwMgrInfoRxProfileRequest_D0S115: category=STRUCTURE, type=AppDataType/ProfileRequestPayLoadDataType_SvcAppStruct, array-size-semantics=VARIABLE-SIZE, max-number-of-elements=100
  application array data type RequestStatusProfileState_RequestStatusProfileStatePayLoad: category=ARRAY
    element Mechatronics_Eth2_SwMgrInfoRxRequestStatusProfileState_D0S98: category=STRUCTURE, type=AppDataType/RequestStatusProfileStatePayLoadDataType_SvcAppStruct, array-size-semantics=VARIABLE-SIZE, max-number-of-elements=100
  5 x application record data type, all with category=STRUCTURE:
    Mechatronics_Eth2_SwMgrInfoRx_Evt_EventAppType
      6 x application record element:
        PMSrcId: category=VALUE, type=AppUint32
        PMDestId: category=VALUE, type=AppUint32
        PR_MsgType: category=VALUE, type=ApplicationDataTypes/AppUint8
        ProfileRequest: category=STRUCTURE, type=AppDataType/ProfileRequestDataType_SvcAppStruct
        RSPS_MsgType: category=VALUE, type=ApplicationDataTypes/AppUint8
        RequestStatusProfileState: category=STRUCTURE, type=AppDataType/RequestStatusProfileStateDataType_SvcAppStruct
    ProfileRequestDataType_SvcAppStruct
      application record element Size_Indicator: category=VALUE, type=ApplicationDataTypes/AppUint16
      application record element ProfileRequestPayLoad: category=ARRAY, type=AppDataType/ProfileRequest_ProfileRequestPayLoad
    ProfileRequestPayLoadDataType_SvcAppStruct
      application record element ProfileID_SWID: category=VALUE, type=AppUint32
      application record element ProfileID_ProfileNumber: category=VALUE, type=ApplicationDataTypes/AppUint8
      application record element RequestType: category=VALUE, type=ApplicationDataTypes/AppUint8
    RequestStatusProfileStateDataType_SvcAppStruct
      application record element Size_Indicator: category=VALUE, type=ApplicationDataTypes/AppUint16
      application record element RequestStatusProfileStatePayLoad: category=ARRAY, type=AppDataType/RequestStatusProfileState_RequestStatusProfileStatePayLoad
    RequestStatusProfileStatePayLoadDataType_SvcAppStruct
      4 x application record element, all with category=VALUE:
        ProfileID_SWID: type=AppUint32
        ProfileID_ProfileNumber: type=ApplicationDataTypes/AppUint8
        RequestStatus: type=ApplicationDataTypes/AppUint8
        ProfileStatus: type=ApplicationDataTypes/AppUint8
package /SVC_DEF_Hierarchy/SVC_SYS_Mechatronics_Eth2_SwMgrInfoDefRx/ImpDataType
  5 x impl type, all with category=STRUCTURE:
    Mechatronics_Eth2_SwMgrInfoRx_Evt_EventImpType
      6 x element, all with category=TYPE_REFERENCE:
        PMSrcId: implementation-data-type=TYPES_Library/ImpUint32
        PMDestId: implementation-data-type=TYPES_Library/ImpUint32
        PR_MsgType: implementation-data-type=TYPES_Library/ImpUint8
        ProfileRequest: implementation-data-type=ImpDataType/ProfileRequestDataType_SvcStruct
        RSPS_MsgType: implementation-data-type=TYPES_Library/ImpUint8
        RequestStatusProfileState: implementation-data-type=ImpDataType/RequestStatusProfileStateDataType_SvcStruct
    ProfileRequestDataType_SvcStruct: dynamic-array-size-profile=VSA_LINEAR
      element Size_Indicator: implementation-data-type=TYPES_Library/ImpUint16
      element ProfileRequestPayLoad: category=ARRAY
        element Mechatronics_Eth2_SwMgrInfoRxProfileRequest_D0S115: array-size=100, array-size-handling=ALL-INDICES-SAME-ARRAY-SIZE, array-size-semantics=VARIABLE-SIZE, implementation-data-type=ImpDataType/ProfileRequestPayLoadDataType_SvcStruct
    ProfileRequestPayLoadDataType_SvcStruct
      element ProfileID_SWID: implementation-data-type=TYPES_Library/ImpUint32
      element ProfileID_ProfileNumber: implementation-data-type=TYPES_Library/ImpUint8
      element RequestType: implementation-data-type=TYPES_Library/ImpUint8
    RequestStatusProfileStateDataType_SvcStruct: dynamic-array-size-profile=VSA_LINEAR
      element Size_Indicator: implementation-data-type=TYPES_Library/ImpUint16
      element RequestStatusProfileStatePayLoad: category=ARRAY
        element Mechatronics_Eth2_SwMgrInfoRxRequestStatusProfileState_D0S98: array-size=100, array-size-handling=ALL-INDICES-SAME-ARRAY-SIZE, array-size-semantics=VARIABLE-SIZE, implementation-data-type=ImpDataType/RequestStatusProfileStatePayLoadDataType_SvcStruct
    RequestStatusProfileStatePayLoadDataType_SvcStruct
      4 x element, all with category=TYPE_REFERENCE:
        ProfileID_SWID: implementation-data-type=TYPES_Library/ImpUint32
        ProfileID_ProfileNumber: implementation-data-type=TYPES_Library/ImpUint8
        RequestStatus: implementation-data-type=TYPES_Library/ImpUint8
        ProfileStatus: implementation-data-type=TYPES_Library/ImpUint8
package /SVC_DEF_Hierarchy/SVC_SYS_Mechatronics_Eth2_SwMgrInfoDefTx
  collection Mechatronics_Eth2_SwMgrInfoTx: category=SET, element=Mechatronics_Eth2_SwMgrInfoTx_Evt
  sender receiver interface Mechatronics_Eth2_SwMgrInfoTx_Evt: meta-data-item-set{data-element=Mechatronics_Eth2_SwMgrInfoTx_Evt, meta-data-item=length=10}
    data Mechatronics_Eth2_SwMgrInfoTx_Evt: sw-impl-policy=QUEUED, type=Mechatronics_Eth2_SwMgrInfoTx_Evt_EventAppType
package /SVC_DEF_Hierarchy/SVC_SYS_Mechatronics_Eth2_SwMgrInfoDefTx/AppDataType
  application array data type ProfileRequest_ProfileRequestPayLoad: category=ARRAY
    element Mechatronics_Eth2_SwMgrInfoTxProfileRequest_D0S115: category=STRUCTURE, type=AppDataType/ProfileRequestPayLoadDataType_SvcAppStruct, array-size-semantics=VARIABLE-SIZE, max-number-of-elements=100
  application array data type RequestStatusProfileState_RequestStatusProfileStatePayLoad: category=ARRAY
    element Mechatronics_Eth2_SwMgrInfoTxRequestStatusProfileState_D0S98: category=STRUCTURE, type=AppDataType/RequestStatusProfileStatePayLoadDataType_SvcAppStruct, array-size-semantics=VARIABLE-SIZE, max-number-of-elements=100
  5 x application record data type, all with category=STRUCTURE:
    Mechatronics_Eth2_SwMgrInfoTx_Evt_EventAppType
      6 x application record element:
        PMSrcId: category=VALUE, type=AppUint32
        PMDestId: category=VALUE, type=AppUint32
        PR_MsgType: category=VALUE, type=ApplicationDataTypes/AppUint8
        ProfileRequest: category=STRUCTURE, type=AppDataType/ProfileRequestDataType_SvcAppStruct
        RSPS_MsgType: category=VALUE, type=ApplicationDataTypes/AppUint8
        RequestStatusProfileState: category=STRUCTURE, type=AppDataType/RequestStatusProfileStateDataType_SvcAppStruct
    ProfileRequestDataType_SvcAppStruct
      application record element Size_Indicator: category=VALUE, type=ApplicationDataTypes/AppUint16
      application record element ProfileRequestPayLoad: category=ARRAY, type=AppDataType/ProfileRequest_ProfileRequestPayLoad
    ProfileRequestPayLoadDataType_SvcAppStruct
      application record element ProfileID_SWID: category=VALUE, type=AppUint32
      application record element ProfileID_ProfileNumber: category=VALUE, type=ApplicationDataTypes/AppUint8
      application record element RequestType: category=VALUE, type=ApplicationDataTypes/AppUint8
    RequestStatusProfileStateDataType_SvcAppStruct
      application record element Size_Indicator: category=VALUE, type=ApplicationDataTypes/AppUint16
      application record element RequestStatusProfileStatePayLoad: category=ARRAY, type=AppDataType/RequestStatusProfileState_RequestStatusProfileStatePayLoad
    RequestStatusProfileStatePayLoadDataType_SvcAppStruct
      4 x application record element, all with category=VALUE:
        ProfileID_SWID: type=AppUint32
        ProfileID_ProfileNumber: type=ApplicationDataTypes/AppUint8
        RequestStatus: type=ApplicationDataTypes/AppUint8
        ProfileStatus: type=ApplicationDataTypes/AppUint8
package /SVC_DEF_Hierarchy/SVC_SYS_Mechatronics_Eth2_SwMgrInfoDefTx/ImpDataType
  5 x impl type, all with category=STRUCTURE:
    Mechatronics_Eth2_SwMgrInfoTx_Evt_EventImpType
      6 x element, all with category=TYPE_REFERENCE:
        PMSrcId: implementation-data-type=TYPES_Library/ImpUint32
        PMDestId: implementation-data-type=TYPES_Library/ImpUint32
        PR_MsgType: implementation-data-type=TYPES_Library/ImpUint8
        ProfileRequest: implementation-data-type=ImpDataType/ProfileRequestDataType_SvcStruct
        RSPS_MsgType: implementation-data-type=TYPES_Library/ImpUint8
        RequestStatusProfileState: implementation-data-type=ImpDataType/RequestStatusProfileStateDataType_SvcStruct
    ProfileRequestDataType_SvcStruct: dynamic-array-size-profile=VSA_LINEAR
      element Size_Indicator: implementation-data-type=TYPES_Library/ImpUint16
      element ProfileRequestPayLoad: category=ARRAY
        element Mechatronics_Eth2_SwMgrInfoTxProfileRequest_D0S115: array-size=100, array-size-handling=ALL-INDICES-SAME-ARRAY-SIZE, array-size-semantics=VARIABLE-SIZE, implementation-data-type=ImpDataType/ProfileRequestPayLoadDataType_SvcStruct
    ProfileRequestPayLoadDataType_SvcStruct
      element ProfileID_SWID: implementation-data-type=TYPES_Library/ImpUint32
      element ProfileID_ProfileNumber: implementation-data-type=TYPES_Library/ImpUint8
      element RequestType: implementation-data-type=TYPES_Library/ImpUint8
    RequestStatusProfileStateDataType_SvcStruct: dynamic-array-size-profile=VSA_LINEAR
      element Size_Indicator: implementation-data-type=TYPES_Library/ImpUint16
      element RequestStatusProfileStatePayLoad: category=ARRAY
        element Mechatronics_Eth2_SwMgrInfoTxRequestStatusProfileState_D0S98: array-size=100, array-size-handling=ALL-INDICES-SAME-ARRAY-SIZE, array-size-semantics=VARIABLE-SIZE, implementation-data-type=ImpDataType/RequestStatusProfileStatePayLoadDataType_SvcStruct
    RequestStatusProfileStatePayLoadDataType_SvcStruct
      4 x element, all with category=TYPE_REFERENCE:
        ProfileID_SWID: implementation-data-type=TYPES_Library/ImpUint32
        ProfileID_ProfileNumber: implementation-data-type=TYPES_Library/ImpUint8
        RequestStatus: implementation-data-type=TYPES_Library/ImpUint8
        ProfileStatus: implementation-data-type=TYPES_Library/ImpUint8
package /SVC_DEF_Hierarchy/SVC_SYS_PwrMgrMulti_PwrMgrHeartbeatDefRx
  collection PwrMgrMulti_PwrMgrHeartbeatRx: category=SET, element=PwrMgrMulti_PwrMgrHeartbeatRx_Evt
  sender receiver interface PwrMgrMulti_PwrMgrHeartbeatRx_Evt: meta-data-item-set{data-element=PwrMgrMulti_PwrMgrHeartbeatRx_Evt, meta-data-item=length=10}
    data PwrMgrMulti_PwrMgrHeartbeatRx_Evt: sw-impl-policy=QUEUED, type=PwrMgrMulti_PwrMgrHeartbeatRx_Evt_EventAppType
package /SVC_DEF_Hierarchy/SVC_SYS_PwrMgrMulti_PwrMgrHeartbeatDefRx/AppDataType
  application record data type PwrMgrMulti_PwrMgrHeartbeatRx_Evt_EventAppType: category=STRUCTURE
    application record element SrcPMId: category=VALUE, type=AppUint32
    application record element HrtBtCntr: category=VALUE, type=AppUint32
    application record element NmbrPrfAct: category=VALUE, type=ApplicationDataTypes/AppUint16
package /SVC_DEF_Hierarchy/SVC_SYS_PwrMgrMulti_PwrMgrHeartbeatDefRx/ImpDataType
  impl type PwrMgrMulti_PwrMgrHeartbeatRx_Evt_EventImpType: category=STRUCTURE
    element SrcPMId: implementation-data-type=TYPES_Library/ImpUint32
    element HrtBtCntr: implementation-data-type=TYPES_Library/ImpUint32
    element NmbrPrfAct: implementation-data-type=TYPES_Library/ImpUint16
package /SVC_DEF_Hierarchy/SVC_SYS_PwrMgrMulti_PwrMgrWakeupDefRx
  collection PwrMgrMulti_PwrMgrWakeupRx: category=SET, element=PwrMgrMulti_PwrMgrWakeupRx_Evt
  sender receiver interface PwrMgrMulti_PwrMgrWakeupRx_Evt: meta-data-item-set{data-element=PwrMgrMulti_PwrMgrWakeupRx_Evt, meta-data-item=length=10}
    data PwrMgrMulti_PwrMgrWakeupRx_Evt: sw-impl-policy=QUEUED, type=PwrMgrMulti_PwrMgrWakeupRx_Evt_EventAppType
package /SVC_DEF_Hierarchy/SVC_SYS_PwrMgrMulti_PwrMgrWakeupDefRx/AppDataType
  application array data type WakeupFrameA_WakeupFrameA: category=ARRAY
    element PwrMgrMulti_PwrMgrWakeupRxWakeupFrameA_D0S8: category=VALUE, type=ApplicationDataTypes/AppUint8, max-number-of-elements=8
  application array data type WakeupFrameB_WakeupFrameB: category=ARRAY
    element PwrMgrMulti_PwrMgrWakeupRxWakeupFrameB_D0S8: category=VALUE, type=ApplicationDataTypes/AppUint8, max-number-of-elements=8
  application array data type WakeupFrameC_WakeupFrameC: category=ARRAY
    element PwrMgrMulti_PwrMgrWakeupRxWakeupFrameC_D0S8: category=VALUE, type=ApplicationDataTypes/AppUint8, max-number-of-elements=8
  application record data type PwrMgrMulti_PwrMgrWakeupRx_Evt_EventAppType: category=STRUCTURE
    4 x application record element:
      SrcPMId: category=VALUE, type=AppUint32
      WakeupFrameA: category=ARRAY, type=AppDataType/WakeupFrameA_WakeupFrameA
      WakeupFrameB: category=ARRAY, type=AppDataType/WakeupFrameB_WakeupFrameB
      WakeupFrameC: category=ARRAY, type=AppDataType/WakeupFrameC_WakeupFrameC
package /SVC_DEF_Hierarchy/SVC_SYS_PwrMgrMulti_PwrMgrWakeupDefRx/ImpDataType
  impl type PwrMgrMulti_PwrMgrWakeupRx_Evt_EventImpType: category=STRUCTURE
    4 x element:
      SrcPMId: implementation-data-type=TYPES_Library/ImpUint32
      WakeupFrameA: category=ARRAY
        element PwrMgrMulti_PwrMgrWakeupRxWakeupFrameA_D0S8: array-size=8, implementation-data-type=TYPES_Library/ImpUint8
      WakeupFrameB: category=ARRAY
        element PwrMgrMulti_PwrMgrWakeupRxWakeupFrameB_D0S8: array-size=8, implementation-data-type=TYPES_Library/ImpUint8
      WakeupFrameC: category=ARRAY
        element PwrMgrMulti_PwrMgrWakeupRxWakeupFrameC_D0S8: array-size=8, implementation-data-type=TYPES_Library/ImpUint8
package /SVC_DEF_Hierarchy/SVC_eBstActrPriDef
  collection hSVC_eBstActrPri: category=SET, element=hSVC_eBstActrPri_evt
  sender receiver interface hSVC_eBstActrPri_evt
    data hSVC_eBstActrPri_evt: type=hSVC_eBstActrPri_evt_EventAppType
package /SVC_DEF_Hierarchy/SVC_eBstActrPriDef/AppDataType
  application array data type VaBACR_y_UpIntegrationOutputP_VaBACR_y_UpIntegrationOutputP: category=ARRAY
    element hSVC_eBstActrPriVaBACR_y_UpIntegrationOutputP_D0S150: category=VALUE, type=BYTE, max-number-of-elements=150
  21 x app type, all with category=VALUE:
    hSVC_eBstActrPri_evt_VeBACR_e_PrimDiagStStsP_TeBACR_e_DiagStSts_SvcAppEnum
    hSVC_eBstActrPri_evt_VeBACR_e_SbmPrimDiagStStsP_TeBACR_e_SbmDiagStSts_SvcAppEnum
    hSVC_eBstActrPri_evt_VeBACR_e_eBstEPB_AchModeLtP_TeBACR_e_EPB_AchMode_SvcAppEnum
    hSVC_eBstActrPri_evt_VeBACR_e_eBstEPB_AchModeRtP_TeBACR_e_EPB_AchMode_SvcAppEnum
    hSVC_eBstActrPri_evt_VeBACR_e_eBstEPB_StateLtP_TeBACR_e_EPB_State_SvcAppEnum
    hSVC_eBstActrPri_evt_VeBACR_e_eBstEPB_StateRtP_TeBACR_e_EPB_State_SvcAppEnum
    hSVC_eBstActrPri_evt_VeBACR_e_eBstFluidLvlRawP_TeBACR_e_BrkFluidLvl_SvcAppEnum
    hSVC_eBstActrPri_evt_VeBACR_e_eBstHydFuncStP_TeBACR_e_eBstHydState_SvcAppEnum
    hSVC_eBstActrPri_evt_VeBACR_e_eBstIntrSelfTstStsP_TeBACR_e_IntrSelfTstSts_SvcAppEnum
    hSVC_eBstActrPri_evt_VeBACR_e_eBstMC_StsP_TeBACR_e_VldTrvlSnsrs_SvcAppEnum
    hSVC_eBstActrPri_evt_VeBACR_e_eBstPCanCommStsP_TeBACR_e_PCanCommSts_SvcAppEnum
    hSVC_eBstActrPri_evt_VeBACR_e_eBstPlngrPosnStsP_TeBPRR_e_ActPosnSts_SvcAppEnum
    hSVC_eBstActrPri_evt_VeBACR_e_eBstRplnshStsP_TeBACR_e_RplnshSts_SvcAppEnum
    hSVC_eBstActrPri_evt_VeBACR_e_eBstVDA_PbcHPO_ReqP_TeBACR_e_VDA_PbcHPO_Req_SvcAppEnum
    hSVC_eBstActrPri_evt_VeBACR_e_eBstWhlCntrlStsLfP_TeBACR_e_WhlCntrlSts_SvcAppEnum
    hSVC_eBstActrPri_evt_VeBACR_e_eBstWhlCntrlStsLrP_TeBACR_e_WhlCntrlSts_SvcAppEnum
    hSVC_eBstActrPri_evt_VeBACR_e_eBstWhlCntrlStsRfP_TeBACR_e_WhlCntrlSts_SvcAppEnum
    hSVC_eBstActrPri_evt_VeBACR_e_eBstWhlCntrlStsRrP_TeBACR_e_WhlCntrlSts_SvcAppEnum
    hSVC_eBstActrPri_evt_YeBACR_e_eBstEBOS_EBCMStateP_TeBACR_e_EBOS_EBCM_State_SvcAppEnum
    hSVC_eBstActrPri_evt_YeBACR_e_eBstEPB_StatusLtP_TeBACR_e_EPB_Status_SvcAppEnum
    hSVC_eBstActrPri_evt_YeBACR_e_eBstEPB_StatusRtP_TeBACR_e_EPB_Status_SvcAppEnum
  application record data type hSVC_eBstActrPri_evt_EventAppType: category=STRUCTURE
    116 x application record element:
      VeBACR_d_eBstWS_VdaBitsRfP: category=VALUE, type=WORD
      VeBACR_b_eBstWS_StndStllRfP: category=VALUE, type=TbBOOLEAN
      VeBACR_F_eBstEPB_AchvdRtP: category=VALUE, type=T_F_Newtons
      VeBACR_b_eBstMC_AchvdInvP: category=VALUE, type=TbBOOLEAN
      VeBACR_l_eBstMCP: category=VALUE, type=T_l_Millimeters
      VeBACR_d_eBstWS_VdaBitsLfP: category=VALUE, type=WORD
      VeBACR_Cnt_eBstWS_TmD3_RrP: category=VALUE, type=T_COUNT_WORD
      VeBACR_Cnt_eBstWS_PulsRrP: category=VALUE, type=T_COUNT_WORD
      VeBACR_Cnt_eBstWS_TmD1_RrP: category=VALUE, type=T_COUNT_WORD
      VeBACR_Cnt_eBstWS_TmD2_LfP: category=VALUE, type=T_COUNT_WORD
      VeBACR_l_eBstPlngrPosnP: category=VALUE, type=T_l_Millimeters
      VeBACR_Cnt_eBstWS_TmD1_LrP: category=VALUE, type=T_COUNT_WORD
      VeBACR_b_eBstWS_InvLrP: category=VALUE, type=TbBOOLEAN
      VeBACR_p_eBstMC_AchvdP: category=VALUE, type=T_p_bar
      VeBACR_p_eBstBkPrsEstRrP: category=VALUE, type=T_p_bar
      VeBACR_e_eBstEPB_StateLtP: category=VALUE, type=hSVC_eBstActrPri_evt_VeBACR_e_eBstEPB_StateLtP_TeBACR_e_EPB_State_SvcAppEnum
      VeBACR_Cnt_eBstWS_TmD3_RfP: category=VALUE, type=T_COUNT_WORD
      VeBACR_e_eBstPlngrPosnStsP: category=VALUE, type=hSVC_eBstActrPri_evt_VeBACR_e_eBstPlngrPosnStsP_TeBPRR_e_ActPosnSts_SvcAppEnum
      VeBACR_b_eBst_BstWthWarningP: category=VALUE, type=TbBOOLEAN
      VeBACR_Cnt_eBstWS_PulsRfP: category=VALUE, type=T_COUNT_WORD
      VeBACR_p_eBstBkPrsEstLfP: category=VALUE, type=T_p_bar
      VeBACR_Cnt_eBstWS_PulsLrP: category=VALUE, type=T_COUNT_WORD
      VeBACR_b_eBstBC_AchvdInvP: category=VALUE, type=TbBOOLEAN
      VeBACR_e_eBstMC_StsP: category=VALUE, type=hSVC_eBstActrPri_evt_VeBACR_e_eBstMC_StsP_TeBACR_e_VldTrvlSnsrs_SvcAppEnum
      VeBACR_b_eBstWS_InvRrP: category=VALUE, type=TbBOOLEAN
      VeBACR_d_eBstWS_VdaBitsLrP: category=VALUE, type=WORD
      VeBACR_Cnt_eBstWS_TmD3_LfP: category=VALUE, type=T_COUNT_WORD
      VeBACR_Cnt_eBstWS_TmD3_LrP: category=VALUE, type=T_COUNT_WORD
      VeBACR_e_eBstEPB_AchModeRtP: category=VALUE, type=hSVC_eBstActrPri_evt_VeBACR_e_eBstEPB_AchModeRtP_TeBACR_e_EPB_AchMode_SvcAppEnum
      YeBACR_Pct_eBstThermalCapP: category=VALUE, type=T_Pct_Percent
      VeBACR_b_eBstWS_StndStllRrP: category=VALUE, type=TbBOOLEAN
      VeBACR_b_eBstWS_InvRfP: category=VALUE, type=TbBOOLEAN
      VeBACR_e_eBstFluidLvlRawP: category=VALUE, type=hSVC_eBstActrPri_evt_VeBACR_e_eBstFluidLvlRawP_TeBACR_e_BrkFluidLvl_SvcAppEnum
      VeBACR_p_eBstBC_AchvdP: category=VALUE, type=T_p_bar
      VeBACR_Cnt_eBstWS_PulsLfP: category=VALUE, type=T_COUNT_WORD
      VeBACR_Cnt_eBstWS_TmD1_RfP: category=VALUE, type=T_COUNT_WORD
      VeBACR_Cnt_eBstWS_TmRrP: category=VALUE, type=T_COUNT_LONG
      YeBACR_e_eBstEBOS_EBCMStateP: category=VALUE, type=hSVC_eBstActrPri_evt_YeBACR_e_eBstEBOS_EBCMStateP_TeBACR_e_EBOS_EBCM_State_SvcAppEnum
      VeBACR_e_eBstIntrSelfTstStsP: category=VALUE, type=hSVC_eBstActrPri_evt_VeBACR_e_eBstIntrSelfTstStsP_TeBACR_e_IntrSelfTstSts_SvcAppEnum
      VeBACR_Cnt_eBstWS_TmD2_LrP: category=VALUE, type=T_COUNT_WORD
      VeBACR_d_eBstWS_VdaBitsRrP: category=VALUE, type=WORD
      VeBACR_b_eBstPwrMgmtActP: category=VALUE, type=TbBOOLEAN
      VeBACR_Cnt_eBstWS_VdaBitsRrP: category=VALUE, type=T_COUNT_BYTE
      VeBACR_b_eBstWS_InvLfP: category=VALUE, type=TbBOOLEAN
      VeBACR_d_eBstPwrMgmtRsnP: category=VALUE, type=WORD
      VeBACR_Cnt_eBstWS_TmRfP: category=VALUE, type=T_COUNT_LONG
      VeBACR_p_eBstBkPrsEstLrP: category=VALUE, type=T_p_bar
      VeBACR_Cnt_eBstWS_TmLfP: category=VALUE, type=T_COUNT_LONG
      VeBACR_Cnt_eBstWS_VdaBitsRfP: category=VALUE, type=T_COUNT_BYTE
      VeBACR_Cnt_eBstWS_TmD2_RrP: category=VALUE, type=T_COUNT_WORD
      VeBACR_b_eBstDgrdDBRReqstdP: category=VALUE, type=TbBOOLEAN
      VeBACR_p_eBstBkPrsEstRfP: category=VALUE, type=T_p_bar
      VeBACR_e_eBstEPB_StateRtP: category=VALUE, type=hSVC_eBstActrPri_evt_VeBACR_e_eBstEPB_StateRtP_TeBACR_e_EPB_State_SvcAppEnum
      VeBACR_F_eBstEPB_AchvdLtP: category=VALUE, type=T_F_Newtons
      VeBACR_Cnt_eBstWS_TmD2_RfP: category=VALUE, type=T_COUNT_WORD
      VeBACR_Cnt_eBstWS_VdaBitsLfP: category=VALUE, type=T_COUNT_BYTE
      VeBACR_b_eBstWS_StndStllLfP: category=VALUE, type=TbBOOLEAN
      VeBACR_e_eBstEPB_AchModeLtP: category=VALUE, type=hSVC_eBstActrPri_evt_VeBACR_e_eBstEPB_AchModeLtP_TeBACR_e_EPB_AchMode_SvcAppEnum
      VeBACR_Cnt_eBstWS_TmLrP: category=VALUE, type=T_COUNT_LONG
      VeBACR_Cnt_eBstWS_TmD1_LfP: category=VALUE, type=T_COUNT_WORD
      VeBACR_b_eBstWS_StndStllLrP: category=VALUE, type=TbBOOLEAN
      VeBACR_Cnt_eBstWS_VdaBitsLrP: category=VALUE, type=T_COUNT_BYTE
      VeBACR_Cnt_eBstWS_TmD7_RrP: category=VALUE, type=T_COUNT_WORD
      VeBACR_U_eBstBrkActVolt2_P: category=VALUE, type=T_U_Volts
      VeBACR_b_eBstBrkActCurr2FA_P: category=VALUE, type=TbBOOLEAN
      VeBACR_Cnt_eBstWS_TmD8_RfP: category=VALUE, type=T_COUNT_WORD
      VeBACR_Cnt_eBstWS_TmD7_LfP: category=VALUE, type=T_COUNT_WORD
      VeBACR_Cnt_eBstWS_TmD8_LrP: category=VALUE, type=T_COUNT_WORD
      VeBACR_Cnt_eBstWS_TmD5_LfP: category=VALUE, type=T_COUNT_WORD
      VeBACR_Cnt_eBstWS_TmD4_LrP: category=VALUE, type=T_COUNT_WORD
      VeBACR_Cnt_eBstWS_TmD5_RrP: category=VALUE, type=T_COUNT_WORD
      VeBACR_Cnt_eBstWS_TmD6_RfP: category=VALUE, type=T_COUNT_WORD
      VeBACR_Cnt_eBstWS_TmD4_RfP: category=VALUE, type=T_COUNT_WORD
      VeBACR_Cnt_eBstWS_TmD6_LrP: category=VALUE, type=T_COUNT_WORD
      VeBACR_U_eBstBrkActVolt1_P: category=VALUE, type=T_U_Volts
      VeBACR_b_eBstBrkActVolt2FA_P: category=VALUE, type=TbBOOLEAN
      VeBACR_Cnt_eBstWS_TmD8_LfP: category=VALUE, type=T_COUNT_WORD
      VeBACR_Cnt_eBstWS_TmD7_LrP: category=VALUE, type=T_COUNT_WORD
      VeBACR_Cnt_eBstWS_TmD8_RrP: category=VALUE, type=T_COUNT_WORD
      VeBACR_b_eBstBrkActCurr1FA_P: category=VALUE, type=TbBOOLEAN
      VeBACR_Cnt_eBstWS_TmD7_RfP: category=VALUE, type=T_COUNT_WORD
      VeBACR_I_eBstBrkActCurr2_P: category=VALUE, type=T_I_Amps
      VeBACR_Cnt_eBstWS_TmD4_RrP: category=VALUE, type=T_COUNT_WORD
      VeBACR_Cnt_eBstWS_TmD5_LrP: category=VALUE, type=T_COUNT_WORD
      VeBACR_Cnt_eBstWS_TmD4_LfP: category=VALUE, type=T_COUNT_WORD
      VeBACR_Cnt_eBstWS_TmD6_LfP: category=VALUE, type=T_COUNT_WORD
      VeBACR_Cnt_eBstWS_TmD6_RrP: category=VALUE, type=T_COUNT_WORD
      VeBACR_Cnt_eBstWS_TmD5_RfP: category=VALUE, type=T_COUNT_WORD
      VeBACR_b_eBstBrkActVolt1FA_P: category=VALUE, type=TbBOOLEAN
      VeBACR_b_eBstLeakModeActvP: category=VALUE, type=TbBOOLEAN
      VeBACR_b_eBstRecoveryActvP: category=VALUE, type=TbBOOLEAN
      VeBACR_I_eBstBrkActCurr1_P: category=VALUE, type=T_I_Amps
      VeBACR_V_eBstPotPlngrVolP: category=VALUE, type=T_V_Millimeters3
      VeBACR_e_eBstRplnshStsP: category=VALUE, type=hSVC_eBstActrPri_evt_VeBACR_e_eBstRplnshStsP_TeBACR_e_RplnshSts_SvcAppEnum
      VeBACR_V_eBstRemPlngrVolP: category=VALUE, type=T_V_Millimeters3
      VeBACR_p_eBstVDA_PbcHPO_P: category=VALUE, type=T_p_bar
      VeBACR_e_eBstVDA_PbcHPO_ReqP: category=VALUE, type=hSVC_eBstActrPri_evt_VeBACR_e_eBstVDA_PbcHPO_ReqP_TeBACR_e_VDA_PbcHPO_Req_SvcAppEnum
      VeBACR_e_eBstHydFuncStP: category=VALUE, type=hSVC_eBstActrPri_evt_VeBACR_e_eBstHydFuncStP_TeBACR_e_eBstHydState_SvcAppEnum
      YeBACR_b_eBst_BstUnavlblP: category=VALUE, type=TbBOOLEAN
      VeBACR_d_eBstEBCM_SwVerAlphP: category=VALUE, type=WORD
      VeBACR_g_eBstEBCM_SwVerPN_P: category=VALUE, type=LONGWORD
      VeBACR_b_eBstPCanCommStsP: category=VALUE, type=TbBOOLEAN
      VeBACR_V_eBstHydCmpOffstVolP: category=VALUE, type=T_V_Millimeters3
      VaBACR_y_UpIntegrationOutputP: category=ARRAY, type=VaBACR_y_UpIntegrationOutputP_VaBACR_y_UpIntegrationOutputP
      VeBACR_e_SbmPrimDiagStStsP: category=VALUE, type=hSVC_eBstActrPri_evt_VeBACR_e_SbmPrimDiagStStsP_TeBACR_e_SbmDiagStSts_SvcAppEnum
      VeBACR_e_eBstWhlCntrlStsLfP: category=VALUE, type=hSVC_eBstActrPri_evt_VeBACR_e_eBstWhlCntrlStsLfP_TeBACR_e_WhlCntrlSts_SvcAppEnum
      YeBACR_e_eBstEPB_StatusRtP: category=VALUE, type=hSVC_eBstActrPri_evt_YeBACR_e_eBstEPB_StatusRtP_TeBACR_e_EPB_Status_SvcAppEnum
      VeBACR_e_eBstWhlCntrlStsRrP: category=VALUE, type=hSVC_eBstActrPri_evt_VeBACR_e_eBstWhlCntrlStsRrP_TeBACR_e_WhlCntrlSts_SvcAppEnum
      VeBACR_e_eBstWhlCntrlStsLrP: category=VALUE, type=hSVC_eBstActrPri_evt_VeBACR_e_eBstWhlCntrlStsLrP_TeBACR_e_WhlCntrlSts_SvcAppEnum
      VeBACR_b_MIL_ReqFromEBCM_P: category=VALUE, type=TbBOOLEAN
      VeBACR_e_eBstWhlCntrlStsRfP: category=VALUE, type=hSVC_eBstActrPri_evt_VeBACR_e_eBstWhlCntrlStsRfP_TeBACR_e_WhlCntrlSts_SvcAppEnum
      YeBACR_e_eBstEPB_StatusLtP: category=VALUE, type=hSVC_eBstActrPri_evt_YeBACR_e_eBstEPB_StatusLtP_TeBACR_e_EPB_Status_SvcAppEnum
      VeBACR_e_PrimDiagStStsP: category=VALUE, type=hSVC_eBstActrPri_evt_VeBACR_e_PrimDiagStStsP_TeBACR_e_DiagStSts_SvcAppEnum
      VeBACR_b_eBstPanicBrkAppActP: category=VALUE, type=TbBOOLEAN
      VeBACR_e_eBstPCanCommStsP: category=VALUE, type=hSVC_eBstActrPri_evt_VeBACR_e_eBstPCanCommStsP_TeBACR_e_PCanCommSts_SvcAppEnum
      VeBACR_b_ThermalCapInvP: category=VALUE, type=TbBOOLEAN
package /SVC_DEF_Hierarchy/SVC_eBstActrPriDef/ImpDataType
  22 x impl type:
    hSVC_eBstActrPri_evt_EventImpType: category=STRUCTURE
      116 x element:
        VeBACR_d_eBstWS_VdaBitsRfP: implementation-data-type=WORD
        VeBACR_b_eBstWS_StndStllRfP: implementation-data-type=TbBOOLEAN
        VeBACR_F_eBstEPB_AchvdRtP: implementation-data-type=T_F_Newtons
        VeBACR_b_eBstMC_AchvdInvP: implementation-data-type=TbBOOLEAN
        VeBACR_l_eBstMCP: implementation-data-type=T_l_Millimeters
        VeBACR_d_eBstWS_VdaBitsLfP: implementation-data-type=WORD
        VeBACR_Cnt_eBstWS_TmD3_RrP: implementation-data-type=T_COUNT_WORD
        VeBACR_Cnt_eBstWS_PulsRrP: implementation-data-type=T_COUNT_WORD
        VeBACR_Cnt_eBstWS_TmD1_RrP: implementation-data-type=T_COUNT_WORD
        VeBACR_Cnt_eBstWS_TmD2_LfP: implementation-data-type=T_COUNT_WORD
        VeBACR_l_eBstPlngrPosnP: implementation-data-type=T_l_Millimeters
        VeBACR_Cnt_eBstWS_TmD1_LrP: implementation-data-type=T_COUNT_WORD
        VeBACR_b_eBstWS_InvLrP: implementation-data-type=TbBOOLEAN
        VeBACR_p_eBstMC_AchvdP: implementation-data-type=T_p_bar
        VeBACR_p_eBstBkPrsEstRrP: implementation-data-type=T_p_bar
        VeBACR_e_eBstEPB_StateLtP: implementation-data-type=hSVC_eBstActrPri_evt_VeBACR_e_eBstEPB_StateLtP_TeBACR_e_EPB_State_SvcEnum
        VeBACR_Cnt_eBstWS_TmD3_RfP: implementation-data-type=T_COUNT_WORD
        VeBACR_e_eBstPlngrPosnStsP: implementation-data-type=hSVC_eBstActrPri_evt_VeBACR_e_eBstPlngrPosnStsP_TeBPRR_e_ActPosnSts_SvcEnum
        VeBACR_b_eBst_BstWthWarningP: implementation-data-type=TbBOOLEAN
        VeBACR_Cnt_eBstWS_PulsRfP: implementation-data-type=T_COUNT_WORD
        VeBACR_p_eBstBkPrsEstLfP: implementation-data-type=T_p_bar
        VeBACR_Cnt_eBstWS_PulsLrP: implementation-data-type=T_COUNT_WORD
        VeBACR_b_eBstBC_AchvdInvP: implementation-data-type=TbBOOLEAN
        VeBACR_e_eBstMC_StsP: implementation-data-type=hSVC_eBstActrPri_evt_VeBACR_e_eBstMC_StsP_TeBACR_e_VldTrvlSnsrs_SvcEnum
        VeBACR_b_eBstWS_InvRrP: implementation-data-type=TbBOOLEAN
        VeBACR_d_eBstWS_VdaBitsLrP: implementation-data-type=WORD
        VeBACR_Cnt_eBstWS_TmD3_LfP: implementation-data-type=T_COUNT_WORD
        VeBACR_Cnt_eBstWS_TmD3_LrP: implementation-data-type=T_COUNT_WORD
        VeBACR_e_eBstEPB_AchModeRtP: implementation-data-type=hSVC_eBstActrPri_evt_VeBACR_e_eBstEPB_AchModeRtP_TeBACR_e_EPB_AchMode_SvcEnum
        YeBACR_Pct_eBstThermalCapP: implementation-data-type=T_Pct_Percent
        VeBACR_b_eBstWS_StndStllRrP: implementation-data-type=TbBOOLEAN
        VeBACR_b_eBstWS_InvRfP: implementation-data-type=TbBOOLEAN
        VeBACR_e_eBstFluidLvlRawP: implementation-data-type=hSVC_eBstActrPri_evt_VeBACR_e_eBstFluidLvlRawP_TeBACR_e_BrkFluidLvl_SvcEnum
        VeBACR_p_eBstBC_AchvdP: implementation-data-type=T_p_bar
        VeBACR_Cnt_eBstWS_PulsLfP: implementation-data-type=T_COUNT_WORD
        VeBACR_Cnt_eBstWS_TmD1_RfP: implementation-data-type=T_COUNT_WORD
        VeBACR_Cnt_eBstWS_TmRrP: implementation-data-type=T_COUNT_LONG
        YeBACR_e_eBstEBOS_EBCMStateP: implementation-data-type=hSVC_eBstActrPri_evt_YeBACR_e_eBstEBOS_EBCMStateP_TeBACR_e_EBOS_EBCM_State_SvcEnum
        VeBACR_e_eBstIntrSelfTstStsP: implementation-data-type=hSVC_eBstActrPri_evt_VeBACR_e_eBstIntrSelfTstStsP_TeBACR_e_IntrSelfTstSts_SvcEnum
        VeBACR_Cnt_eBstWS_TmD2_LrP: implementation-data-type=T_COUNT_WORD
        VeBACR_d_eBstWS_VdaBitsRrP: implementation-data-type=WORD
        VeBACR_b_eBstPwrMgmtActP: implementation-data-type=TbBOOLEAN
        VeBACR_Cnt_eBstWS_VdaBitsRrP: implementation-data-type=T_COUNT_BYTE
        VeBACR_b_eBstWS_InvLfP: implementation-data-type=TbBOOLEAN
        VeBACR_d_eBstPwrMgmtRsnP: implementation-data-type=WORD
        VeBACR_Cnt_eBstWS_TmRfP: implementation-data-type=T_COUNT_LONG
        VeBACR_p_eBstBkPrsEstLrP: implementation-data-type=T_p_bar
        VeBACR_Cnt_eBstWS_TmLfP: implementation-data-type=T_COUNT_LONG
        VeBACR_Cnt_eBstWS_VdaBitsRfP: implementation-data-type=T_COUNT_BYTE
        VeBACR_Cnt_eBstWS_TmD2_RrP: implementation-data-type=T_COUNT_WORD
        VeBACR_b_eBstDgrdDBRReqstdP: implementation-data-type=TbBOOLEAN
        VeBACR_p_eBstBkPrsEstRfP: implementation-data-type=T_p_bar
        VeBACR_e_eBstEPB_StateRtP: implementation-data-type=hSVC_eBstActrPri_evt_VeBACR_e_eBstEPB_StateRtP_TeBACR_e_EPB_State_SvcEnum
        VeBACR_F_eBstEPB_AchvdLtP: implementation-data-type=T_F_Newtons
        VeBACR_Cnt_eBstWS_TmD2_RfP: implementation-data-type=T_COUNT_WORD
        VeBACR_Cnt_eBstWS_VdaBitsLfP: implementation-data-type=T_COUNT_BYTE
        VeBACR_b_eBstWS_StndStllLfP: implementation-data-type=TbBOOLEAN
        VeBACR_e_eBstEPB_AchModeLtP: implementation-data-type=hSVC_eBstActrPri_evt_VeBACR_e_eBstEPB_AchModeLtP_TeBACR_e_EPB_AchMode_SvcEnum
        VeBACR_Cnt_eBstWS_TmLrP: implementation-data-type=T_COUNT_LONG
        VeBACR_Cnt_eBstWS_TmD1_LfP: implementation-data-type=T_COUNT_WORD
        VeBACR_b_eBstWS_StndStllLrP: implementation-data-type=TbBOOLEAN
        VeBACR_Cnt_eBstWS_VdaBitsLrP: implementation-data-type=T_COUNT_BYTE
        VeBACR_Cnt_eBstWS_TmD7_RrP: implementation-data-type=T_COUNT_WORD
        VeBACR_U_eBstBrkActVolt2_P: implementation-data-type=T_U_Volts
        VeBACR_b_eBstBrkActCurr2FA_P: implementation-data-type=TbBOOLEAN
        VeBACR_Cnt_eBstWS_TmD8_RfP: implementation-data-type=T_COUNT_WORD
        VeBACR_Cnt_eBstWS_TmD7_LfP: implementation-data-type=T_COUNT_WORD
        VeBACR_Cnt_eBstWS_TmD8_LrP: implementation-data-type=T_COUNT_WORD
        VeBACR_Cnt_eBstWS_TmD5_LfP: implementation-data-type=T_COUNT_WORD
        VeBACR_Cnt_eBstWS_TmD4_LrP: implementation-data-type=T_COUNT_WORD
        VeBACR_Cnt_eBstWS_TmD5_RrP: implementation-data-type=T_COUNT_WORD
        VeBACR_Cnt_eBstWS_TmD6_RfP: implementation-data-type=T_COUNT_WORD
        VeBACR_Cnt_eBstWS_TmD4_RfP: implementation-data-type=T_COUNT_WORD
        VeBACR_Cnt_eBstWS_TmD6_LrP: implementation-data-type=T_COUNT_WORD
        VeBACR_U_eBstBrkActVolt1_P: implementation-data-type=T_U_Volts
        VeBACR_b_eBstBrkActVolt2FA_P: implementation-data-type=TbBOOLEAN
        VeBACR_Cnt_eBstWS_TmD8_LfP: implementation-data-type=T_COUNT_WORD
        VeBACR_Cnt_eBstWS_TmD7_LrP: implementation-data-type=T_COUNT_WORD
        VeBACR_Cnt_eBstWS_TmD8_RrP: implementation-data-type=T_COUNT_WORD
        VeBACR_b_eBstBrkActCurr1FA_P: implementation-data-type=TbBOOLEAN
        VeBACR_Cnt_eBstWS_TmD7_RfP: implementation-data-type=T_COUNT_WORD
        VeBACR_I_eBstBrkActCurr2_P: implementation-data-type=T_I_Amps
        VeBACR_Cnt_eBstWS_TmD4_RrP: implementation-data-type=T_COUNT_WORD
        VeBACR_Cnt_eBstWS_TmD5_LrP: implementation-data-type=T_COUNT_WORD
        VeBACR_Cnt_eBstWS_TmD4_LfP: implementation-data-type=T_COUNT_WORD
        VeBACR_Cnt_eBstWS_TmD6_LfP: implementation-data-type=T_COUNT_WORD
        VeBACR_Cnt_eBstWS_TmD6_RrP: implementation-data-type=T_COUNT_WORD
        VeBACR_Cnt_eBstWS_TmD5_RfP: implementation-data-type=T_COUNT_WORD
        VeBACR_b_eBstBrkActVolt1FA_P: implementation-data-type=TbBOOLEAN
        VeBACR_b_eBstLeakModeActvP: implementation-data-type=TbBOOLEAN
        VeBACR_b_eBstRecoveryActvP: implementation-data-type=TbBOOLEAN
        VeBACR_I_eBstBrkActCurr1_P: implementation-data-type=T_I_Amps
        VeBACR_V_eBstPotPlngrVolP: implementation-data-type=T_V_Millimeters3
        VeBACR_e_eBstRplnshStsP: implementation-data-type=hSVC_eBstActrPri_evt_VeBACR_e_eBstRplnshStsP_TeBACR_e_RplnshSts_SvcEnum
        VeBACR_V_eBstRemPlngrVolP: implementation-data-type=T_V_Millimeters3
        VeBACR_p_eBstVDA_PbcHPO_P: implementation-data-type=T_p_bar
        VeBACR_e_eBstVDA_PbcHPO_ReqP: implementation-data-type=hSVC_eBstActrPri_evt_VeBACR_e_eBstVDA_PbcHPO_ReqP_TeBACR_e_VDA_PbcHPO_Req_SvcEnum
        VeBACR_e_eBstHydFuncStP: implementation-data-type=hSVC_eBstActrPri_evt_VeBACR_e_eBstHydFuncStP_TeBACR_e_eBstHydState_SvcEnum
        YeBACR_b_eBst_BstUnavlblP: implementation-data-type=TbBOOLEAN
        VeBACR_d_eBstEBCM_SwVerAlphP: implementation-data-type=WORD
        VeBACR_g_eBstEBCM_SwVerPN_P: implementation-data-type=LONGWORD
        VeBACR_b_eBstPCanCommStsP: implementation-data-type=TbBOOLEAN
        VeBACR_V_eBstHydCmpOffstVolP: implementation-data-type=T_V_Millimeters3
        VaBACR_y_UpIntegrationOutputP: category=ARRAY
          element hSVC_eBstActrPriVaBACR_y_UpIntegrationOutputP_D0S150: array-size=150, implementation-data-type=BYTE
        VeBACR_e_SbmPrimDiagStStsP: implementation-data-type=hSVC_eBstActrPri_evt_VeBACR_e_SbmPrimDiagStStsP_TeBACR_e_SbmDiagStSts_SvcEnum
        VeBACR_e_eBstWhlCntrlStsLfP: implementation-data-type=hSVC_eBstActrPri_evt_VeBACR_e_eBstWhlCntrlStsLfP_TeBACR_e_WhlCntrlSts_SvcEnum
        YeBACR_e_eBstEPB_StatusRtP: implementation-data-type=hSVC_eBstActrPri_evt_YeBACR_e_eBstEPB_StatusRtP_TeBACR_e_EPB_Status_SvcEnum
        VeBACR_e_eBstWhlCntrlStsRrP: implementation-data-type=hSVC_eBstActrPri_evt_VeBACR_e_eBstWhlCntrlStsRrP_TeBACR_e_WhlCntrlSts_SvcEnum
        VeBACR_e_eBstWhlCntrlStsLrP: implementation-data-type=hSVC_eBstActrPri_evt_VeBACR_e_eBstWhlCntrlStsLrP_TeBACR_e_WhlCntrlSts_SvcEnum
        VeBACR_b_MIL_ReqFromEBCM_P: implementation-data-type=TbBOOLEAN
        VeBACR_e_eBstWhlCntrlStsRfP: implementation-data-type=hSVC_eBstActrPri_evt_VeBACR_e_eBstWhlCntrlStsRfP_TeBACR_e_WhlCntrlSts_SvcEnum
        YeBACR_e_eBstEPB_StatusLtP: implementation-data-type=hSVC_eBstActrPri_evt_YeBACR_e_eBstEPB_StatusLtP_TeBACR_e_EPB_Status_SvcEnum
        VeBACR_e_PrimDiagStStsP: implementation-data-type=hSVC_eBstActrPri_evt_VeBACR_e_PrimDiagStStsP_TeBACR_e_DiagStSts_SvcEnum
        VeBACR_b_eBstPanicBrkAppActP: implementation-data-type=TbBOOLEAN
        VeBACR_e_eBstPCanCommStsP: implementation-data-type=hSVC_eBstActrPri_evt_VeBACR_e_eBstPCanCommStsP_TeBACR_e_PCanCommSts_SvcEnum
        VeBACR_b_ThermalCapInvP: implementation-data-type=TbBOOLEAN
    hSVC_eBstActrPri_evt_VeBACR_e_PrimDiagStStsP_TeBACR_e_DiagStSts_SvcEnum:
      category=VALUE
      base-type=sint16
      compu {2=Ce_hSVC_eBstActrPri_evt_VeBACR_e_PrimDiagStStsP_BACR_e_DiagSts_TestCmplt, 1=Ce_hSVC_eBstActrPri_evt_VeBACR_e_PrimDiagStStsP_BACR_e_DiagSts_TestActv, 3=Ce_hSVC_eBstActrPri_evt_VeBACR_e_PrimDiagStStsP_BACR_e_DiagSts_TestFail, 4=Ce_hSVC_eBstActrPri_evt_VeBACR_e_PrimDiagStStsP_BACR_e_DiagSts_TstCndNtMet, 0=Ce_hSVC_eBstActrPri_evt_VeBACR_e_PrimDiagStStsP_BACR_e_DiagSts_NotActv}
    hSVC_eBstActrPri_evt_VeBACR_e_SbmPrimDiagStStsP_TeBACR_e_SbmDiagStSts_SvcEnum: category=VALUE, base-type=sint16, compu {0=Ce_hSVC_eBstActrPri_evt_VeBACR_e_SbmPrimDiagStStsP_BACR_e_NoDiagReq, 4=Ce_hSVC_eBstActrPri_evt_VeBACR_e_SbmPrimDiagStStsP_BACR_e_CondNotMet, 1=Ce_hSVC_eBstActrPri_evt_VeBACR_e_SbmPrimDiagStStsP_BACR_e_DiagState1, 2=Ce_hSVC_eBstActrPri_evt_VeBACR_e_SbmPrimDiagStStsP_BACR_e_DiagState2, 3=Ce_hSVC_eBstActrPri_evt_VeBACR_e_SbmPrimDiagStStsP_BACR_e_DiagState3}
    hSVC_eBstActrPri_evt_VeBACR_e_eBstEPB_AchModeLtP_TeBACR_e_EPB_AchMode_SvcEnum:
      category=VALUE
      base-type=sint16
      compu {25=Ce_hSVC_eBstActrPri_evt_VeBACR_e_eBstEPB_AchModeLtP_BACR_e_EPB_InPadAdjustment, 0=Ce_hSVC_eBstActrPri_evt_VeBACR_e_eBstEPB_AchModeLtP_BACR_e_EPB_InNone, 4=Ce_hSVC_eBstActrPri_evt_VeBACR_e_eBstEPB_AchModeLtP_BACR_e_EPB_InRollerBenchApply, 23=Ce_hSVC_eBstActrPri_evt_VeBACR_e_eBstEPB_AchModeLtP_BACR_e_EPB_InNoBoostEPBAst, 22=Ce_hSVC_eBstActrPri_evt_VeBACR_e_eBstEPB_AchModeLtP_BACR_e_EPB_InServiceRelease, 24=Ce_hSVC_eBstActrPri_evt_VeBACR_e_eBstEPB_AchModeLtP_BACR_e_EPB_InDynamicApply, 21=Ce_hSVC_eBstActrPri_evt_VeBACR_e_eBstEPB_AchModeLtP_BACR_e_EPB_InAssemblyCheck}
    hSVC_eBstActrPri_evt_VeBACR_e_eBstEPB_AchModeRtP_TeBACR_e_EPB_AchMode_SvcEnum:
      category=VALUE
      base-type=sint16
      compu {25=Ce_hSVC_eBstActrPri_evt_VeBACR_e_eBstEPB_AchModeRtP_BACR_e_EPB_InPadAdjustment, 24=Ce_hSVC_eBstActrPri_evt_VeBACR_e_eBstEPB_AchModeRtP_BACR_e_EPB_InDynamicApply, 0=Ce_hSVC_eBstActrPri_evt_VeBACR_e_eBstEPB_AchModeRtP_BACR_e_EPB_InNone, 21=Ce_hSVC_eBstActrPri_evt_VeBACR_e_eBstEPB_AchModeRtP_BACR_e_EPB_InAssemblyCheck, 22=Ce_hSVC_eBstActrPri_evt_VeBACR_e_eBstEPB_AchModeRtP_BACR_e_EPB_InServiceRelease, 4=Ce_hSVC_eBstActrPri_evt_VeBACR_e_eBstEPB_AchModeRtP_BACR_e_EPB_InRollerBenchApply, 23=Ce_hSVC_eBstActrPri_evt_VeBACR_e_eBstEPB_AchModeRtP_BACR_e_EPB_InNoBoostEPBAst}
    hSVC_eBstActrPri_evt_VeBACR_e_eBstEPB_StateLtP_TeBACR_e_EPB_State_SvcEnum:
      category=VALUE
      base-type=sint16
      compu {17=Ce_hSVC_eBstActrPri_evt_VeBACR_e_eBstEPB_StateLtP_BACR_e_EPB_Releasing, 18=Ce_hSVC_eBstActrPri_evt_VeBACR_e_eBstEPB_StateLtP_BACR_e_EPB_Released, 2=Ce_hSVC_eBstActrPri_evt_VeBACR_e_eBstEPB_StateLtP_BACR_e_EPB_Applied, 0=Ce_hSVC_eBstActrPri_evt_VeBACR_e_eBstEPB_StateLtP_BACR_e_EPB_Unknown, 1=Ce_hSVC_eBstActrPri_evt_VeBACR_e_eBstEPB_StateLtP_BACR_e_EPB_Applying}
    hSVC_eBstActrPri_evt_VeBACR_e_eBstEPB_StateRtP_TeBACR_e_EPB_State_SvcEnum:
      category=VALUE
      base-type=sint16
      compu {1=Ce_hSVC_eBstActrPri_evt_VeBACR_e_eBstEPB_StateRtP_BACR_e_EPB_Applying, 18=Ce_hSVC_eBstActrPri_evt_VeBACR_e_eBstEPB_StateRtP_BACR_e_EPB_Released, 17=Ce_hSVC_eBstActrPri_evt_VeBACR_e_eBstEPB_StateRtP_BACR_e_EPB_Releasing, 0=Ce_hSVC_eBstActrPri_evt_VeBACR_e_eBstEPB_StateRtP_BACR_e_EPB_Unknown, 2=Ce_hSVC_eBstActrPri_evt_VeBACR_e_eBstEPB_StateRtP_BACR_e_EPB_Applied}
    hSVC_eBstActrPri_evt_VeBACR_e_eBstFluidLvlRawP_TeBACR_e_BrkFluidLvl_SvcEnum: category=VALUE, base-type=sint16, compu {0=Ce_hSVC_eBstActrPri_evt_VeBACR_e_eBstFluidLvlRawP_BACR_e_BrkFluidLvlNormal, 3=Ce_hSVC_eBstActrPri_evt_VeBACR_e_eBstFluidLvlRawP_BACR_e_BrkFluidLvlFailed, 1=Ce_hSVC_eBstActrPri_evt_VeBACR_e_eBstFluidLvlRawP_BACR_e_BrkFluidLvlLow, 2=Ce_hSVC_eBstActrPri_evt_VeBACR_e_eBstFluidLvlRawP_BACR_e_BrkFluidLvlCritLow}
    hSVC_eBstActrPri_evt_VeBACR_e_eBstHydFuncStP_TeBACR_e_eBstHydState_SvcEnum:
      category=VALUE
      base-type=sint16
      compu {4=Ce_hSVC_eBstActrPri_evt_VeBACR_e_eBstHydFuncStP_BACR_e_eBstNoBoostWithIso, 0=Ce_hSVC_eBstActrPri_evt_VeBACR_e_eBstHydFuncStP_BACR_e_eBstHydNormal, 6=Ce_hSVC_eBstActrPri_evt_VeBACR_e_eBstHydFuncStP_BACR_e_eBstBoostReqWthDfrrd, 3=Ce_hSVC_eBstActrPri_evt_VeBACR_e_eBstHydFuncStP_BACR_e_eBstNoBoost, 5=Ce_hSVC_eBstActrPri_evt_VeBACR_e_eBstHydFuncStP_BACR_e_eBstHydLeakDetection, 1=Ce_hSVC_eBstActrPri_evt_VeBACR_e_eBstHydFuncStP_BACR_e_eBstHydHalfSystem1, 2=Ce_hSVC_eBstActrPri_evt_VeBACR_e_eBstHydFuncStP_BACR_e_eBstHydHalfSystem2}
    hSVC_eBstActrPri_evt_VeBACR_e_eBstIntrSelfTstStsP_TeBACR_e_IntrSelfTstSts_SvcEnum:
      category=VALUE
      base-type=sint16
      compu {2=Ce_hSVC_eBstActrPri_evt_VeBACR_e_eBstIntrSelfTstStsP_BACR_e_SelfTstAborted, 0=Ce_hSVC_eBstActrPri_evt_VeBACR_e_eBstIntrSelfTstStsP_BACR_e_SelfTstNotActive, 3=Ce_hSVC_eBstActrPri_evt_VeBACR_e_eBstIntrSelfTstStsP_BACR_e_SelfTstRetry, 4=Ce_hSVC_eBstActrPri_evt_VeBACR_e_eBstIntrSelfTstStsP_BACR_e_SelfTstComplete, 1=Ce_hSVC_eBstActrPri_evt_VeBACR_e_eBstIntrSelfTstStsP_BACR_e_SelfTstActive}
    hSVC_eBstActrPri_evt_VeBACR_e_eBstMC_StsP_TeBACR_e_VldTrvlSnsrs_SvcEnum: category=VALUE, base-type=sint16, compu {2=Ce_hSVC_eBstActrPri_evt_VeBACR_e_eBstMC_StsP_BACR_e_Two_VldSnrs, 0=Ce_hSVC_eBstActrPri_evt_VeBACR_e_eBstMC_StsP_BACR_e_Zero_VldSnrs, 1=Ce_hSVC_eBstActrPri_evt_VeBACR_e_eBstMC_StsP_BACR_e_One_VldSnr}
    hSVC_eBstActrPri_evt_VeBACR_e_eBstPCanCommStsP_TeBACR_e_PCanCommSts_SvcEnum: category=VALUE, base-type=sint16, compu {1=Ce_hSVC_eBstActrPri_evt_VeBACR_e_eBstPCanCommStsP_BACR_e_PCanStsNormal, 2=Ce_hSVC_eBstActrPri_evt_VeBACR_e_eBstPCanCommStsP_BACR_e_PCanStsFailed, 0=Ce_hSVC_eBstActrPri_evt_VeBACR_e_eBstPCanCommStsP_BACR_e_PCanStsUnknown}
    hSVC_eBstActrPri_evt_VeBACR_e_eBstPlngrPosnStsP_TeBPRR_e_ActPosnSts_SvcEnum: category=VALUE, base-type=sint16, compu {3=Ce_hSVC_eBstActrPri_evt_VeBACR_e_eBstPlngrPosnStsP_BPRR_e_PosnFailed, 1=Ce_hSVC_eBstActrPri_evt_VeBACR_e_eBstPlngrPosnStsP_BPRR_e_PosnUnknown, 0=Ce_hSVC_eBstActrPri_evt_VeBACR_e_eBstPlngrPosnStsP_BPRR_e_PosnInit, 2=Ce_hSVC_eBstActrPri_evt_VeBACR_e_eBstPlngrPosnStsP_BPRR_e_PosnLearned}
    hSVC_eBstActrPri_evt_VeBACR_e_eBstRplnshStsP_TeBACR_e_RplnshSts_SvcEnum:
      category=VALUE
      base-type=sint16
      compu {4=Ce_hSVC_eBstActrPri_evt_VeBACR_e_eBstRplnshStsP_BACR_e_ActvPrep, 0=Ce_hSVC_eBstActrPri_evt_VeBACR_e_eBstRplnshStsP_BACR_e_RplnshUnavailable, 3=Ce_hSVC_eBstActrPri_evt_VeBACR_e_eBstRplnshStsP_BACR_e_AvailLastEvntAbortd, 1=Ce_hSVC_eBstActrPri_evt_VeBACR_e_eBstRplnshStsP_BACR_e_AvailLastEvntSuccsess, 7=Ce_hSVC_eBstActrPri_evt_VeBACR_e_eBstRplnshStsP_BACR_e_RplnshFailed, 5=Ce_hSVC_eBstActrPri_evt_VeBACR_e_eBstRplnshStsP_BACR_e_ActvRplnsh, 6=Ce_hSVC_eBstActrPri_evt_VeBACR_e_eBstRplnshStsP_BACR_e_ActvTransn, 2=Ce_hSVC_eBstActrPri_evt_VeBACR_e_eBstRplnshStsP_BACR_e_AvailLastEvntIntrptd}
    hSVC_eBstActrPri_evt_VeBACR_e_eBstVDA_PbcHPO_ReqP_TeBACR_e_VDA_PbcHPO_Req_SvcEnum: category=VALUE, base-type=sint16, compu {0=Ce_hSVC_eBstActrPri_evt_VeBACR_e_eBstVDA_PbcHPO_ReqP_BACR_e_VDA_PbcHPO_ReqNone, 2=Ce_hSVC_eBstActrPri_evt_VeBACR_e_eBstVDA_PbcHPO_ReqP_BACR_e_VdA_PbcHPO_ReqMax, 1=Ce_hSVC_eBstActrPri_evt_VeBACR_e_eBstVDA_PbcHPO_ReqP_BACR_e_VDA_PbcHPO_ReqNormal}
    hSVC_eBstActrPri_evt_VeBACR_e_eBstWhlCntrlStsLfP_TeBACR_e_WhlCntrlSts_SvcEnum: category=VALUE, base-type=sint16, compu {2=Ce_hSVC_eBstActrPri_evt_VeBACR_e_eBstWhlCntrlStsLfP_BACR_e_UnblDecrPress, 3=Ce_hSVC_eBstActrPri_evt_VeBACR_e_eBstWhlCntrlStsLfP_BACR_e_UnblMdfyPress, 0=Ce_hSVC_eBstActrPri_evt_VeBACR_e_eBstWhlCntrlStsLfP_BACR_e_Normal, 1=Ce_hSVC_eBstActrPri_evt_VeBACR_e_eBstWhlCntrlStsLfP_BACR_e_UnblBuildPress}
    hSVC_eBstActrPri_evt_VeBACR_e_eBstWhlCntrlStsLrP_TeBACR_e_WhlCntrlSts_SvcEnum: category=VALUE, base-type=sint16, compu {1=Ce_hSVC_eBstActrPri_evt_VeBACR_e_eBstWhlCntrlStsLrP_BACR_e_UnblBuildPress, 3=Ce_hSVC_eBstActrPri_evt_VeBACR_e_eBstWhlCntrlStsLrP_BACR_e_UnblMdfyPress, 2=Ce_hSVC_eBstActrPri_evt_VeBACR_e_eBstWhlCntrlStsLrP_BACR_e_UnblDecrPress, 0=Ce_hSVC_eBstActrPri_evt_VeBACR_e_eBstWhlCntrlStsLrP_BACR_e_Normal}
    hSVC_eBstActrPri_evt_VeBACR_e_eBstWhlCntrlStsRfP_TeBACR_e_WhlCntrlSts_SvcEnum: category=VALUE, base-type=sint16, compu {0=Ce_hSVC_eBstActrPri_evt_VeBACR_e_eBstWhlCntrlStsRfP_BACR_e_Normal, 2=Ce_hSVC_eBstActrPri_evt_VeBACR_e_eBstWhlCntrlStsRfP_BACR_e_UnblDecrPress, 1=Ce_hSVC_eBstActrPri_evt_VeBACR_e_eBstWhlCntrlStsRfP_BACR_e_UnblBuildPress, 3=Ce_hSVC_eBstActrPri_evt_VeBACR_e_eBstWhlCntrlStsRfP_BACR_e_UnblMdfyPress}
    hSVC_eBstActrPri_evt_VeBACR_e_eBstWhlCntrlStsRrP_TeBACR_e_WhlCntrlSts_SvcEnum: category=VALUE, base-type=sint16, compu {3=Ce_hSVC_eBstActrPri_evt_VeBACR_e_eBstWhlCntrlStsRrP_BACR_e_UnblMdfyPress, 2=Ce_hSVC_eBstActrPri_evt_VeBACR_e_eBstWhlCntrlStsRrP_BACR_e_UnblDecrPress, 1=Ce_hSVC_eBstActrPri_evt_VeBACR_e_eBstWhlCntrlStsRrP_BACR_e_UnblBuildPress, 0=Ce_hSVC_eBstActrPri_evt_VeBACR_e_eBstWhlCntrlStsRrP_BACR_e_Normal}
    hSVC_eBstActrPri_evt_YeBACR_e_eBstEBOS_EBCMStateP_TeBACR_e_EBOS_EBCM_State_SvcEnum:
      category=VALUE
      base-type=sint16
      compu {0=Ce_hSVC_eBstActrPri_evt_YeBACR_e_eBstEBOS_EBCMStateP_BACR_e_EBOS_EBCM_Off, 3=Ce_hSVC_eBstActrPri_evt_YeBACR_e_eBstEBOS_EBCMStateP_BACR_e_EBOS_EBCM_RdntOprtn, 2=Ce_hSVC_eBstActrPri_evt_YeBACR_e_eBstEBOS_EBCMStateP_BACR_e_EBOS_EBCM_PreOprtn, 1=Ce_hSVC_eBstActrPri_evt_YeBACR_e_eBstEBOS_EBCMStateP_BACR_e_EBOS_EBCM_Init, 4=Ce_hSVC_eBstActrPri_evt_YeBACR_e_eBstEBOS_EBCMStateP_BACR_e_EBOS_EBCM_FuncOprtn, 5=Ce_hSVC_eBstActrPri_evt_YeBACR_e_eBstEBOS_EBCMStateP_BACR_e_EBOS_EBCM_HouseKeep}
    hSVC_eBstActrPri_evt_YeBACR_e_eBstEPB_StatusLtP_TeBACR_e_EPB_Status_SvcEnum: category=VALUE, base-type=sint16, compu {0=Ce_hSVC_eBstActrPri_evt_YeBACR_e_eBstEPB_StatusLtP_BACR_e_EPB_Initializing, 1=Ce_hSVC_eBstActrPri_evt_YeBACR_e_eBstEPB_StatusLtP_BACR_e_EPB_Normal, 2=Ce_hSVC_eBstActrPri_evt_YeBACR_e_eBstEPB_StatusLtP_BACR_e_EPB_Failed, 3=Ce_hSVC_eBstActrPri_evt_YeBACR_e_eBstEPB_StatusLtP_BACR_e_EPB_AsmblyChckIncmplt}
    hSVC_eBstActrPri_evt_YeBACR_e_eBstEPB_StatusRtP_TeBACR_e_EPB_Status_SvcEnum: category=VALUE, base-type=sint16, compu {1=Ce_hSVC_eBstActrPri_evt_YeBACR_e_eBstEPB_StatusRtP_BACR_e_EPB_Normal, 0=Ce_hSVC_eBstActrPri_evt_YeBACR_e_eBstEPB_StatusRtP_BACR_e_EPB_Initializing, 2=Ce_hSVC_eBstActrPri_evt_YeBACR_e_eBstEPB_StatusRtP_BACR_e_EPB_Failed, 3=Ce_hSVC_eBstActrPri_evt_YeBACR_e_eBstEPB_StatusRtP_BACR_e_EPB_AsmblyChckIncmplt}
package /SVC_DEF_Hierarchy/SVC_eBstActrSecDef
  collection hSVC_eBstActrSec: category=SET, element=hSVC_eBstActrSec_evt
  sender receiver interface hSVC_eBstActrSec_evt
    data hSVC_eBstActrSec_evt: type=hSVC_eBstActrSec_evt_EventAppType
